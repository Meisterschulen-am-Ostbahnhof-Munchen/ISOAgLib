## Kconfig.projbuild
```kconfig
menu "### ISOAgLib Example Configuration ###"

    config USE_ISO_TERMINAL_GRAPHICCONTEXT
        bool "USE_ISO_TERMINAL_GRAPHICCONTEXT"
        default n
    config USE_ISO_TERMINAL_GETATTRIBUTES
        bool "USE_ISO_TERMINAL_GETATTRIBUTES"
        default n
     config USE_VTOBJECT_alarmmask
        bool "USE_VTOBJECT_alarmmask"
        default n
     config USE_VTOBJECT_archedbargraph
         bool "USE_VTOBJECT_archedbargraph"
         default n
     config USE_VTOBJECT_auxiliaryfunction
         bool "USE_VTOBJECT_auxiliaryfunction"
         default n
     config USE_VTOBJECT_auxiliaryfunction2
         bool "USE_VTOBJECT_auxiliaryfunction2"
         default n
     config USE_VTOBJECT_auxiliaryinput
         bool "USE_VTOBJECT_auxiliaryinput"
         default n
     config USE_VTOBJECT_auxiliaryinput2
         bool "USE_VTOBJECT_auxiliaryinput2"
         default n
     config USE_VTOBJECT_button
         bool "USE_VTOBJECT_button"
         default n
     config USE_VTOBJECT_container
         bool "USE_VTOBJECT_container"
         default n
     config USE_VTOBJECT_colourmap
         bool "USE_VTOBJECT_colourmap"
         default n
     config USE_VTOBJECT_datamask
         bool "USE_VTOBJECT_datamask"
         default n
     config USE_VTOBJECT_ellipse
         bool "USE_VTOBJECT_ellipse"
         default n
     config USE_VTOBJECT_fillattributes
         bool "USE_VTOBJECT_fillattributes"
         default n
     config USE_VTOBJECT_fontattributes
         bool "USE_VTOBJECT_fontattributes"
         default n
     config USE_VTOBJECT_inputboolean
         bool "USE_VTOBJECT_inputboolean"
         default n
     config USE_VTOBJECT_inputlist
         bool "USE_VTOBJECT_inputlist"
         default n
     config USE_VTOBJECT_inputnumber
         bool "USE_VTOBJECT_inputnumber"
         default n
     config USE_VTOBJECT_inputstring
         bool "USE_VTOBJECT_inputstring"
         default n
     config USE_VTOBJECT_key
         bool "USE_VTOBJECT_key"
         default n
     config USE_VTOBJECT_line
         bool "USE_VTOBJECT_line"
         default n
     config USE_VTOBJECT_linearbargraph
         bool "USE_VTOBJECT_linearbargraph"
         default n
     config USE_VTOBJECT_lineattributes
         bool "USE_VTOBJECT_lineattributes"
         default n
     config USE_VTOBJECT_macro
         bool "USE_VTOBJECT_macro"
         default n
     config USE_VTOBJECT_meter
         bool "USE_VTOBJECT_meter"
         default n
     config USE_VTOBJECT_numbervariable
         bool "USE_VTOBJECT_numbervariable"
         default n
     config USE_VTOBJECT_objectpointer
         bool "USE_VTOBJECT_objectpointer"
         default n
     config USE_VTOBJECT_outputnumber
         bool "USE_VTOBJECT_outputnumber"
         default n
     config USE_VTOBJECT_outputstring
         bool "USE_VTOBJECT_outputstring"
         default n
     config USE_VTOBJECT_polygon
         bool "USE_VTOBJECT_polygon"
         default n
     config USE_VTOBJECT_picturegraphic
         bool "USE_VTOBJECT_picturegraphic"
         default n
     config USE_VTOBJECT_rectangle
         bool "USE_VTOBJECT_rectangle"
         default n
     config USE_VTOBJECT_softkeymask
         bool "USE_VTOBJECT_softkeymask"
         default n
     config USE_VTOBJECT_stringvariable
         bool "USE_VTOBJECT_stringvariable"
         default n
     config USE_VTOBJECT_workingset
         bool "USE_VTOBJECT_workingset"
         default n
            

endmenu
```
