extern const IsoAgLib::iVtObject_c::iVtObjectWorkingSet_s iVtObjectimiIsoMaskupload_sROM;
extern const IsoAgLib::iVtObject_c::iVtObjectOutputString_s iVtObjectos1_sROM;
extern const IsoAgLib::iVtObject_c::iVtObjectOutputString_s iVtObjectos2_sROM;
extern const IsoAgLib::iVtObject_c::iVtObjectDataMask_s iVtObjectMainMask_sROM;
extern const IsoAgLib::iVtObject_c::iVtObjectOutputString_s iVtObjectos3_sROM;
extern const IsoAgLib::iVtObject_c::iVtObjectFontAttributes_s iVtObjectFontAttributesNormal12x16_sROM;
extern const IsoAgLib::iVtObject_c::iVtObjectFontAttributes_s iVtObjectFontAttributesSKM6x8_sROM;
