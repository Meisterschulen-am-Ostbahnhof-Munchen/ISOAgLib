IsoAgLib::iVtObjectWorkingSet_c iVtObjectimiIsoMaskupload_2;
IsoAgLib::iVtObjectOutputString_c iVtObjectopsWS1;
IsoAgLib::iVtObjectOutputString_c iVtObjectopsWS2;
IsoAgLib::iVtObjectContainer_c iVtObjectcontainerInAllMasks_2;
IsoAgLib::iVtObjectRectangle_c iVtObjectrect1;
IsoAgLib::iVtObjectPictureGraphic_c iVtObjectBigLogo_2;
IsoAgLib::iVtObjectLine_c iVtObjectleine_2;
IsoAgLib::iVtObjectOutputString_c iVtObjectOutStrLang;
IsoAgLib::iVtObjectOutputString_c iVtObjectOutStrLang_2;
IsoAgLib::iVtObjectOutputString_c iVtObjectOutStrLang_1;
IsoAgLib::iVtObjectNumberVariable_c iVtObjectVarOutNumVal;
IsoAgLib::iVtObjectOutputNumber_c iVtObjectOutNumVal;
IsoAgLib::iVtObjectInputString_c iVtObjectInpString;
IsoAgLib::iVtObjectInputNumber_c iVtObjectInpNumVal;
IsoAgLib::iVtObjectOutputNumber_c iVtObjectfrstLstElem;
IsoAgLib::iVtObjectOutputNumber_c iVtObjectscndLstElem;
IsoAgLib::iVtObjectOutputNumber_c iVtObjectthrdLstElem;
IsoAgLib::iVtObjectOutputNumber_c iVtObjectfrthLstElem;
IsoAgLib::iVtObjectInputList_c iVtObjectInputNumList;
IsoAgLib::iVtObjectButton_c iVtObjectBtn1;
IsoAgLib::iVtObjectOutputString_c iVtObjectbtn1;
IsoAgLib::iVtObjectButton_c iVtObjectBtn2;
IsoAgLib::iVtObjectOutputString_c iVtObjectbtn2;
IsoAgLib::iVtObjectButton_c iVtObjectBtn3;
IsoAgLib::iVtObjectOutputString_c iVtObjectbtn3;
IsoAgLib::iVtObjectKey_c iVtObjectKeyReset_2;
IsoAgLib::iVtObjectOutputString_c iVtObjectOutStrSoftKey;
IsoAgLib::iVtObjectOutputString_c iVtObjectOutStrSoftKey_1;
IsoAgLib::iVtObjectOutputString_c iVtObjectOutStrSoftKey_2;
IsoAgLib::iVtObjectKey_c iVtObjectKeyMove_2;
IsoAgLib::iVtObjectOutputString_c iVtObjectops1;
IsoAgLib::iVtObjectKey_c iVtObjectKeyLogo_2;
IsoAgLib::iVtObjectOutputString_c iVtObjectops2;
IsoAgLib::iVtObjectKey_c iVtObjectKeyChangeLang_2;
IsoAgLib::iVtObjectOutputString_c iVtObjectops3;
IsoAgLib::iVtObjectKey_c iVtObjectKeyChangeCol_2;
IsoAgLib::iVtObjectOutputString_c iVtObjectops4;
IsoAgLib::iVtObjectOutputString_c iVtObjectops5;
IsoAgLib::iVtObjectKey_c iVtObjectKeyForbidden_2;
IsoAgLib::iVtObjectOutputString_c iVtObjectops6;
IsoAgLib::iVtObjectKey_c iVtObjectKeyChangeMask_2;
IsoAgLib::iVtObjectOutputString_c iVtObjectops7;
IsoAgLib::iVtObjectButton_c iVtObjectKeyBackMask;
IsoAgLib::iVtObjectOutputString_c iVtObjectops8;
IsoAgLib::iVtObjectButton_c iVtObjectKeyNextMask;
IsoAgLib::iVtObjectOutputString_c iVtObjectops9;
IsoAgLib::iVtObjectEllipse_c iVtObjectdEllipse_2;
IsoAgLib::iVtObjectPolygon_c iVtObjectdPolygon_2;
IsoAgLib::iVtObjectDataMask_c iVtObjectMainMask_2;
IsoAgLib::iVtObjectContainer_c iVtObjectmask1contentscontainer_2;
IsoAgLib::iVtObjectOutputString_c iVtObjectops10;
IsoAgLib::iVtObjectOutputString_c iVtObjectops11;
IsoAgLib::iVtObjectOutputString_c iVtObjectops12;
IsoAgLib::iVtObjectOutputString_c iVtObjectops13;
IsoAgLib::iVtObjectOutputString_c iVtObjectops14;
IsoAgLib::iVtObjectOutputString_c iVtObjectops15;
IsoAgLib::iVtObjectObjectPointer_c iVtObjectOutNumPtr;
IsoAgLib::iVtObjectObjectPointer_c iVtObjectInputListptr;
IsoAgLib::iVtObjectArchedBarGraph_c iVtObjectAccelArchedBarGraph_2;
IsoAgLib::iVtObjectOutputString_c iVtObjectOpsFakeMileage_2;
IsoAgLib::iVtObjectObjectPointer_c iVtObjectChangeAwayPointer_2;
IsoAgLib::iVtObjectRectangle_c iVtObjectrect2;
IsoAgLib::iVtObjectInputBoolean_c iVtObjectInputLikeage_2;
IsoAgLib::iVtObjectObjectPointer_c iVtObjectLikeageOP_2;
IsoAgLib::iVtObjectSoftKeyMask_c iVtObjectsoftkeys1_2;
IsoAgLib::iVtObjectDataMask_c iVtObjectAnotherMask_2;
IsoAgLib::iVtObjectOutputString_c iVtObjectops16;
IsoAgLib::iVtObjectOutputString_c iVtObjectops17;
IsoAgLib::iVtObjectOutputString_c iVtObjectops18;
IsoAgLib::iVtObjectOutputString_c iVtObjectops19;
IsoAgLib::iVtObjectOutputString_c iVtObjectops20;
IsoAgLib::iVtObjectOutputString_c iVtObjectops21;
IsoAgLib::iVtObjectOutputString_c iVtObjectops22;
IsoAgLib::iVtObjectSoftKeyMask_c iVtObjectsoftkeys2_2;
IsoAgLib::iVtObjectDataMask_c iVtObjectLastMask;
IsoAgLib::iVtObjectSoftKeyMask_c iVtObjectsoftkeys3;
IsoAgLib::iVtObjectAlarmMask_c iVtObjectForbiddenAlarmMask_2;
IsoAgLib::iVtObjectContainer_c iVtObjectalarm1contentscontainer_2;
IsoAgLib::iVtObjectOutputString_c iVtObjectops23;
IsoAgLib::iVtObjectOutputString_c iVtObjectops24;
IsoAgLib::iVtObjectOutputString_c iVtObjectops25;
IsoAgLib::iVtObjectFontAttributes_c iVtObjectFontAttributesNormal6x8_2;
IsoAgLib::iVtObjectFontAttributes_c iVtObjectFontAttributes_2_Normal6x8LangDep;
IsoAgLib::iVtObjectFontAttributes_c iVtObjectFontAttributes_2_Normal6x8LangDep_1;
IsoAgLib::iVtObjectFontAttributes_c iVtObjectFontAttributes_2_Normal6x8LangDep_2;
IsoAgLib::iVtObjectFillAttributes_c iVtObjectFillAttrib;
IsoAgLib::iVtObjectFillAttributes_c iVtObjectFillAttributes_2;
IsoAgLib::iVtObjectFontAttributes_c iVtObjectFontAttributesNormal8x12_2;
IsoAgLib::iVtObjectFontAttributes_c iVtObjectFontAttributesNormal6x8R_2;
IsoAgLib::iVtObjectFontAttributes_c iVtObjectFontAttributesNormal6x8B_2;
IsoAgLib::iVtObjectFontAttributes_c iVtObjectFontAttributesNormal8x8_2;
IsoAgLib::iVtObjectFontAttributes_c iVtObjectFontAttributesNormal12x16_2;
IsoAgLib::iVtObjectFontAttributes_c iVtObjectFontAttributesNormal16x16_2;
IsoAgLib::iVtObjectFontAttributes_c iVtObjectFontAttributesNormal16x24_2;
IsoAgLib::iVtObjectFontAttributes_c iVtObjectFontAttributesNormal24x32_2;
IsoAgLib::iVtObjectLineAttributes_c iVtObjectLineAttributes_Normal_2;
IsoAgLib::iVtObjectLineAttributes_c iVtObjectLineAttributesNormal_2;
IsoAgLib::iVtObjectLineAttributes_c iVtObjectLineAttributesDotted_2;
IsoAgLib::iVtObjectFontAttributes_c iVtObjectFontAttributesSKM6x8_2;
IsoAgLib::iVtObjectFontAttributes_c iVtObjectFontAttributesSKM8x8_2;
IsoAgLib::iVtObjectFontAttributes_c iVtObjectFontAttributesSKM12x16_2;
IsoAgLib::iVtObjectLineAttributes_c iVtObjectLineAttributesSKM_2;
IsoAgLib::iVtObjectFontAttributes_c iVtObjectFontAttributesNormal6x8_Button60x30_2;
