#define iVtObjectIDimiIsoMaskupload_2 65534
#define iVtObjectIDopsWS1 65533
#define iVtObjectIDopsWS2 65532
#define iVtObjectIDcontainerInAllMasks_2 65531
#define iVtObjectIDrect1 65530
#define iVtObjectIDBigLogo_2 65529
#define iVtObjectIDleine_2 65528
#define iVtObjectIDOutStrLang 65527
#define iVtObjectIDOutStrLang_2 65527
#define iVtObjectIDOutStrLang_1 65527
#define iVtObjectIDVarOutNumVal 65526
#define iVtObjectIDOutNumVal 65525
#define iVtObjectIDInpString 65524
#define iVtObjectIDInpNumVal 65523
#define iVtObjectIDfrstLstElem 65522
#define iVtObjectIDscndLstElem 65521
#define iVtObjectIDthrdLstElem 65520
#define iVtObjectIDfrthLstElem 65519
#define iVtObjectIDInputNumList 65518
#define iVtObjectIDBtn1 65517
#define vtKeyCodeBtn1 1
#define iVtObjectIDbtn1 65516
#define iVtObjectIDBtn2 65515
#define vtKeyCodeBtn2 2
#define iVtObjectIDbtn2 65514
#define iVtObjectIDBtn3 65513
#define vtKeyCodeBtn3 3
#define iVtObjectIDbtn3 65512
#define iVtObjectIDKeyReset_2 65511
#define vtKeyCodeKeyReset_2 4
#define iVtObjectIDOutStrSoftKey 65510
#define iVtObjectIDOutStrSoftKey_1 65510
#define iVtObjectIDOutStrSoftKey_2 65510
#define iVtObjectIDKeyMove_2 65509
#define vtKeyCodeKeyMove_2 5
#define iVtObjectIDops1 65508
#define iVtObjectIDKeyLogo_2 65507
#define vtKeyCodeKeyLogo_2 6
#define iVtObjectIDops2 65506
#define iVtObjectIDKeyChangeLang_2 65505
#define vtKeyCodeKeyChangeLang_2 7
#define iVtObjectIDops3 65504
#define iVtObjectIDKeyChangeCol_2 65503
#define vtKeyCodeKeyChangeCol_2 8
#define iVtObjectIDops4 65502
#define iVtObjectIDops5 65501
#define iVtObjectIDKeyForbidden_2 65500
#define vtKeyCodeKeyForbidden_2 9
#define iVtObjectIDops6 65499
#define iVtObjectIDKeyChangeMask_2 65498
#define vtKeyCodeKeyChangeMask_2 10
#define iVtObjectIDops7 65497
#define iVtObjectIDKeyBackMask 65496
#define vtKeyCodeKeyBackMask 11
#define iVtObjectIDops8 65495
#define iVtObjectIDKeyNextMask 65494
#define vtKeyCodeKeyNextMask 12
#define iVtObjectIDops9 65493
#define iVtObjectIDdEllipse_2 65492
#define iVtObjectIDdPolygon_2 65491
#define iVtObjectIDMainMask_2 65490
#define iVtObjectIDmask1contentscontainer_2 65489
#define iVtObjectIDops10 65488
#define iVtObjectIDops11 65487
#define iVtObjectIDops12 65486
#define iVtObjectIDops13 65485
#define iVtObjectIDops14 65484
#define iVtObjectIDops15 65483
#define iVtObjectIDOutNumPtr 65482
#define iVtObjectIDInputListptr 65481
#define iVtObjectIDAccelArchedBarGraph_2 65480
#define iVtObjectIDOpsFakeMileage_2 65479
#define iVtObjectIDChangeAwayPointer_2 65478
#define iVtObjectIDrect2 65477
#define iVtObjectIDInputLikeage_2 65476
#define iVtObjectIDLikeageOP_2 65475
#define iVtObjectIDsoftkeys1_2 65474
#define iVtObjectIDAnotherMask_2 65473
#define iVtObjectIDops16 65472
#define iVtObjectIDops17 65471
#define iVtObjectIDops18 65470
#define iVtObjectIDops19 65469
#define iVtObjectIDops20 65468
#define iVtObjectIDops21 65467
#define iVtObjectIDops22 65466
#define iVtObjectIDsoftkeys2_2 65465
#define iVtObjectIDLastMask 65464
#define iVtObjectIDsoftkeys3 65463
#define iVtObjectIDForbiddenAlarmMask_2 65462
#define iVtObjectIDalarm1contentscontainer_2 65461
#define iVtObjectIDops23 65460
#define iVtObjectIDops24 65459
#define iVtObjectIDops25 65458
#define iVtObjectIDFontAttributesNormal6x8_2 65457
#define iVtObjectIDFontAttributes_2_Normal6x8LangDep 65456
#define iVtObjectIDFontAttributes_2_Normal6x8LangDep_1 65456
#define iVtObjectIDFontAttributes_2_Normal6x8LangDep_2 65456
#define iVtObjectIDFillAttrib 65455
#define iVtObjectIDFillAttributes_2 65454
#define iVtObjectIDFontAttributesNormal8x12_2 65453
#define iVtObjectIDFontAttributesNormal6x8R_2 65452
#define iVtObjectIDFontAttributesNormal6x8B_2 65451
#define iVtObjectIDFontAttributesNormal8x8_2 65450
#define iVtObjectIDFontAttributesNormal12x16_2 65449
#define iVtObjectIDFontAttributesNormal16x16_2 65448
#define iVtObjectIDFontAttributesNormal16x24_2 65447
#define iVtObjectIDFontAttributesNormal24x32_2 65446
#define iVtObjectIDLineAttributes_Normal_2 65445
#define iVtObjectIDLineAttributesNormal_2 65444
#define iVtObjectIDLineAttributesDotted_2 65443
#define iVtObjectIDFontAttributesSKM6x8_2 65442
#define iVtObjectIDFontAttributesSKM8x8_2 65441
#define iVtObjectIDFontAttributesSKM12x16_2 65440
#define iVtObjectIDLineAttributesSKM_2 65439
#define iVtObjectIDFontAttributesNormal6x8_Button60x30_2 65438
#define vtObjectPoolDimension 200
#define vtObjectPoolSoftKeyWidth 60
#define vtObjectPoolSoftKeyHeight 32

#define vtKeyCodeACK 0
