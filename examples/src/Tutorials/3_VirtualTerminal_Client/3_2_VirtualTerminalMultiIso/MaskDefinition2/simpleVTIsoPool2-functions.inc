void iObjectPool_simpleVTIsoPool2_c::initAllObjectsOnce (SINGLETON_VEC_KEY_PARAMETER_DEF)
{
  if (b_initAllObjects) return;   // so the pointer to the ROM structures are only getting set once on initialization!
  iVtObjectimiIsoMaskupload_2.init (&iVtObjectimiIsoMaskupload_2_sROM SINGLETON_VEC_KEY_PARAMETER_USE_WITH_COMMA);
  iVtObjectopsWS1.init (&iVtObjectopsWS1_sROM SINGLETON_VEC_KEY_PARAMETER_USE_WITH_COMMA);
  iVtObjectopsWS2.init (&iVtObjectopsWS2_sROM SINGLETON_VEC_KEY_PARAMETER_USE_WITH_COMMA);
  iVtObjectcontainerInAllMasks_2.init (&iVtObjectcontainerInAllMasks_2_sROM SINGLETON_VEC_KEY_PARAMETER_USE_WITH_COMMA);
  iVtObjectrect1.init (&iVtObjectrect1_sROM SINGLETON_VEC_KEY_PARAMETER_USE_WITH_COMMA);
  iVtObjectBigLogo_2.init (&iVtObjectBigLogo_2_sROM SINGLETON_VEC_KEY_PARAMETER_USE_WITH_COMMA);
  iVtObjectleine_2.init (&iVtObjectleine_2_sROM SINGLETON_VEC_KEY_PARAMETER_USE_WITH_COMMA);
  iVtObjectOutStrLang.init (&iVtObjectOutStrLang_sROM SINGLETON_VEC_KEY_PARAMETER_USE_WITH_COMMA);
  iVtObjectOutStrLang_2.init (&iVtObjectOutStrLang_2_sROM SINGLETON_VEC_KEY_PARAMETER_USE_WITH_COMMA);
  iVtObjectOutStrLang_1.init (&iVtObjectOutStrLang_1_sROM SINGLETON_VEC_KEY_PARAMETER_USE_WITH_COMMA);
  iVtObjectVarOutNumVal.init (&iVtObjectVarOutNumVal_sROM SINGLETON_VEC_KEY_PARAMETER_USE_WITH_COMMA);
  iVtObjectOutNumVal.init (&iVtObjectOutNumVal_sROM SINGLETON_VEC_KEY_PARAMETER_USE_WITH_COMMA);
  iVtObjectInpString.init (&iVtObjectInpString_sROM SINGLETON_VEC_KEY_PARAMETER_USE_WITH_COMMA);
  iVtObjectInpNumVal.init (&iVtObjectInpNumVal_sROM SINGLETON_VEC_KEY_PARAMETER_USE_WITH_COMMA);
  iVtObjectfrstLstElem.init (&iVtObjectfrstLstElem_sROM SINGLETON_VEC_KEY_PARAMETER_USE_WITH_COMMA);
  iVtObjectscndLstElem.init (&iVtObjectscndLstElem_sROM SINGLETON_VEC_KEY_PARAMETER_USE_WITH_COMMA);
  iVtObjectthrdLstElem.init (&iVtObjectthrdLstElem_sROM SINGLETON_VEC_KEY_PARAMETER_USE_WITH_COMMA);
  iVtObjectfrthLstElem.init (&iVtObjectfrthLstElem_sROM SINGLETON_VEC_KEY_PARAMETER_USE_WITH_COMMA);
  iVtObjectInputNumList.init (&iVtObjectInputNumList_sROM SINGLETON_VEC_KEY_PARAMETER_USE_WITH_COMMA);
  iVtObjectBtn1.init (&iVtObjectBtn1_sROM SINGLETON_VEC_KEY_PARAMETER_USE_WITH_COMMA);
  iVtObjectbtn1.init (&iVtObjectbtn1_sROM SINGLETON_VEC_KEY_PARAMETER_USE_WITH_COMMA);
  iVtObjectBtn2.init (&iVtObjectBtn2_sROM SINGLETON_VEC_KEY_PARAMETER_USE_WITH_COMMA);
  iVtObjectbtn2.init (&iVtObjectbtn2_sROM SINGLETON_VEC_KEY_PARAMETER_USE_WITH_COMMA);
  iVtObjectBtn3.init (&iVtObjectBtn3_sROM SINGLETON_VEC_KEY_PARAMETER_USE_WITH_COMMA);
  iVtObjectbtn3.init (&iVtObjectbtn3_sROM SINGLETON_VEC_KEY_PARAMETER_USE_WITH_COMMA);
  iVtObjectKeyReset_2.init (&iVtObjectKeyReset_2_sROM SINGLETON_VEC_KEY_PARAMETER_USE_WITH_COMMA);
  iVtObjectOutStrSoftKey.init (&iVtObjectOutStrSoftKey_sROM SINGLETON_VEC_KEY_PARAMETER_USE_WITH_COMMA);
  iVtObjectOutStrSoftKey_1.init (&iVtObjectOutStrSoftKey_1_sROM SINGLETON_VEC_KEY_PARAMETER_USE_WITH_COMMA);
  iVtObjectOutStrSoftKey_2.init (&iVtObjectOutStrSoftKey_2_sROM SINGLETON_VEC_KEY_PARAMETER_USE_WITH_COMMA);
  iVtObjectKeyMove_2.init (&iVtObjectKeyMove_2_sROM SINGLETON_VEC_KEY_PARAMETER_USE_WITH_COMMA);
  iVtObjectops1.init (&iVtObjectops1_sROM SINGLETON_VEC_KEY_PARAMETER_USE_WITH_COMMA);
  iVtObjectKeyLogo_2.init (&iVtObjectKeyLogo_2_sROM SINGLETON_VEC_KEY_PARAMETER_USE_WITH_COMMA);
  iVtObjectops2.init (&iVtObjectops2_sROM SINGLETON_VEC_KEY_PARAMETER_USE_WITH_COMMA);
  iVtObjectKeyChangeLang_2.init (&iVtObjectKeyChangeLang_2_sROM SINGLETON_VEC_KEY_PARAMETER_USE_WITH_COMMA);
  iVtObjectops3.init (&iVtObjectops3_sROM SINGLETON_VEC_KEY_PARAMETER_USE_WITH_COMMA);
  iVtObjectKeyChangeCol_2.init (&iVtObjectKeyChangeCol_2_sROM SINGLETON_VEC_KEY_PARAMETER_USE_WITH_COMMA);
  iVtObjectops4.init (&iVtObjectops4_sROM SINGLETON_VEC_KEY_PARAMETER_USE_WITH_COMMA);
  iVtObjectops5.init (&iVtObjectops5_sROM SINGLETON_VEC_KEY_PARAMETER_USE_WITH_COMMA);
  iVtObjectKeyForbidden_2.init (&iVtObjectKeyForbidden_2_sROM SINGLETON_VEC_KEY_PARAMETER_USE_WITH_COMMA);
  iVtObjectops6.init (&iVtObjectops6_sROM SINGLETON_VEC_KEY_PARAMETER_USE_WITH_COMMA);
  iVtObjectKeyChangeMask_2.init (&iVtObjectKeyChangeMask_2_sROM SINGLETON_VEC_KEY_PARAMETER_USE_WITH_COMMA);
  iVtObjectops7.init (&iVtObjectops7_sROM SINGLETON_VEC_KEY_PARAMETER_USE_WITH_COMMA);
  iVtObjectKeyBackMask.init (&iVtObjectKeyBackMask_sROM SINGLETON_VEC_KEY_PARAMETER_USE_WITH_COMMA);
  iVtObjectops8.init (&iVtObjectops8_sROM SINGLETON_VEC_KEY_PARAMETER_USE_WITH_COMMA);
  iVtObjectKeyNextMask.init (&iVtObjectKeyNextMask_sROM SINGLETON_VEC_KEY_PARAMETER_USE_WITH_COMMA);
  iVtObjectops9.init (&iVtObjectops9_sROM SINGLETON_VEC_KEY_PARAMETER_USE_WITH_COMMA);
  iVtObjectdEllipse_2.init (&iVtObjectdEllipse_2_sROM SINGLETON_VEC_KEY_PARAMETER_USE_WITH_COMMA);
  iVtObjectdPolygon_2.init (&iVtObjectdPolygon_2_sROM SINGLETON_VEC_KEY_PARAMETER_USE_WITH_COMMA);
  iVtObjectMainMask_2.init (&iVtObjectMainMask_2_sROM SINGLETON_VEC_KEY_PARAMETER_USE_WITH_COMMA);
  iVtObjectmask1contentscontainer_2.init (&iVtObjectmask1contentscontainer_2_sROM SINGLETON_VEC_KEY_PARAMETER_USE_WITH_COMMA);
  iVtObjectops10.init (&iVtObjectops10_sROM SINGLETON_VEC_KEY_PARAMETER_USE_WITH_COMMA);
  iVtObjectops11.init (&iVtObjectops11_sROM SINGLETON_VEC_KEY_PARAMETER_USE_WITH_COMMA);
  iVtObjectops12.init (&iVtObjectops12_sROM SINGLETON_VEC_KEY_PARAMETER_USE_WITH_COMMA);
  iVtObjectops13.init (&iVtObjectops13_sROM SINGLETON_VEC_KEY_PARAMETER_USE_WITH_COMMA);
  iVtObjectops14.init (&iVtObjectops14_sROM SINGLETON_VEC_KEY_PARAMETER_USE_WITH_COMMA);
  iVtObjectops15.init (&iVtObjectops15_sROM SINGLETON_VEC_KEY_PARAMETER_USE_WITH_COMMA);
  iVtObjectOutNumPtr.init (&iVtObjectOutNumPtr_sROM SINGLETON_VEC_KEY_PARAMETER_USE_WITH_COMMA);
  iVtObjectInputListptr.init (&iVtObjectInputListptr_sROM SINGLETON_VEC_KEY_PARAMETER_USE_WITH_COMMA);
  iVtObjectAccelArchedBarGraph_2.init (&iVtObjectAccelArchedBarGraph_2_sROM SINGLETON_VEC_KEY_PARAMETER_USE_WITH_COMMA);
  iVtObjectOpsFakeMileage_2.init (&iVtObjectOpsFakeMileage_2_sROM SINGLETON_VEC_KEY_PARAMETER_USE_WITH_COMMA);
  iVtObjectChangeAwayPointer_2.init (&iVtObjectChangeAwayPointer_2_sROM SINGLETON_VEC_KEY_PARAMETER_USE_WITH_COMMA);
  iVtObjectrect2.init (&iVtObjectrect2_sROM SINGLETON_VEC_KEY_PARAMETER_USE_WITH_COMMA);
  iVtObjectInputLikeage_2.init (&iVtObjectInputLikeage_2_sROM SINGLETON_VEC_KEY_PARAMETER_USE_WITH_COMMA);
  iVtObjectLikeageOP_2.init (&iVtObjectLikeageOP_2_sROM SINGLETON_VEC_KEY_PARAMETER_USE_WITH_COMMA);
  iVtObjectsoftkeys1_2.init (&iVtObjectsoftkeys1_2_sROM SINGLETON_VEC_KEY_PARAMETER_USE_WITH_COMMA);
  iVtObjectAnotherMask_2.init (&iVtObjectAnotherMask_2_sROM SINGLETON_VEC_KEY_PARAMETER_USE_WITH_COMMA);
  iVtObjectops16.init (&iVtObjectops16_sROM SINGLETON_VEC_KEY_PARAMETER_USE_WITH_COMMA);
  iVtObjectops17.init (&iVtObjectops17_sROM SINGLETON_VEC_KEY_PARAMETER_USE_WITH_COMMA);
  iVtObjectops18.init (&iVtObjectops18_sROM SINGLETON_VEC_KEY_PARAMETER_USE_WITH_COMMA);
  iVtObjectops19.init (&iVtObjectops19_sROM SINGLETON_VEC_KEY_PARAMETER_USE_WITH_COMMA);
  iVtObjectops20.init (&iVtObjectops20_sROM SINGLETON_VEC_KEY_PARAMETER_USE_WITH_COMMA);
  iVtObjectops21.init (&iVtObjectops21_sROM SINGLETON_VEC_KEY_PARAMETER_USE_WITH_COMMA);
  iVtObjectops22.init (&iVtObjectops22_sROM SINGLETON_VEC_KEY_PARAMETER_USE_WITH_COMMA);
  iVtObjectsoftkeys2_2.init (&iVtObjectsoftkeys2_2_sROM SINGLETON_VEC_KEY_PARAMETER_USE_WITH_COMMA);
  iVtObjectLastMask.init (&iVtObjectLastMask_sROM SINGLETON_VEC_KEY_PARAMETER_USE_WITH_COMMA);
  iVtObjectsoftkeys3.init (&iVtObjectsoftkeys3_sROM SINGLETON_VEC_KEY_PARAMETER_USE_WITH_COMMA);
  iVtObjectForbiddenAlarmMask_2.init (&iVtObjectForbiddenAlarmMask_2_sROM SINGLETON_VEC_KEY_PARAMETER_USE_WITH_COMMA);
  iVtObjectalarm1contentscontainer_2.init (&iVtObjectalarm1contentscontainer_2_sROM SINGLETON_VEC_KEY_PARAMETER_USE_WITH_COMMA);
  iVtObjectops23.init (&iVtObjectops23_sROM SINGLETON_VEC_KEY_PARAMETER_USE_WITH_COMMA);
  iVtObjectops24.init (&iVtObjectops24_sROM SINGLETON_VEC_KEY_PARAMETER_USE_WITH_COMMA);
  iVtObjectops25.init (&iVtObjectops25_sROM SINGLETON_VEC_KEY_PARAMETER_USE_WITH_COMMA);
  iVtObjectFontAttributesNormal6x8_2.init (&iVtObjectFontAttributesNormal6x8_2_sROM SINGLETON_VEC_KEY_PARAMETER_USE_WITH_COMMA);
  iVtObjectFontAttributes_2_Normal6x8LangDep.init (&iVtObjectFontAttributes_2_Normal6x8LangDep_sROM SINGLETON_VEC_KEY_PARAMETER_USE_WITH_COMMA);
  iVtObjectFontAttributes_2_Normal6x8LangDep_1.init (&iVtObjectFontAttributes_2_Normal6x8LangDep_1_sROM SINGLETON_VEC_KEY_PARAMETER_USE_WITH_COMMA);
  iVtObjectFontAttributes_2_Normal6x8LangDep_2.init (&iVtObjectFontAttributes_2_Normal6x8LangDep_2_sROM SINGLETON_VEC_KEY_PARAMETER_USE_WITH_COMMA);
  iVtObjectFillAttrib.init (&iVtObjectFillAttrib_sROM SINGLETON_VEC_KEY_PARAMETER_USE_WITH_COMMA);
  iVtObjectFillAttributes_2.init (&iVtObjectFillAttributes_2_sROM SINGLETON_VEC_KEY_PARAMETER_USE_WITH_COMMA);
  iVtObjectFontAttributesNormal8x12_2.init (&iVtObjectFontAttributesNormal8x12_2_sROM SINGLETON_VEC_KEY_PARAMETER_USE_WITH_COMMA);
  iVtObjectFontAttributesNormal6x8R_2.init (&iVtObjectFontAttributesNormal6x8R_2_sROM SINGLETON_VEC_KEY_PARAMETER_USE_WITH_COMMA);
  iVtObjectFontAttributesNormal6x8B_2.init (&iVtObjectFontAttributesNormal6x8B_2_sROM SINGLETON_VEC_KEY_PARAMETER_USE_WITH_COMMA);
  iVtObjectFontAttributesNormal8x8_2.init (&iVtObjectFontAttributesNormal8x8_2_sROM SINGLETON_VEC_KEY_PARAMETER_USE_WITH_COMMA);
  iVtObjectFontAttributesNormal12x16_2.init (&iVtObjectFontAttributesNormal12x16_2_sROM SINGLETON_VEC_KEY_PARAMETER_USE_WITH_COMMA);
  iVtObjectFontAttributesNormal16x16_2.init (&iVtObjectFontAttributesNormal16x16_2_sROM SINGLETON_VEC_KEY_PARAMETER_USE_WITH_COMMA);
  iVtObjectFontAttributesNormal16x24_2.init (&iVtObjectFontAttributesNormal16x24_2_sROM SINGLETON_VEC_KEY_PARAMETER_USE_WITH_COMMA);
  iVtObjectFontAttributesNormal24x32_2.init (&iVtObjectFontAttributesNormal24x32_2_sROM SINGLETON_VEC_KEY_PARAMETER_USE_WITH_COMMA);
  iVtObjectLineAttributes_Normal_2.init (&iVtObjectLineAttributes_Normal_2_sROM SINGLETON_VEC_KEY_PARAMETER_USE_WITH_COMMA);
  iVtObjectLineAttributesNormal_2.init (&iVtObjectLineAttributesNormal_2_sROM SINGLETON_VEC_KEY_PARAMETER_USE_WITH_COMMA);
  iVtObjectLineAttributesDotted_2.init (&iVtObjectLineAttributesDotted_2_sROM SINGLETON_VEC_KEY_PARAMETER_USE_WITH_COMMA);
  iVtObjectFontAttributesSKM6x8_2.init (&iVtObjectFontAttributesSKM6x8_2_sROM SINGLETON_VEC_KEY_PARAMETER_USE_WITH_COMMA);
  iVtObjectFontAttributesSKM8x8_2.init (&iVtObjectFontAttributesSKM8x8_2_sROM SINGLETON_VEC_KEY_PARAMETER_USE_WITH_COMMA);
  iVtObjectFontAttributesSKM12x16_2.init (&iVtObjectFontAttributesSKM12x16_2_sROM SINGLETON_VEC_KEY_PARAMETER_USE_WITH_COMMA);
  iVtObjectLineAttributesSKM_2.init (&iVtObjectLineAttributesSKM_2_sROM SINGLETON_VEC_KEY_PARAMETER_USE_WITH_COMMA);
  iVtObjectFontAttributesNormal6x8_Button60x30_2.init (&iVtObjectFontAttributesNormal6x8_Button60x30_2_sROM SINGLETON_VEC_KEY_PARAMETER_USE_WITH_COMMA);

  #include "simpleVTIsoPool2-functions-origin.inc"

  b_initAllObjects = true;
}
