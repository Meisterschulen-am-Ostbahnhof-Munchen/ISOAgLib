IsoAgLib::iVtObject_c* HUGE_MEM all_iVtObjects [] = {
 &iVtObjectimiIsoMaskupload_2,
 &iVtObjectFontAttributesNormal6x8_Button60x30_2,
 &iVtObjectLineAttributesSKM_2,
 &iVtObjectFontAttributesSKM12x16_2,
 &iVtObjectFontAttributesSKM8x8_2,
 &iVtObjectFontAttributesSKM6x8_2,
 &iVtObjectLineAttributesDotted_2,
 &iVtObjectLineAttributesNormal_2,
 &iVtObjectLineAttributes_Normal_2,
 &iVtObjectFontAttributesNormal24x32_2,
 &iVtObjectFontAttributesNormal16x24_2,
 &iVtObjectFontAttributesNormal16x16_2,
 &iVtObjectFontAttributesNormal12x16_2,
 &iVtObjectFontAttributesNormal8x8_2,
 &iVtObjectFontAttributesNormal6x8B_2,
 &iVtObjectFontAttributesNormal6x8R_2,
 &iVtObjectFontAttributesNormal8x12_2,
 &iVtObjectFillAttributes_2,
 &iVtObjectFillAttrib,
 &iVtObjectFontAttributesNormal6x8_2,
 &iVtObjectops25,
 &iVtObjectops24,
 &iVtObjectops23,
 &iVtObjectalarm1contentscontainer_2,
 &iVtObjectForbiddenAlarmMask_2,
 &iVtObjectsoftkeys3,
 &iVtObjectLastMask,
 &iVtObjectsoftkeys2_2,
 &iVtObjectops22,
 &iVtObjectops21,
 &iVtObjectops20,
 &iVtObjectops19,
 &iVtObjectops18,
 &iVtObjectops17,
 &iVtObjectops16,
 &iVtObjectAnotherMask_2,
 &iVtObjectsoftkeys1_2,
 &iVtObjectLikeageOP_2,
 &iVtObjectInputLikeage_2,
 &iVtObjectrect2,
 &iVtObjectChangeAwayPointer_2,
 &iVtObjectOpsFakeMileage_2,
 &iVtObjectAccelArchedBarGraph_2,
 &iVtObjectInputListptr,
 &iVtObjectOutNumPtr,
 &iVtObjectops15,
 &iVtObjectops14,
 &iVtObjectops13,
 &iVtObjectops12,
 &iVtObjectops11,
 &iVtObjectops10,
 &iVtObjectmask1contentscontainer_2,
 &iVtObjectMainMask_2,
 &iVtObjectdPolygon_2,
 &iVtObjectdEllipse_2,
 &iVtObjectops9,
 &iVtObjectKeyNextMask,
 &iVtObjectops8,
 &iVtObjectKeyBackMask,
 &iVtObjectops7,
 &iVtObjectKeyChangeMask_2,
 &iVtObjectops6,
 &iVtObjectKeyForbidden_2,
 &iVtObjectops5,
 &iVtObjectops4,
 &iVtObjectKeyChangeCol_2,
 &iVtObjectops3,
 &iVtObjectKeyChangeLang_2,
 &iVtObjectops2,
 &iVtObjectKeyLogo_2,
 &iVtObjectops1,
 &iVtObjectKeyMove_2,
 &iVtObjectKeyReset_2,
 &iVtObjectbtn3,
 &iVtObjectBtn3,
 &iVtObjectbtn2,
 &iVtObjectBtn2,
 &iVtObjectbtn1,
 &iVtObjectBtn1,
 &iVtObjectInputNumList,
 &iVtObjectfrthLstElem,
 &iVtObjectthrdLstElem,
 &iVtObjectscndLstElem,
 &iVtObjectfrstLstElem,
 &iVtObjectInpNumVal,
 &iVtObjectInpString,
 &iVtObjectOutNumVal,
 &iVtObjectVarOutNumVal,
 &iVtObjectleine_2,
 &iVtObjectBigLogo_2,
 &iVtObjectrect1,
 &iVtObjectcontainerInAllMasks_2,
 &iVtObjectopsWS2,
 &iVtObjectopsWS1
};

IsoAgLib::iVtObject_c* HUGE_MEM * all_iVtObjectLists [] = {
  all_iVtObjects,
  all_iVtObjects0,
  all_iVtObjects1,
  all_iVtObjects2,
  NULL // indicate end of list
};

iObjectPool_simpleVTIsoPool2_c::iObjectPool_simpleVTIsoPool2_c () : iIsoTerminalObjectPool_c (all_iVtObjectLists, 94, 3, 200, 60, 32) {};
