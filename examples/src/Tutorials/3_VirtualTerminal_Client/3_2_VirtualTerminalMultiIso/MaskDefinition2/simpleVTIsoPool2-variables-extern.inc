extern IsoAgLib::iVtObjectWorkingSet_c iVtObjectimiIsoMaskupload_2;
extern IsoAgLib::iVtObjectOutputString_c iVtObjectopsWS1;
extern IsoAgLib::iVtObjectOutputString_c iVtObjectopsWS2;
extern IsoAgLib::iVtObjectContainer_c iVtObjectcontainerInAllMasks_2;
extern IsoAgLib::iVtObjectRectangle_c iVtObjectrect1;
extern IsoAgLib::iVtObjectPictureGraphic_c iVtObjectBigLogo_2;
extern IsoAgLib::iVtObjectLine_c iVtObjectleine_2;
extern IsoAgLib::iVtObjectOutputString_c iVtObjectOutStrLang;
extern IsoAgLib::iVtObjectOutputString_c iVtObjectOutStrLang_2;
extern IsoAgLib::iVtObjectOutputString_c iVtObjectOutStrLang_1;
extern IsoAgLib::iVtObjectNumberVariable_c iVtObjectVarOutNumVal;
extern IsoAgLib::iVtObjectOutputNumber_c iVtObjectOutNumVal;
extern IsoAgLib::iVtObjectInputString_c iVtObjectInpString;
extern IsoAgLib::iVtObjectInputNumber_c iVtObjectInpNumVal;
extern IsoAgLib::iVtObjectOutputNumber_c iVtObjectfrstLstElem;
extern IsoAgLib::iVtObjectOutputNumber_c iVtObjectscndLstElem;
extern IsoAgLib::iVtObjectOutputNumber_c iVtObjectthrdLstElem;
extern IsoAgLib::iVtObjectOutputNumber_c iVtObjectfrthLstElem;
extern IsoAgLib::iVtObjectInputList_c iVtObjectInputNumList;
extern IsoAgLib::iVtObjectButton_c iVtObjectBtn1;
extern IsoAgLib::iVtObjectOutputString_c iVtObjectbtn1;
extern IsoAgLib::iVtObjectButton_c iVtObjectBtn2;
extern IsoAgLib::iVtObjectOutputString_c iVtObjectbtn2;
extern IsoAgLib::iVtObjectButton_c iVtObjectBtn3;
extern IsoAgLib::iVtObjectOutputString_c iVtObjectbtn3;
extern IsoAgLib::iVtObjectKey_c iVtObjectKeyReset_2;
extern IsoAgLib::iVtObjectOutputString_c iVtObjectOutStrSoftKey;
extern IsoAgLib::iVtObjectOutputString_c iVtObjectOutStrSoftKey_1;
extern IsoAgLib::iVtObjectOutputString_c iVtObjectOutStrSoftKey_2;
extern IsoAgLib::iVtObjectKey_c iVtObjectKeyMove_2;
extern IsoAgLib::iVtObjectOutputString_c iVtObjectops1;
extern IsoAgLib::iVtObjectKey_c iVtObjectKeyLogo_2;
extern IsoAgLib::iVtObjectOutputString_c iVtObjectops2;
extern IsoAgLib::iVtObjectKey_c iVtObjectKeyChangeLang_2;
extern IsoAgLib::iVtObjectOutputString_c iVtObjectops3;
extern IsoAgLib::iVtObjectKey_c iVtObjectKeyChangeCol_2;
extern IsoAgLib::iVtObjectOutputString_c iVtObjectops4;
extern IsoAgLib::iVtObjectOutputString_c iVtObjectops5;
extern IsoAgLib::iVtObjectKey_c iVtObjectKeyForbidden_2;
extern IsoAgLib::iVtObjectOutputString_c iVtObjectops6;
extern IsoAgLib::iVtObjectKey_c iVtObjectKeyChangeMask_2;
extern IsoAgLib::iVtObjectOutputString_c iVtObjectops7;
extern IsoAgLib::iVtObjectButton_c iVtObjectKeyBackMask;
extern IsoAgLib::iVtObjectOutputString_c iVtObjectops8;
extern IsoAgLib::iVtObjectButton_c iVtObjectKeyNextMask;
extern IsoAgLib::iVtObjectOutputString_c iVtObjectops9;
extern IsoAgLib::iVtObjectEllipse_c iVtObjectdEllipse_2;
extern IsoAgLib::iVtObjectPolygon_c iVtObjectdPolygon_2;
extern IsoAgLib::iVtObjectDataMask_c iVtObjectMainMask_2;
extern IsoAgLib::iVtObjectContainer_c iVtObjectmask1contentscontainer_2;
extern IsoAgLib::iVtObjectOutputString_c iVtObjectops10;
extern IsoAgLib::iVtObjectOutputString_c iVtObjectops11;
extern IsoAgLib::iVtObjectOutputString_c iVtObjectops12;
extern IsoAgLib::iVtObjectOutputString_c iVtObjectops13;
extern IsoAgLib::iVtObjectOutputString_c iVtObjectops14;
extern IsoAgLib::iVtObjectOutputString_c iVtObjectops15;
extern IsoAgLib::iVtObjectObjectPointer_c iVtObjectOutNumPtr;
extern IsoAgLib::iVtObjectObjectPointer_c iVtObjectInputListptr;
extern IsoAgLib::iVtObjectArchedBarGraph_c iVtObjectAccelArchedBarGraph_2;
extern IsoAgLib::iVtObjectOutputString_c iVtObjectOpsFakeMileage_2;
extern IsoAgLib::iVtObjectObjectPointer_c iVtObjectChangeAwayPointer_2;
extern IsoAgLib::iVtObjectRectangle_c iVtObjectrect2;
extern IsoAgLib::iVtObjectInputBoolean_c iVtObjectInputLikeage_2;
extern IsoAgLib::iVtObjectObjectPointer_c iVtObjectLikeageOP_2;
extern IsoAgLib::iVtObjectSoftKeyMask_c iVtObjectsoftkeys1_2;
extern IsoAgLib::iVtObjectDataMask_c iVtObjectAnotherMask_2;
extern IsoAgLib::iVtObjectOutputString_c iVtObjectops16;
extern IsoAgLib::iVtObjectOutputString_c iVtObjectops17;
extern IsoAgLib::iVtObjectOutputString_c iVtObjectops18;
extern IsoAgLib::iVtObjectOutputString_c iVtObjectops19;
extern IsoAgLib::iVtObjectOutputString_c iVtObjectops20;
extern IsoAgLib::iVtObjectOutputString_c iVtObjectops21;
extern IsoAgLib::iVtObjectOutputString_c iVtObjectops22;
extern IsoAgLib::iVtObjectSoftKeyMask_c iVtObjectsoftkeys2_2;
extern IsoAgLib::iVtObjectDataMask_c iVtObjectLastMask;
extern IsoAgLib::iVtObjectSoftKeyMask_c iVtObjectsoftkeys3;
extern IsoAgLib::iVtObjectAlarmMask_c iVtObjectForbiddenAlarmMask_2;
extern IsoAgLib::iVtObjectContainer_c iVtObjectalarm1contentscontainer_2;
extern IsoAgLib::iVtObjectOutputString_c iVtObjectops23;
extern IsoAgLib::iVtObjectOutputString_c iVtObjectops24;
extern IsoAgLib::iVtObjectOutputString_c iVtObjectops25;
extern IsoAgLib::iVtObjectFontAttributes_c iVtObjectFontAttributesNormal6x8_2;
extern IsoAgLib::iVtObjectFontAttributes_c iVtObjectFontAttributes_2_Normal6x8LangDep;
extern IsoAgLib::iVtObjectFontAttributes_c iVtObjectFontAttributes_2_Normal6x8LangDep_1;
extern IsoAgLib::iVtObjectFontAttributes_c iVtObjectFontAttributes_2_Normal6x8LangDep_2;
extern IsoAgLib::iVtObjectFillAttributes_c iVtObjectFillAttrib;
extern IsoAgLib::iVtObjectFillAttributes_c iVtObjectFillAttributes_2;
extern IsoAgLib::iVtObjectFontAttributes_c iVtObjectFontAttributesNormal8x12_2;
extern IsoAgLib::iVtObjectFontAttributes_c iVtObjectFontAttributesNormal6x8R_2;
extern IsoAgLib::iVtObjectFontAttributes_c iVtObjectFontAttributesNormal6x8B_2;
extern IsoAgLib::iVtObjectFontAttributes_c iVtObjectFontAttributesNormal8x8_2;
extern IsoAgLib::iVtObjectFontAttributes_c iVtObjectFontAttributesNormal12x16_2;
extern IsoAgLib::iVtObjectFontAttributes_c iVtObjectFontAttributesNormal16x16_2;
extern IsoAgLib::iVtObjectFontAttributes_c iVtObjectFontAttributesNormal16x24_2;
extern IsoAgLib::iVtObjectFontAttributes_c iVtObjectFontAttributesNormal24x32_2;
extern IsoAgLib::iVtObjectLineAttributes_c iVtObjectLineAttributes_Normal_2;
extern IsoAgLib::iVtObjectLineAttributes_c iVtObjectLineAttributesNormal_2;
extern IsoAgLib::iVtObjectLineAttributes_c iVtObjectLineAttributesDotted_2;
extern IsoAgLib::iVtObjectFontAttributes_c iVtObjectFontAttributesSKM6x8_2;
extern IsoAgLib::iVtObjectFontAttributes_c iVtObjectFontAttributesSKM8x8_2;
extern IsoAgLib::iVtObjectFontAttributes_c iVtObjectFontAttributesSKM12x16_2;
extern IsoAgLib::iVtObjectLineAttributes_c iVtObjectLineAttributesSKM_2;
extern IsoAgLib::iVtObjectFontAttributes_c iVtObjectFontAttributesNormal6x8_Button60x30_2;
