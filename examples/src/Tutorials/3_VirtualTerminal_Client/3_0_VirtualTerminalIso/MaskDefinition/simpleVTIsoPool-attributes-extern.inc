extern const IsoAgLib::iVtObject_c::iVtObjectWorkingSet_s iVtObjectimiIsoMaskupload_sROM;
extern const IsoAgLib::iVtObject_c::iVtObjectOutputString_s iVtObjectUnnamed1_sROM;
extern const IsoAgLib::iVtObject_c::iVtObjectOutputString_s iVtObjectUnnamed2_sROM;
extern const IsoAgLib::iVtObject_c::iVtObjectFontAttributes_s iVtObjectFontAttributesNormal6x8_sROM;
extern const IsoAgLib::iVtObject_c::iVtObjectFontAttributes_s iVtObjectFontAttributesNormal6x8LangDep_sROM;
extern const IsoAgLib::iVtObject_c::iVtObjectFontAttributes_s iVtObjectFontAttributesNormal6x8LangDep_1_sROM;
extern const IsoAgLib::iVtObject_c::iVtObjectFontAttributes_s iVtObjectFontAttributesNormal6x8LangDep_2_sROM;
extern const IsoAgLib::iVtObject_c::iVtObjectFontAttributes_s iVtObjectFontAttributesNormal8x12_sROM;
extern const IsoAgLib::iVtObject_c::iVtObjectFontAttributes_s iVtObjectFontAttributesNormal6x8R_sROM;
extern const IsoAgLib::iVtObject_c::iVtObjectFontAttributes_s iVtObjectFontAttributesNormal6x8B_sROM;
extern const IsoAgLib::iVtObject_c::iVtObjectFontAttributes_s iVtObjectFontAttributesNormal8x8_sROM;
extern const IsoAgLib::iVtObject_c::iVtObjectFontAttributes_s iVtObjectFontAttributesNormal12x16_sROM;
extern const IsoAgLib::iVtObject_c::iVtObjectFontAttributes_s iVtObjectFontAttributesNormal16x16_sROM;
extern const IsoAgLib::iVtObject_c::iVtObjectFontAttributes_s iVtObjectFontAttributesNormal16x24_sROM;
extern const IsoAgLib::iVtObject_c::iVtObjectFontAttributes_s iVtObjectFontAttributesNormal24x32_sROM;
extern const IsoAgLib::iVtObject_c::iVtObjectLineAttributes_s iVtObjectLineAttributesNormal_sROM;
extern const IsoAgLib::iVtObject_c::iVtObjectLineAttributes_s iVtObjectLineAttributesDotted_sROM;
extern const IsoAgLib::iVtObject_c::iVtObjectFontAttributes_s iVtObjectFontAttributesSKM6x8_sROM;
extern const IsoAgLib::iVtObject_c::iVtObjectFontAttributes_s iVtObjectFontAttributesSKM8x8_sROM;
extern const IsoAgLib::iVtObject_c::iVtObjectFontAttributes_s iVtObjectFontAttributesSKM12x16_sROM;
extern const IsoAgLib::iVtObject_c::iVtObjectLineAttributes_s iVtObjectLineAttributesSKM_sROM;
extern const IsoAgLib::iVtObject_c::iVtObjectFontAttributes_s iVtObjectFontAttributesNormal6x8_Button60x30_sROM;
extern const IsoAgLib::iVtObject_c::iVtObjectNumberVariable_s iVtObjectValSpeed_sROM;
extern const IsoAgLib::iVtObject_c::iVtObjectNumberVariable_s iVtObjectValAccel_sROM;
extern const IsoAgLib::iVtObject_c::iVtObjectNumberVariable_s iVtObjectValMiles_sROM;
extern const IsoAgLib::iVtObject_c::iVtObjectStringVariable_s iVtObjectStrNone_sROM;
extern const IsoAgLib::iVtObject_c::iVtObjectStringVariable_s iVtObjectStrNone_1_sROM;
extern const IsoAgLib::iVtObject_c::iVtObjectStringVariable_s iVtObjectStrNone_2_sROM;
extern const IsoAgLib::iVtObject_c::iVtObjectStringVariable_s iVtObjectStrRed_sROM;
extern const IsoAgLib::iVtObject_c::iVtObjectStringVariable_s iVtObjectStrRed_1_sROM;
extern const IsoAgLib::iVtObject_c::iVtObjectStringVariable_s iVtObjectStrRed_2_sROM;
extern const IsoAgLib::iVtObject_c::iVtObjectStringVariable_s iVtObjectStrGreen_sROM;
extern const IsoAgLib::iVtObject_c::iVtObjectStringVariable_s iVtObjectStrGreen_1_sROM;
extern const IsoAgLib::iVtObject_c::iVtObjectStringVariable_s iVtObjectStrGreen_2_sROM;
extern const IsoAgLib::iVtObject_c::iVtObjectStringVariable_s iVtObjectStrBlue_sROM;
extern const IsoAgLib::iVtObject_c::iVtObjectStringVariable_s iVtObjectStrBlue_1_sROM;
extern const IsoAgLib::iVtObject_c::iVtObjectStringVariable_s iVtObjectStrBlue_2_sROM;
extern const IsoAgLib::iVtObject_c::iVtObjectStringVariable_s iVtObjectStrYellow_sROM;
extern const IsoAgLib::iVtObject_c::iVtObjectStringVariable_s iVtObjectStrCyan_sROM;
extern const IsoAgLib::iVtObject_c::iVtObjectStringVariable_s iVtObjectStrMagenta_sROM;
extern const IsoAgLib::iVtObject_c::iVtObjectStringVariable_s iVtObjectStrBlack_sROM;
extern const IsoAgLib::iVtObject_c::iVtObjectStringVariable_s iVtObjectStrWhite_sROM;
extern const IsoAgLib::iVtObject_c::iVtObjectOutputString_s iVtObjectLikeIt_sROM;
extern const IsoAgLib::iVtObject_c::iVtObjectOutputString_s iVtObjectLikeItNot_sROM;
extern const IsoAgLib::iVtObject_c::iVtObjectContainer_s iVtObjectcontainerInAllMasks_sROM;
extern const IsoAgLib::iVtObject_c::iVtObjectRectangle_s iVtObjectUnnamed3_sROM;
extern const IsoAgLib::iVtObject_c::iVtObjectPictureGraphic_s iVtObjectBigLogo_sROM;
extern const IsoAgLib::iVtObject_c::iVtObjectLine_s iVtObjectleine_sROM;
extern const IsoAgLib::iVtObject_c::iVtObjectKey_s iVtObjectKeyReset_sROM;
extern const IsoAgLib::iVtObject_c::iVtObjectOutputString_s iVtObjectresetTextOS_sROM;
extern const IsoAgLib::iVtObject_c::iVtObjectOutputString_s iVtObjectresetTextOS_1_sROM;
extern const IsoAgLib::iVtObject_c::iVtObjectOutputString_s iVtObjectresetTextOS_2_sROM;
extern const IsoAgLib::iVtObject_c::iVtObjectInputNumber_s iVtObjectInputMiles_sROM;
extern const IsoAgLib::iVtObject_c::iVtObjectDataMask_s iVtObjectMainMask_sROM;
extern const IsoAgLib::iVtObject_c::iVtObjectContainer_s iVtObjectmask1contentscontainer_sROM;
extern const IsoAgLib::iVtObject_c::iVtObjectOutputString_s iVtObjectUnnamed4_sROM;
extern const IsoAgLib::iVtObject_c::iVtObjectOutputString_s iVtObjectspeedLabel_sROM;
extern const IsoAgLib::iVtObject_c::iVtObjectOutputString_s iVtObjectUnnamed5_sROM;
extern const IsoAgLib::iVtObject_c::iVtObjectOutputNumber_s iVtObjectUnnamed6_sROM;
extern const IsoAgLib::iVtObject_c::iVtObjectOutputNumber_s iVtObjectUnnamed7_sROM;
extern const IsoAgLib::iVtObject_c::iVtObjectOutputNumber_s iVtObjectUnnamed8_sROM;
extern const IsoAgLib::iVtObject_c::iVtObjectLinearBarGraph_s iVtObjectUnnamed9_sROM;
extern const IsoAgLib::iVtObject_c::iVtObjectOutputString_s iVtObjectColLabel_sROM;
extern const IsoAgLib::iVtObject_c::iVtObjectOutputString_s iVtObjectColOS_sROM;
extern const IsoAgLib::iVtObject_c::iVtObjectArchedBarGraph_s iVtObjectAccelArchedBarGraph_sROM;
extern const IsoAgLib::iVtObject_c::iVtObjectOutputString_s iVtObjectOpsFakeMileage_sROM;
extern const IsoAgLib::iVtObject_c::iVtObjectObjectPointer_s iVtObjectChangeAwayPointer_sROM;
extern const IsoAgLib::iVtObject_c::iVtObjectInputList_s iVtObjectInputListTypFakeMiles_sROM;
extern const IsoAgLib::iVtObject_c::iVtObjectOutputNumber_s iVtObjectUnnamed12_sROM;
extern const IsoAgLib::iVtObject_c::iVtObjectOutputNumber_s iVtObjectUnnamed13_sROM;
extern const IsoAgLib::iVtObject_c::iVtObjectOutputNumber_s iVtObjectUnnamed14_sROM;
extern const IsoAgLib::iVtObject_c::iVtObjectOutputNumber_s iVtObjectUnnamed15_sROM;
extern const IsoAgLib::iVtObject_c::iVtObjectOutputString_s iVtObjectUnnamed10_sROM;
extern const IsoAgLib::iVtObject_c::iVtObjectRectangle_s iVtObjectUnnamed11_sROM;
extern const IsoAgLib::iVtObject_c::iVtObjectInputBoolean_s iVtObjectInputLikeage_sROM;
extern const IsoAgLib::iVtObject_c::iVtObjectObjectPointer_s iVtObjectLikeageOP_sROM;
extern const IsoAgLib::iVtObject_c::iVtObjectButton_s iVtObjectKeyMoreAccel_sROM;
extern const IsoAgLib::iVtObject_c::iVtObjectOutputString_s iVtObjectUnnamed16_sROM;
extern const IsoAgLib::iVtObject_c::iVtObjectButton_s iVtObjectKeyLessAccel_sROM;
extern const IsoAgLib::iVtObject_c::iVtObjectOutputString_s iVtObjectUnnamed17_sROM;
extern const IsoAgLib::iVtObject_c::iVtObjectOutputString_s iVtObjectvtLang_sROM;
extern const IsoAgLib::iVtObject_c::iVtObjectOutputString_s iVtObjectOSlanguage_sROM;
extern const IsoAgLib::iVtObject_c::iVtObjectOutputString_s iVtObjectdriver_sROM;
extern const IsoAgLib::iVtObject_c::iVtObjectOutputString_s iVtObjectresonible_sROM;
extern const IsoAgLib::iVtObject_c::iVtObjectInputString_s iVtObjectISdriver_sROM;
extern const IsoAgLib::iVtObject_c::iVtObjectOutputString_s iVtObjectOSresonible_sROM;
extern const IsoAgLib::iVtObject_c::iVtObjectSoftKeyMask_s iVtObjectsoftkeys1_sROM;
extern const IsoAgLib::iVtObject_c::iVtObjectKey_s iVtObjectKeyMove_sROM;
extern const IsoAgLib::iVtObject_c::iVtObjectOutputString_s iVtObjectUnnamed18_sROM;
extern const IsoAgLib::iVtObject_c::iVtObjectKey_s iVtObjectKeyLogo_sROM;
extern const IsoAgLib::iVtObject_c::iVtObjectOutputString_s iVtObjectUnnamed19_sROM;
extern const IsoAgLib::iVtObject_c::iVtObjectKey_s iVtObjectKeyChangeLang_sROM;
extern const IsoAgLib::iVtObject_c::iVtObjectOutputString_s iVtObjectUnnamed20_sROM;
extern const IsoAgLib::iVtObject_c::iVtObjectKey_s iVtObjectKeyChangeCol_sROM;
extern const IsoAgLib::iVtObject_c::iVtObjectOutputString_s iVtObjectUnnamed21_sROM;
extern const IsoAgLib::iVtObject_c::iVtObjectOutputString_s iVtObjectUnnamed22_sROM;
extern const IsoAgLib::iVtObject_c::iVtObjectKey_s iVtObjectKeyTransCol_sROM;
extern const IsoAgLib::iVtObject_c::iVtObjectOutputString_s iVtObjectUnnamed23_sROM;
extern const IsoAgLib::iVtObject_c::iVtObjectOutputString_s iVtObjectUnnamed24_sROM;
extern const IsoAgLib::iVtObject_c::iVtObjectKey_s iVtObjectKeyForbidden_sROM;
extern const IsoAgLib::iVtObject_c::iVtObjectOutputString_s iVtObjectUnnamed25_sROM;
extern const IsoAgLib::iVtObject_c::iVtObjectKey_s iVtObjectKeyChangeFill_sROM;
extern const IsoAgLib::iVtObject_c::iVtObjectOutputString_s iVtObjectUnnamed26_sROM;
extern const IsoAgLib::iVtObject_c::iVtObjectKey_s iVtObjectKeyUpdatePool_sROM;
extern const IsoAgLib::iVtObject_c::iVtObjectOutputString_s iVtObjectUnnamed27_sROM;
extern const IsoAgLib::iVtObject_c::iVtObjectKey_s iVtObjectKeyChangeLogoPosition_sROM;
extern const IsoAgLib::iVtObject_c::iVtObjectOutputString_s iVtObjectUnnamed28_sROM;
extern const IsoAgLib::iVtObject_c::iVtObjectLineAttributes_s iVtObjectLineAttributes_Normal_sROM;
extern const IsoAgLib::iVtObject_c::iVtObjectFillAttributes_s iVtObjectFillAttributes_sROM;
extern const IsoAgLib::iVtObject_c::iVtObjectEllipse_s iVtObjectdEllipse_sROM;
extern const IsoAgLib::iVtObject_c::iVtObjectPolygon_s iVtObjectdPolygon_sROM;
extern const IsoAgLib::iVtObject_c::iVtObjectMeter_s iVtObjectdMeter_sROM;
extern const IsoAgLib::iVtObject_c::iVtObjectMacro_s iVtObjectMacro_1_sROM;
extern const IsoAgLib::iVtObject_c::iVtObjectMacro_s iVtObjectMacro_2_sROM;
extern const IsoAgLib::iVtObject_c::iVtObjectDataMask_s iVtObjectAnotherMask_sROM;
extern const IsoAgLib::iVtObject_c::iVtObjectOutputString_s iVtObjectUnnamed29_sROM;
extern const IsoAgLib::iVtObject_c::iVtObjectOutputString_s iVtObjectUnnamed30_sROM;
extern const IsoAgLib::iVtObject_c::iVtObjectOutputString_s iVtObjectUnnamed31_sROM;
extern const IsoAgLib::iVtObject_c::iVtObjectOutputString_s iVtObjectUnnamed32_sROM;
extern const IsoAgLib::iVtObject_c::iVtObjectOutputString_s iVtObjectUnnamed33_sROM;
extern const IsoAgLib::iVtObject_c::iVtObjectOutputString_s iVtObjectUnnamed34_sROM;
extern const IsoAgLib::iVtObject_c::iVtObjectOutputString_s iVtObjectUnnamed35_sROM;
extern const IsoAgLib::iVtObject_c::iVtObjectAlarmMask_s iVtObjectForbiddenAlarmMask_sROM;
extern const IsoAgLib::iVtObject_c::iVtObjectContainer_s iVtObjectalarm1contentscontainer_sROM;
extern const IsoAgLib::iVtObject_c::iVtObjectOutputString_s iVtObjectUnnamed36_sROM;
extern const IsoAgLib::iVtObject_c::iVtObjectOutputString_s iVtObjectUnnamed37_sROM;
extern const IsoAgLib::iVtObject_c::iVtObjectOutputString_s iVtObjectUnnamed38_sROM;
extern const IsoAgLib::iVtObject_c::iVtObjectSoftKeyMask_s iVtObjectsoftkeysAlarm_sROM;
