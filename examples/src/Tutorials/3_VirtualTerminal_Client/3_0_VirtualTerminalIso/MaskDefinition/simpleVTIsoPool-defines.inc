static const unsigned int iVtObjectIDimiIsoMaskupload = 65534;
static const unsigned int iVtObjectIDUnnamed1 = 65533;
static const unsigned int iVtObjectIDUnnamed2 = 65532;
static const unsigned int iVtObjectIDFontAttributesNormal6x8 = 65531;
static const unsigned int iVtObjectIDFontAttributesNormal6x8LangDep = 65530;
static const unsigned int iVtObjectIDFontAttributesNormal6x8LangDep_1 = 65530;
static const unsigned int iVtObjectIDFontAttributesNormal6x8LangDep_2 = 65530;
static const unsigned int iVtObjectIDFontAttributesNormal8x12 = 65529;
static const unsigned int iVtObjectIDFontAttributesNormal6x8R = 65528;
static const unsigned int iVtObjectIDFontAttributesNormal6x8B = 65527;
static const unsigned int iVtObjectIDFontAttributesNormal8x8 = 65526;
static const unsigned int iVtObjectIDFontAttributesNormal12x16 = 65525;
static const unsigned int iVtObjectIDFontAttributesNormal16x16 = 65524;
static const unsigned int iVtObjectIDFontAttributesNormal16x24 = 65523;
static const unsigned int iVtObjectIDFontAttributesNormal24x32 = 65522;
static const unsigned int iVtObjectIDLineAttributesNormal = 65521;
static const unsigned int iVtObjectIDLineAttributesDotted = 65520;
static const unsigned int iVtObjectIDFontAttributesSKM6x8 = 65519;
static const unsigned int iVtObjectIDFontAttributesSKM8x8 = 65518;
static const unsigned int iVtObjectIDFontAttributesSKM12x16 = 65517;
static const unsigned int iVtObjectIDLineAttributesSKM = 65516;
static const unsigned int iVtObjectIDFontAttributesNormal6x8_Button60x30 = 65515;
static const unsigned int iVtObjectIDValSpeed = 65514;
static const unsigned int iVtObjectIDValAccel = 65513;
static const unsigned int iVtObjectIDValMiles = 1234;
static const unsigned int iVtObjectIDStrNone = 65512;
static const unsigned int iVtObjectIDStrNone_1 = 65512;
static const unsigned int iVtObjectIDStrNone_2 = 65512;
static const unsigned int iVtObjectIDStrRed = 65511;
static const unsigned int iVtObjectIDStrRed_1 = 65511;
static const unsigned int iVtObjectIDStrRed_2 = 65511;
static const unsigned int iVtObjectIDStrGreen = 65510;
static const unsigned int iVtObjectIDStrGreen_1 = 65510;
static const unsigned int iVtObjectIDStrGreen_2 = 65510;
static const unsigned int iVtObjectIDStrBlue = 65509;
static const unsigned int iVtObjectIDStrBlue_1 = 65509;
static const unsigned int iVtObjectIDStrBlue_2 = 65509;
static const unsigned int iVtObjectIDStrYellow = 65508;
static const unsigned int iVtObjectIDStrCyan = 65507;
static const unsigned int iVtObjectIDStrMagenta = 65506;
static const unsigned int iVtObjectIDStrBlack = 65505;
static const unsigned int iVtObjectIDStrWhite = 65504;
static const unsigned int iVtObjectIDLikeIt = 65503;
static const unsigned int iVtObjectIDLikeItNot = 65502;
static const unsigned int iVtObjectIDcontainerInAllMasks = 65501;
static const unsigned int iVtObjectIDUnnamed3 = 65500;
static const unsigned int iVtObjectIDBigLogo = 65499;
static const unsigned int iVtObjectIDleine = 65498;
static const unsigned int iVtObjectIDKeyReset = 65497;
static const unsigned int vtKeyCodeKeyReset = 254;
static const unsigned int iVtObjectIDresetTextOS = 65496;
static const unsigned int iVtObjectIDresetTextOS_1 = 65496;
static const unsigned int iVtObjectIDresetTextOS_2 = 65496;
static const unsigned int iVtObjectIDInputMiles = 65495;
static const unsigned int iVtObjectIDMainMask = 1101;
static const unsigned int iVtObjectIDmask1contentscontainer = 65494;
static const unsigned int iVtObjectIDUnnamed4 = 65493;
static const unsigned int iVtObjectIDspeedLabel = 65492;
static const unsigned int iVtObjectIDUnnamed5 = 65491;
static const unsigned int iVtObjectIDUnnamed6 = 65490;
static const unsigned int iVtObjectIDUnnamed7 = 65489;
static const unsigned int iVtObjectIDUnnamed8 = 65488;
static const unsigned int iVtObjectIDUnnamed9 = 65487;
static const unsigned int iVtObjectIDColLabel = 65486;
static const unsigned int iVtObjectIDColOS = 65485;
static const unsigned int iVtObjectIDAccelArchedBarGraph = 65484;
static const unsigned int iVtObjectIDOpsFakeMileage = 65483;
static const unsigned int iVtObjectIDChangeAwayPointer = 65482;
static const unsigned int iVtObjectIDInputListTypFakeMiles = 65481;
static const unsigned int iVtObjectIDUnnamed12 = 65480;
static const unsigned int iVtObjectIDUnnamed13 = 65479;
static const unsigned int iVtObjectIDUnnamed14 = 65478;
static const unsigned int iVtObjectIDUnnamed15 = 65477;
static const unsigned int iVtObjectIDUnnamed10 = 65476;
static const unsigned int iVtObjectIDUnnamed11 = 65475;
static const unsigned int iVtObjectIDInputLikeage = 65474;
static const unsigned int iVtObjectIDLikeageOP = 65473;
static const unsigned int iVtObjectIDKeyMoreAccel = 65472;
static const unsigned int vtKeyCodeKeyMoreAccel =  253;
static const unsigned int iVtObjectIDUnnamed16 = 65471;
static const unsigned int iVtObjectIDKeyLessAccel = 65470;
static const unsigned int vtKeyCodeKeyLessAccel =  252;
static const unsigned int iVtObjectIDUnnamed17 = 65469;
static const unsigned int iVtObjectIDvtLang = 65468;
static const unsigned int iVtObjectIDOSlanguage = 65467;
static const unsigned int iVtObjectIDdriver = 65466;
static const unsigned int iVtObjectIDresonible = 65465;
static const unsigned int iVtObjectIDISdriver = 65464;
static const unsigned int iVtObjectIDOSresonible = 65463;
static const unsigned int iVtObjectIDsoftkeys1 = 65462;
static const unsigned int iVtObjectIDKeyMove = 65461;
static const unsigned int vtKeyCodeKeyMove = 251;
static const unsigned int iVtObjectIDUnnamed18 = 65460;
static const unsigned int iVtObjectIDKeyLogo = 65459;
static const unsigned int vtKeyCodeKeyLogo = 250;
static const unsigned int iVtObjectIDUnnamed19 = 65458;
static const unsigned int iVtObjectIDKeyChangeLang = 65457;
static const unsigned int vtKeyCodeKeyChangeLang = 249;
static const unsigned int iVtObjectIDUnnamed20 = 65456;
static const unsigned int iVtObjectIDKeyChangeCol = 65455;
static const unsigned int vtKeyCodeKeyChangeCol = 248;
static const unsigned int iVtObjectIDUnnamed21 = 65454;
static const unsigned int iVtObjectIDUnnamed22 = 65453;
static const unsigned int iVtObjectIDKeyTransCol = 65452;
static const unsigned int vtKeyCodeKeyTransCol = 247;
static const unsigned int iVtObjectIDUnnamed23 = 65451;
static const unsigned int iVtObjectIDUnnamed24 = 65450;
static const unsigned int iVtObjectIDKeyForbidden = 65449;
static const unsigned int vtKeyCodeKeyForbidden = 246;
static const unsigned int iVtObjectIDUnnamed25 = 65448;
static const unsigned int iVtObjectIDKeyChangeFill = 65447;
static const unsigned int vtKeyCodeKeyChangeFill = 245;
static const unsigned int iVtObjectIDUnnamed26 = 65446;
static const unsigned int iVtObjectIDKeyUpdatePool = 65445;
static const unsigned int vtKeyCodeKeyUpdatePool = 244;
static const unsigned int iVtObjectIDUnnamed27 = 65444;
static const unsigned int iVtObjectIDKeyChangeLogoPosition = 65443;
static const unsigned int vtKeyCodeKeyChangeLogoPosition = 243;
static const unsigned int iVtObjectIDUnnamed28 = 65442;
static const unsigned int iVtObjectIDLineAttributes_Normal = 65441;
static const unsigned int iVtObjectIDFillAttributes = 65440;
static const unsigned int iVtObjectIDdEllipse = 65439;
static const unsigned int iVtObjectIDdPolygon = 65438;
static const unsigned int iVtObjectIDdMeter = 65437;
static const unsigned int iVtObjectIDMacro_1 = 1;
static const unsigned int iVtObjectIDMacro_2 = 2;
static const unsigned int iVtObjectIDAnotherMask = 65436;
static const unsigned int iVtObjectIDUnnamed29 = 65435;
static const unsigned int iVtObjectIDUnnamed30 = 65434;
static const unsigned int iVtObjectIDUnnamed31 = 65433;
static const unsigned int iVtObjectIDUnnamed32 = 65432;
static const unsigned int iVtObjectIDUnnamed33 = 65431;
static const unsigned int iVtObjectIDUnnamed34 = 65430;
static const unsigned int iVtObjectIDUnnamed35 = 65429;
static const unsigned int iVtObjectIDForbiddenAlarmMask = 65428;
static const unsigned int iVtObjectIDalarm1contentscontainer = 65427;
static const unsigned int iVtObjectIDUnnamed36 = 65426;
static const unsigned int iVtObjectIDUnnamed37 = 65425;
static const unsigned int iVtObjectIDUnnamed38 = 65424;
static const unsigned int iVtObjectIDsoftkeysAlarm = 65423;
static const unsigned int vtObjectPoolDimension = 200;
static const unsigned int vtObjectPoolSoftKeyWidth = 60;
static const unsigned int vtObjectPoolSoftKeyHeight = 32;

static const unsigned int vtKeyCodeACK = 0;
