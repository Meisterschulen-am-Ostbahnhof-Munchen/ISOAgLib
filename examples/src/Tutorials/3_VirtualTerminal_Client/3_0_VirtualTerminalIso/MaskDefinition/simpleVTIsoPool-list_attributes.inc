IsoAgLib::iVtObject_c::iVtObject_s* HUGE_MEM all_sROMs [] = {
 (IsoAgLib::iVtObject_c::iVtObject_s*)&iVtObjectimiIsoMaskupload_sROM,
 (IsoAgLib::iVtObject_c::iVtObject_s*)&iVtObjectMacro_1_sROM,
 (IsoAgLib::iVtObject_c::iVtObject_s*)&iVtObjectMacro_2_sROM,
 (IsoAgLib::iVtObject_c::iVtObject_s*)&iVtObjectMainMask_sROM,
 (IsoAgLib::iVtObject_c::iVtObject_s*)&iVtObjectValMiles_sROM,
 (IsoAgLib::iVtObject_c::iVtObject_s*)&iVtObjectsoftkeysAlarm_sROM,
 (IsoAgLib::iVtObject_c::iVtObject_s*)&iVtObjectUnnamed38_sROM,
 (IsoAgLib::iVtObject_c::iVtObject_s*)&iVtObjectUnnamed37_sROM,
 (IsoAgLib::iVtObject_c::iVtObject_s*)&iVtObjectUnnamed36_sROM,
 (IsoAgLib::iVtObject_c::iVtObject_s*)&iVtObjectalarm1contentscontainer_sROM,
 (IsoAgLib::iVtObject_c::iVtObject_s*)&iVtObjectForbiddenAlarmMask_sROM,
 (IsoAgLib::iVtObject_c::iVtObject_s*)&iVtObjectUnnamed35_sROM,
 (IsoAgLib::iVtObject_c::iVtObject_s*)&iVtObjectUnnamed34_sROM,
 (IsoAgLib::iVtObject_c::iVtObject_s*)&iVtObjectUnnamed33_sROM,
 (IsoAgLib::iVtObject_c::iVtObject_s*)&iVtObjectUnnamed32_sROM,
 (IsoAgLib::iVtObject_c::iVtObject_s*)&iVtObjectUnnamed31_sROM,
 (IsoAgLib::iVtObject_c::iVtObject_s*)&iVtObjectUnnamed30_sROM,
 (IsoAgLib::iVtObject_c::iVtObject_s*)&iVtObjectUnnamed29_sROM,
 (IsoAgLib::iVtObject_c::iVtObject_s*)&iVtObjectAnotherMask_sROM,
 (IsoAgLib::iVtObject_c::iVtObject_s*)&iVtObjectdMeter_sROM,
 (IsoAgLib::iVtObject_c::iVtObject_s*)&iVtObjectdPolygon_sROM,
 (IsoAgLib::iVtObject_c::iVtObject_s*)&iVtObjectdEllipse_sROM,
 (IsoAgLib::iVtObject_c::iVtObject_s*)&iVtObjectFillAttributes_sROM,
 (IsoAgLib::iVtObject_c::iVtObject_s*)&iVtObjectLineAttributes_Normal_sROM,
 (IsoAgLib::iVtObject_c::iVtObject_s*)&iVtObjectUnnamed28_sROM,
 (IsoAgLib::iVtObject_c::iVtObject_s*)&iVtObjectKeyChangeLogoPosition_sROM,
 (IsoAgLib::iVtObject_c::iVtObject_s*)&iVtObjectUnnamed27_sROM,
 (IsoAgLib::iVtObject_c::iVtObject_s*)&iVtObjectKeyUpdatePool_sROM,
 (IsoAgLib::iVtObject_c::iVtObject_s*)&iVtObjectUnnamed26_sROM,
 (IsoAgLib::iVtObject_c::iVtObject_s*)&iVtObjectKeyChangeFill_sROM,
 (IsoAgLib::iVtObject_c::iVtObject_s*)&iVtObjectUnnamed25_sROM,
 (IsoAgLib::iVtObject_c::iVtObject_s*)&iVtObjectKeyForbidden_sROM,
 (IsoAgLib::iVtObject_c::iVtObject_s*)&iVtObjectUnnamed24_sROM,
 (IsoAgLib::iVtObject_c::iVtObject_s*)&iVtObjectUnnamed23_sROM,
 (IsoAgLib::iVtObject_c::iVtObject_s*)&iVtObjectKeyTransCol_sROM,
 (IsoAgLib::iVtObject_c::iVtObject_s*)&iVtObjectUnnamed22_sROM,
 (IsoAgLib::iVtObject_c::iVtObject_s*)&iVtObjectUnnamed21_sROM,
 (IsoAgLib::iVtObject_c::iVtObject_s*)&iVtObjectKeyChangeCol_sROM,
 (IsoAgLib::iVtObject_c::iVtObject_s*)&iVtObjectUnnamed20_sROM,
 (IsoAgLib::iVtObject_c::iVtObject_s*)&iVtObjectKeyChangeLang_sROM,
 (IsoAgLib::iVtObject_c::iVtObject_s*)&iVtObjectUnnamed19_sROM,
 (IsoAgLib::iVtObject_c::iVtObject_s*)&iVtObjectKeyLogo_sROM,
 (IsoAgLib::iVtObject_c::iVtObject_s*)&iVtObjectUnnamed18_sROM,
 (IsoAgLib::iVtObject_c::iVtObject_s*)&iVtObjectKeyMove_sROM,
 (IsoAgLib::iVtObject_c::iVtObject_s*)&iVtObjectsoftkeys1_sROM,
 (IsoAgLib::iVtObject_c::iVtObject_s*)&iVtObjectOSresonible_sROM,
 (IsoAgLib::iVtObject_c::iVtObject_s*)&iVtObjectISdriver_sROM,
 (IsoAgLib::iVtObject_c::iVtObject_s*)&iVtObjectresonible_sROM,
 (IsoAgLib::iVtObject_c::iVtObject_s*)&iVtObjectdriver_sROM,
 (IsoAgLib::iVtObject_c::iVtObject_s*)&iVtObjectOSlanguage_sROM,
 (IsoAgLib::iVtObject_c::iVtObject_s*)&iVtObjectvtLang_sROM,
 (IsoAgLib::iVtObject_c::iVtObject_s*)&iVtObjectUnnamed17_sROM,
 (IsoAgLib::iVtObject_c::iVtObject_s*)&iVtObjectKeyLessAccel_sROM,
 (IsoAgLib::iVtObject_c::iVtObject_s*)&iVtObjectUnnamed16_sROM,
 (IsoAgLib::iVtObject_c::iVtObject_s*)&iVtObjectKeyMoreAccel_sROM,
 (IsoAgLib::iVtObject_c::iVtObject_s*)&iVtObjectLikeageOP_sROM,
 (IsoAgLib::iVtObject_c::iVtObject_s*)&iVtObjectInputLikeage_sROM,
 (IsoAgLib::iVtObject_c::iVtObject_s*)&iVtObjectUnnamed11_sROM,
 (IsoAgLib::iVtObject_c::iVtObject_s*)&iVtObjectUnnamed10_sROM,
 (IsoAgLib::iVtObject_c::iVtObject_s*)&iVtObjectUnnamed15_sROM,
 (IsoAgLib::iVtObject_c::iVtObject_s*)&iVtObjectUnnamed14_sROM,
 (IsoAgLib::iVtObject_c::iVtObject_s*)&iVtObjectUnnamed13_sROM,
 (IsoAgLib::iVtObject_c::iVtObject_s*)&iVtObjectUnnamed12_sROM,
 (IsoAgLib::iVtObject_c::iVtObject_s*)&iVtObjectInputListTypFakeMiles_sROM,
 (IsoAgLib::iVtObject_c::iVtObject_s*)&iVtObjectChangeAwayPointer_sROM,
 (IsoAgLib::iVtObject_c::iVtObject_s*)&iVtObjectOpsFakeMileage_sROM,
 (IsoAgLib::iVtObject_c::iVtObject_s*)&iVtObjectAccelArchedBarGraph_sROM,
 (IsoAgLib::iVtObject_c::iVtObject_s*)&iVtObjectColOS_sROM,
 (IsoAgLib::iVtObject_c::iVtObject_s*)&iVtObjectColLabel_sROM,
 (IsoAgLib::iVtObject_c::iVtObject_s*)&iVtObjectUnnamed9_sROM,
 (IsoAgLib::iVtObject_c::iVtObject_s*)&iVtObjectUnnamed8_sROM,
 (IsoAgLib::iVtObject_c::iVtObject_s*)&iVtObjectUnnamed7_sROM,
 (IsoAgLib::iVtObject_c::iVtObject_s*)&iVtObjectUnnamed6_sROM,
 (IsoAgLib::iVtObject_c::iVtObject_s*)&iVtObjectUnnamed5_sROM,
 (IsoAgLib::iVtObject_c::iVtObject_s*)&iVtObjectspeedLabel_sROM,
 (IsoAgLib::iVtObject_c::iVtObject_s*)&iVtObjectUnnamed4_sROM,
 (IsoAgLib::iVtObject_c::iVtObject_s*)&iVtObjectmask1contentscontainer_sROM,
 (IsoAgLib::iVtObject_c::iVtObject_s*)&iVtObjectInputMiles_sROM,
 (IsoAgLib::iVtObject_c::iVtObject_s*)&iVtObjectKeyReset_sROM,
 (IsoAgLib::iVtObject_c::iVtObject_s*)&iVtObjectleine_sROM,
 (IsoAgLib::iVtObject_c::iVtObject_s*)&iVtObjectBigLogo_sROM,
 (IsoAgLib::iVtObject_c::iVtObject_s*)&iVtObjectUnnamed3_sROM,
 (IsoAgLib::iVtObject_c::iVtObject_s*)&iVtObjectcontainerInAllMasks_sROM,
 (IsoAgLib::iVtObject_c::iVtObject_s*)&iVtObjectLikeItNot_sROM,
 (IsoAgLib::iVtObject_c::iVtObject_s*)&iVtObjectLikeIt_sROM,
 (IsoAgLib::iVtObject_c::iVtObject_s*)&iVtObjectStrWhite_sROM,
 (IsoAgLib::iVtObject_c::iVtObject_s*)&iVtObjectStrBlack_sROM,
 (IsoAgLib::iVtObject_c::iVtObject_s*)&iVtObjectStrMagenta_sROM,
 (IsoAgLib::iVtObject_c::iVtObject_s*)&iVtObjectStrCyan_sROM,
 (IsoAgLib::iVtObject_c::iVtObject_s*)&iVtObjectStrYellow_sROM,
 (IsoAgLib::iVtObject_c::iVtObject_s*)&iVtObjectValAccel_sROM,
 (IsoAgLib::iVtObject_c::iVtObject_s*)&iVtObjectValSpeed_sROM,
 (IsoAgLib::iVtObject_c::iVtObject_s*)&iVtObjectFontAttributesNormal6x8_Button60x30_sROM,
 (IsoAgLib::iVtObject_c::iVtObject_s*)&iVtObjectLineAttributesSKM_sROM,
 (IsoAgLib::iVtObject_c::iVtObject_s*)&iVtObjectFontAttributesSKM12x16_sROM,
 (IsoAgLib::iVtObject_c::iVtObject_s*)&iVtObjectFontAttributesSKM8x8_sROM,
 (IsoAgLib::iVtObject_c::iVtObject_s*)&iVtObjectFontAttributesSKM6x8_sROM,
 (IsoAgLib::iVtObject_c::iVtObject_s*)&iVtObjectLineAttributesDotted_sROM,
 (IsoAgLib::iVtObject_c::iVtObject_s*)&iVtObjectLineAttributesNormal_sROM,
 (IsoAgLib::iVtObject_c::iVtObject_s*)&iVtObjectFontAttributesNormal24x32_sROM,
 (IsoAgLib::iVtObject_c::iVtObject_s*)&iVtObjectFontAttributesNormal16x24_sROM,
 (IsoAgLib::iVtObject_c::iVtObject_s*)&iVtObjectFontAttributesNormal16x16_sROM,
 (IsoAgLib::iVtObject_c::iVtObject_s*)&iVtObjectFontAttributesNormal12x16_sROM,
 (IsoAgLib::iVtObject_c::iVtObject_s*)&iVtObjectFontAttributesNormal8x8_sROM,
 (IsoAgLib::iVtObject_c::iVtObject_s*)&iVtObjectFontAttributesNormal6x8B_sROM,
 (IsoAgLib::iVtObject_c::iVtObject_s*)&iVtObjectFontAttributesNormal6x8R_sROM,
 (IsoAgLib::iVtObject_c::iVtObject_s*)&iVtObjectFontAttributesNormal8x12_sROM,
 (IsoAgLib::iVtObject_c::iVtObject_s*)&iVtObjectFontAttributesNormal6x8_sROM,
 (IsoAgLib::iVtObject_c::iVtObject_s*)&iVtObjectUnnamed2_sROM,
 (IsoAgLib::iVtObject_c::iVtObject_s*)&iVtObjectUnnamed1_sROM,
 (IsoAgLib::iVtObject_c::iVtObject_s*)&iVtObjectresetTextOS_sROM,
 (IsoAgLib::iVtObject_c::iVtObject_s*)&iVtObjectStrBlue_sROM,
 (IsoAgLib::iVtObject_c::iVtObject_s*)&iVtObjectStrGreen_sROM,
 (IsoAgLib::iVtObject_c::iVtObject_s*)&iVtObjectStrRed_sROM,
 (IsoAgLib::iVtObject_c::iVtObject_s*)&iVtObjectStrNone_sROM,
 (IsoAgLib::iVtObject_c::iVtObject_s*)&iVtObjectFontAttributesNormal6x8LangDep_sROM,
 (IsoAgLib::iVtObject_c::iVtObject_s*)&iVtObjectresetTextOS_1_sROM,
 (IsoAgLib::iVtObject_c::iVtObject_s*)&iVtObjectStrBlue_1_sROM,
 (IsoAgLib::iVtObject_c::iVtObject_s*)&iVtObjectStrGreen_1_sROM,
 (IsoAgLib::iVtObject_c::iVtObject_s*)&iVtObjectStrRed_1_sROM,
 (IsoAgLib::iVtObject_c::iVtObject_s*)&iVtObjectStrNone_1_sROM,
 (IsoAgLib::iVtObject_c::iVtObject_s*)&iVtObjectFontAttributesNormal6x8LangDep_1_sROM,
 (IsoAgLib::iVtObject_c::iVtObject_s*)&iVtObjectresetTextOS_2_sROM,
 (IsoAgLib::iVtObject_c::iVtObject_s*)&iVtObjectStrBlue_2_sROM,
 (IsoAgLib::iVtObject_c::iVtObject_s*)&iVtObjectStrGreen_2_sROM,
 (IsoAgLib::iVtObject_c::iVtObject_s*)&iVtObjectStrRed_2_sROM,
 (IsoAgLib::iVtObject_c::iVtObject_s*)&iVtObjectStrNone_2_sROM,
 (IsoAgLib::iVtObject_c::iVtObject_s*)&iVtObjectFontAttributesNormal6x8LangDep_2_sROM
};
