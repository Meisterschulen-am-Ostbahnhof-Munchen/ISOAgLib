void iObjectPool_simpleVTIsoPool_c::initAllObjectsOnce (SINGLETON_VEC_KEY_PARAMETER_DEF)
{
  if (b_initAllObjects) return;   // so the pointer to the ROM structures are only getting set once on initialization!
  iVtObjectimiIsoMaskupload.init (&iVtObjectimiIsoMaskupload_sROM SINGLETON_VEC_KEY_PARAMETER_USE_WITH_COMMA);
  iVtObjectUnnamed1.init (&iVtObjectUnnamed1_sROM SINGLETON_VEC_KEY_PARAMETER_USE_WITH_COMMA);
  iVtObjectUnnamed2.init (&iVtObjectUnnamed2_sROM SINGLETON_VEC_KEY_PARAMETER_USE_WITH_COMMA);
  iVtObjectFontAttributesNormal6x8.init (&iVtObjectFontAttributesNormal6x8_sROM SINGLETON_VEC_KEY_PARAMETER_USE_WITH_COMMA);
  iVtObjectFontAttributesNormal6x8LangDep.init (&iVtObjectFontAttributesNormal6x8LangDep_sROM SINGLETON_VEC_KEY_PARAMETER_USE_WITH_COMMA);
  iVtObjectFontAttributesNormal6x8LangDep_1.init (&iVtObjectFontAttributesNormal6x8LangDep_1_sROM SINGLETON_VEC_KEY_PARAMETER_USE_WITH_COMMA);
  iVtObjectFontAttributesNormal6x8LangDep_2.init (&iVtObjectFontAttributesNormal6x8LangDep_2_sROM SINGLETON_VEC_KEY_PARAMETER_USE_WITH_COMMA);
  iVtObjectFontAttributesNormal8x12.init (&iVtObjectFontAttributesNormal8x12_sROM SINGLETON_VEC_KEY_PARAMETER_USE_WITH_COMMA);
  iVtObjectFontAttributesNormal6x8R.init (&iVtObjectFontAttributesNormal6x8R_sROM SINGLETON_VEC_KEY_PARAMETER_USE_WITH_COMMA);
  iVtObjectFontAttributesNormal6x8B.init (&iVtObjectFontAttributesNormal6x8B_sROM SINGLETON_VEC_KEY_PARAMETER_USE_WITH_COMMA);
  iVtObjectFontAttributesNormal8x8.init (&iVtObjectFontAttributesNormal8x8_sROM SINGLETON_VEC_KEY_PARAMETER_USE_WITH_COMMA);
  iVtObjectFontAttributesNormal12x16.init (&iVtObjectFontAttributesNormal12x16_sROM SINGLETON_VEC_KEY_PARAMETER_USE_WITH_COMMA);
  iVtObjectFontAttributesNormal16x16.init (&iVtObjectFontAttributesNormal16x16_sROM SINGLETON_VEC_KEY_PARAMETER_USE_WITH_COMMA);
  iVtObjectFontAttributesNormal16x24.init (&iVtObjectFontAttributesNormal16x24_sROM SINGLETON_VEC_KEY_PARAMETER_USE_WITH_COMMA);
  iVtObjectFontAttributesNormal24x32.init (&iVtObjectFontAttributesNormal24x32_sROM SINGLETON_VEC_KEY_PARAMETER_USE_WITH_COMMA);
  iVtObjectLineAttributesNormal.init (&iVtObjectLineAttributesNormal_sROM SINGLETON_VEC_KEY_PARAMETER_USE_WITH_COMMA);
  iVtObjectLineAttributesDotted.init (&iVtObjectLineAttributesDotted_sROM SINGLETON_VEC_KEY_PARAMETER_USE_WITH_COMMA);
  iVtObjectFontAttributesSKM6x8.init (&iVtObjectFontAttributesSKM6x8_sROM SINGLETON_VEC_KEY_PARAMETER_USE_WITH_COMMA);
  iVtObjectFontAttributesSKM8x8.init (&iVtObjectFontAttributesSKM8x8_sROM SINGLETON_VEC_KEY_PARAMETER_USE_WITH_COMMA);
  iVtObjectFontAttributesSKM12x16.init (&iVtObjectFontAttributesSKM12x16_sROM SINGLETON_VEC_KEY_PARAMETER_USE_WITH_COMMA);
  iVtObjectLineAttributesSKM.init (&iVtObjectLineAttributesSKM_sROM SINGLETON_VEC_KEY_PARAMETER_USE_WITH_COMMA);
  iVtObjectFontAttributesNormal6x8_Button60x30.init (&iVtObjectFontAttributesNormal6x8_Button60x30_sROM SINGLETON_VEC_KEY_PARAMETER_USE_WITH_COMMA);
  iVtObjectValSpeed.init (&iVtObjectValSpeed_sROM SINGLETON_VEC_KEY_PARAMETER_USE_WITH_COMMA);
  iVtObjectValAccel.init (&iVtObjectValAccel_sROM SINGLETON_VEC_KEY_PARAMETER_USE_WITH_COMMA);
  iVtObjectValMiles.init (&iVtObjectValMiles_sROM SINGLETON_VEC_KEY_PARAMETER_USE_WITH_COMMA);
  iVtObjectStrNone.init (&iVtObjectStrNone_sROM SINGLETON_VEC_KEY_PARAMETER_USE_WITH_COMMA);
  iVtObjectStrNone_1.init (&iVtObjectStrNone_1_sROM SINGLETON_VEC_KEY_PARAMETER_USE_WITH_COMMA);
  iVtObjectStrNone_2.init (&iVtObjectStrNone_2_sROM SINGLETON_VEC_KEY_PARAMETER_USE_WITH_COMMA);
  iVtObjectStrRed.init (&iVtObjectStrRed_sROM SINGLETON_VEC_KEY_PARAMETER_USE_WITH_COMMA);
  iVtObjectStrRed_1.init (&iVtObjectStrRed_1_sROM SINGLETON_VEC_KEY_PARAMETER_USE_WITH_COMMA);
  iVtObjectStrRed_2.init (&iVtObjectStrRed_2_sROM SINGLETON_VEC_KEY_PARAMETER_USE_WITH_COMMA);
  iVtObjectStrGreen.init (&iVtObjectStrGreen_sROM SINGLETON_VEC_KEY_PARAMETER_USE_WITH_COMMA);
  iVtObjectStrGreen_1.init (&iVtObjectStrGreen_1_sROM SINGLETON_VEC_KEY_PARAMETER_USE_WITH_COMMA);
  iVtObjectStrGreen_2.init (&iVtObjectStrGreen_2_sROM SINGLETON_VEC_KEY_PARAMETER_USE_WITH_COMMA);
  iVtObjectStrBlue.init (&iVtObjectStrBlue_sROM SINGLETON_VEC_KEY_PARAMETER_USE_WITH_COMMA);
  iVtObjectStrBlue_1.init (&iVtObjectStrBlue_1_sROM SINGLETON_VEC_KEY_PARAMETER_USE_WITH_COMMA);
  iVtObjectStrBlue_2.init (&iVtObjectStrBlue_2_sROM SINGLETON_VEC_KEY_PARAMETER_USE_WITH_COMMA);
  iVtObjectStrYellow.init (&iVtObjectStrYellow_sROM SINGLETON_VEC_KEY_PARAMETER_USE_WITH_COMMA);
  iVtObjectStrCyan.init (&iVtObjectStrCyan_sROM SINGLETON_VEC_KEY_PARAMETER_USE_WITH_COMMA);
  iVtObjectStrMagenta.init (&iVtObjectStrMagenta_sROM SINGLETON_VEC_KEY_PARAMETER_USE_WITH_COMMA);
  iVtObjectStrBlack.init (&iVtObjectStrBlack_sROM SINGLETON_VEC_KEY_PARAMETER_USE_WITH_COMMA);
  iVtObjectStrWhite.init (&iVtObjectStrWhite_sROM SINGLETON_VEC_KEY_PARAMETER_USE_WITH_COMMA);
  iVtObjectLikeIt.init (&iVtObjectLikeIt_sROM SINGLETON_VEC_KEY_PARAMETER_USE_WITH_COMMA);
  iVtObjectLikeItNot.init (&iVtObjectLikeItNot_sROM SINGLETON_VEC_KEY_PARAMETER_USE_WITH_COMMA);
  iVtObjectcontainerInAllMasks.init (&iVtObjectcontainerInAllMasks_sROM SINGLETON_VEC_KEY_PARAMETER_USE_WITH_COMMA);
  iVtObjectUnnamed3.init (&iVtObjectUnnamed3_sROM SINGLETON_VEC_KEY_PARAMETER_USE_WITH_COMMA);
  iVtObjectBigLogo.init (&iVtObjectBigLogo_sROM SINGLETON_VEC_KEY_PARAMETER_USE_WITH_COMMA);
  iVtObjectUnnamed4.init (&iVtObjectUnnamed4_sROM SINGLETON_VEC_KEY_PARAMETER_USE_WITH_COMMA);
  iVtObjectUnnamed5.init (&iVtObjectUnnamed5_sROM SINGLETON_VEC_KEY_PARAMETER_USE_WITH_COMMA);
  iVtObjectBigGC.init (&iVtObjectBigGC_sROM SINGLETON_VEC_KEY_PARAMETER_USE_WITH_COMMA);
  iVtObjectUnnamed6.init (&iVtObjectUnnamed6_sROM SINGLETON_VEC_KEY_PARAMETER_USE_WITH_COMMA);
  iVtObjectUnnamed7.init (&iVtObjectUnnamed7_sROM SINGLETON_VEC_KEY_PARAMETER_USE_WITH_COMMA);
  iVtObjectleine.init (&iVtObjectleine_sROM SINGLETON_VEC_KEY_PARAMETER_USE_WITH_COMMA);
  iVtObjectKeyReset.init (&iVtObjectKeyReset_sROM SINGLETON_VEC_KEY_PARAMETER_USE_WITH_COMMA);
  iVtObjectresetTextOS.init (&iVtObjectresetTextOS_sROM SINGLETON_VEC_KEY_PARAMETER_USE_WITH_COMMA);
  iVtObjectresetTextOS_1.init (&iVtObjectresetTextOS_1_sROM SINGLETON_VEC_KEY_PARAMETER_USE_WITH_COMMA);
  iVtObjectresetTextOS_2.init (&iVtObjectresetTextOS_2_sROM SINGLETON_VEC_KEY_PARAMETER_USE_WITH_COMMA);
  iVtObjectInputMiles.init (&iVtObjectInputMiles_sROM SINGLETON_VEC_KEY_PARAMETER_USE_WITH_COMMA);
  iVtObjectMainMask.init (&iVtObjectMainMask_sROM SINGLETON_VEC_KEY_PARAMETER_USE_WITH_COMMA);
  iVtObjectmask1contentscontainer.init (&iVtObjectmask1contentscontainer_sROM SINGLETON_VEC_KEY_PARAMETER_USE_WITH_COMMA);
  iVtObjectUnnamed8.init (&iVtObjectUnnamed8_sROM SINGLETON_VEC_KEY_PARAMETER_USE_WITH_COMMA);
  iVtObjectspeedLabel.init (&iVtObjectspeedLabel_sROM SINGLETON_VEC_KEY_PARAMETER_USE_WITH_COMMA);
  iVtObjectUnnamed9.init (&iVtObjectUnnamed9_sROM SINGLETON_VEC_KEY_PARAMETER_USE_WITH_COMMA);
  iVtObjectUnnamed10.init (&iVtObjectUnnamed10_sROM SINGLETON_VEC_KEY_PARAMETER_USE_WITH_COMMA);
  iVtObjectUnnamed11.init (&iVtObjectUnnamed11_sROM SINGLETON_VEC_KEY_PARAMETER_USE_WITH_COMMA);
  iVtObjectUnnamed12.init (&iVtObjectUnnamed12_sROM SINGLETON_VEC_KEY_PARAMETER_USE_WITH_COMMA);
  iVtObjectUnnamed13.init (&iVtObjectUnnamed13_sROM SINGLETON_VEC_KEY_PARAMETER_USE_WITH_COMMA);
  iVtObjectColLabel.init (&iVtObjectColLabel_sROM SINGLETON_VEC_KEY_PARAMETER_USE_WITH_COMMA);
  iVtObjectColOS.init (&iVtObjectColOS_sROM SINGLETON_VEC_KEY_PARAMETER_USE_WITH_COMMA);
  iVtObjectAccelArchedBarGraph.init (&iVtObjectAccelArchedBarGraph_sROM SINGLETON_VEC_KEY_PARAMETER_USE_WITH_COMMA);
  iVtObjectOpsFakeMileage.init (&iVtObjectOpsFakeMileage_sROM SINGLETON_VEC_KEY_PARAMETER_USE_WITH_COMMA);
  iVtObjectChangeAwayPointer.init (&iVtObjectChangeAwayPointer_sROM SINGLETON_VEC_KEY_PARAMETER_USE_WITH_COMMA);
  iVtObjectInputListTypFakeMiles.init (&iVtObjectInputListTypFakeMiles_sROM SINGLETON_VEC_KEY_PARAMETER_USE_WITH_COMMA);
  iVtObjectUnnamed16.init (&iVtObjectUnnamed16_sROM SINGLETON_VEC_KEY_PARAMETER_USE_WITH_COMMA);
  iVtObjectUnnamed17.init (&iVtObjectUnnamed17_sROM SINGLETON_VEC_KEY_PARAMETER_USE_WITH_COMMA);
  iVtObjectUnnamed18.init (&iVtObjectUnnamed18_sROM SINGLETON_VEC_KEY_PARAMETER_USE_WITH_COMMA);
  iVtObjectUnnamed19.init (&iVtObjectUnnamed19_sROM SINGLETON_VEC_KEY_PARAMETER_USE_WITH_COMMA);
  iVtObjectUnnamed14.init (&iVtObjectUnnamed14_sROM SINGLETON_VEC_KEY_PARAMETER_USE_WITH_COMMA);
  iVtObjectUnnamed15.init (&iVtObjectUnnamed15_sROM SINGLETON_VEC_KEY_PARAMETER_USE_WITH_COMMA);
  iVtObjectInputLikeage.init (&iVtObjectInputLikeage_sROM SINGLETON_VEC_KEY_PARAMETER_USE_WITH_COMMA);
  iVtObjectLikeageOP.init (&iVtObjectLikeageOP_sROM SINGLETON_VEC_KEY_PARAMETER_USE_WITH_COMMA);
  iVtObjectKeyMoreAccel.init (&iVtObjectKeyMoreAccel_sROM SINGLETON_VEC_KEY_PARAMETER_USE_WITH_COMMA);
  iVtObjectUnnamed20.init (&iVtObjectUnnamed20_sROM SINGLETON_VEC_KEY_PARAMETER_USE_WITH_COMMA);
  iVtObjectKeyLessAccel.init (&iVtObjectKeyLessAccel_sROM SINGLETON_VEC_KEY_PARAMETER_USE_WITH_COMMA);
  iVtObjectUnnamed21.init (&iVtObjectUnnamed21_sROM SINGLETON_VEC_KEY_PARAMETER_USE_WITH_COMMA);
  iVtObjectvtLang.init (&iVtObjectvtLang_sROM SINGLETON_VEC_KEY_PARAMETER_USE_WITH_COMMA);
  iVtObjectOSlanguage.init (&iVtObjectOSlanguage_sROM SINGLETON_VEC_KEY_PARAMETER_USE_WITH_COMMA);
  iVtObjectdriver.init (&iVtObjectdriver_sROM SINGLETON_VEC_KEY_PARAMETER_USE_WITH_COMMA);
  iVtObjectresonible.init (&iVtObjectresonible_sROM SINGLETON_VEC_KEY_PARAMETER_USE_WITH_COMMA);
  iVtObjectISdriver.init (&iVtObjectISdriver_sROM SINGLETON_VEC_KEY_PARAMETER_USE_WITH_COMMA);
  iVtObjectOSresonible.init (&iVtObjectOSresonible_sROM SINGLETON_VEC_KEY_PARAMETER_USE_WITH_COMMA);
  iVtObjectsoftkeys1.init (&iVtObjectsoftkeys1_sROM SINGLETON_VEC_KEY_PARAMETER_USE_WITH_COMMA);
  iVtObjectKeyMove.init (&iVtObjectKeyMove_sROM SINGLETON_VEC_KEY_PARAMETER_USE_WITH_COMMA);
  iVtObjectUnnamed22.init (&iVtObjectUnnamed22_sROM SINGLETON_VEC_KEY_PARAMETER_USE_WITH_COMMA);
  iVtObjectKeyLogo.init (&iVtObjectKeyLogo_sROM SINGLETON_VEC_KEY_PARAMETER_USE_WITH_COMMA);
  iVtObjectUnnamed23.init (&iVtObjectUnnamed23_sROM SINGLETON_VEC_KEY_PARAMETER_USE_WITH_COMMA);
  iVtObjectKeyChangeLang.init (&iVtObjectKeyChangeLang_sROM SINGLETON_VEC_KEY_PARAMETER_USE_WITH_COMMA);
  iVtObjectUnnamed24.init (&iVtObjectUnnamed24_sROM SINGLETON_VEC_KEY_PARAMETER_USE_WITH_COMMA);
  iVtObjectKeyChangeCol.init (&iVtObjectKeyChangeCol_sROM SINGLETON_VEC_KEY_PARAMETER_USE_WITH_COMMA);
  iVtObjectUnnamed25.init (&iVtObjectUnnamed25_sROM SINGLETON_VEC_KEY_PARAMETER_USE_WITH_COMMA);
  iVtObjectUnnamed26.init (&iVtObjectUnnamed26_sROM SINGLETON_VEC_KEY_PARAMETER_USE_WITH_COMMA);
  iVtObjectKeyForbidden.init (&iVtObjectKeyForbidden_sROM SINGLETON_VEC_KEY_PARAMETER_USE_WITH_COMMA);
  iVtObjectUnnamed27.init (&iVtObjectUnnamed27_sROM SINGLETON_VEC_KEY_PARAMETER_USE_WITH_COMMA);
  iVtObjectKeyChangeFill.init (&iVtObjectKeyChangeFill_sROM SINGLETON_VEC_KEY_PARAMETER_USE_WITH_COMMA);
  iVtObjectUnnamed28.init (&iVtObjectUnnamed28_sROM SINGLETON_VEC_KEY_PARAMETER_USE_WITH_COMMA);
  iVtObjectLineAttributes_Normal.init (&iVtObjectLineAttributes_Normal_sROM SINGLETON_VEC_KEY_PARAMETER_USE_WITH_COMMA);
  iVtObjectFillAttributes.init (&iVtObjectFillAttributes_sROM SINGLETON_VEC_KEY_PARAMETER_USE_WITH_COMMA);
  iVtObjectdEllipse.init (&iVtObjectdEllipse_sROM SINGLETON_VEC_KEY_PARAMETER_USE_WITH_COMMA);
  iVtObjectdPolygon.init (&iVtObjectdPolygon_sROM SINGLETON_VEC_KEY_PARAMETER_USE_WITH_COMMA);
  iVtObjectdMeter.init (&iVtObjectdMeter_sROM SINGLETON_VEC_KEY_PARAMETER_USE_WITH_COMMA);
  iVtObjectMacro_1.init (&iVtObjectMacro_1_sROM SINGLETON_VEC_KEY_PARAMETER_USE_WITH_COMMA);
  iVtObjectMacro_2.init (&iVtObjectMacro_2_sROM SINGLETON_VEC_KEY_PARAMETER_USE_WITH_COMMA);
  iVtObjectAnotherMask.init (&iVtObjectAnotherMask_sROM SINGLETON_VEC_KEY_PARAMETER_USE_WITH_COMMA);
  iVtObjectUnnamed29.init (&iVtObjectUnnamed29_sROM SINGLETON_VEC_KEY_PARAMETER_USE_WITH_COMMA);
  iVtObjectUnnamed30.init (&iVtObjectUnnamed30_sROM SINGLETON_VEC_KEY_PARAMETER_USE_WITH_COMMA);
  iVtObjectUnnamed31.init (&iVtObjectUnnamed31_sROM SINGLETON_VEC_KEY_PARAMETER_USE_WITH_COMMA);
  iVtObjectUnnamed32.init (&iVtObjectUnnamed32_sROM SINGLETON_VEC_KEY_PARAMETER_USE_WITH_COMMA);
  iVtObjectUnnamed33.init (&iVtObjectUnnamed33_sROM SINGLETON_VEC_KEY_PARAMETER_USE_WITH_COMMA);
  iVtObjectUnnamed34.init (&iVtObjectUnnamed34_sROM SINGLETON_VEC_KEY_PARAMETER_USE_WITH_COMMA);
  iVtObjectUnnamed35.init (&iVtObjectUnnamed35_sROM SINGLETON_VEC_KEY_PARAMETER_USE_WITH_COMMA);
  iVtObjectForbiddenAlarmMask.init (&iVtObjectForbiddenAlarmMask_sROM SINGLETON_VEC_KEY_PARAMETER_USE_WITH_COMMA);
  iVtObjectalarm1contentscontainer.init (&iVtObjectalarm1contentscontainer_sROM SINGLETON_VEC_KEY_PARAMETER_USE_WITH_COMMA);
  iVtObjectUnnamed36.init (&iVtObjectUnnamed36_sROM SINGLETON_VEC_KEY_PARAMETER_USE_WITH_COMMA);
  iVtObjectUnnamed37.init (&iVtObjectUnnamed37_sROM SINGLETON_VEC_KEY_PARAMETER_USE_WITH_COMMA);
  iVtObjectUnnamed38.init (&iVtObjectUnnamed38_sROM SINGLETON_VEC_KEY_PARAMETER_USE_WITH_COMMA);
  iVtObjectsoftkeysAlarm.init (&iVtObjectsoftkeysAlarm_sROM SINGLETON_VEC_KEY_PARAMETER_USE_WITH_COMMA);

  #include "simpleVTIsoPool-functions-origin.inc"

  b_initAllObjects = true;
}
