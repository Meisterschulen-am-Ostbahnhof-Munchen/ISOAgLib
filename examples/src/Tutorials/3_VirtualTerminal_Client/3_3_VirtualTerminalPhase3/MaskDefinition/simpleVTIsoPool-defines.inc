#define iVtObjectIDimiIsoMaskupload 65534
#define iVtObjectIDUnnamed1 65533
#define iVtObjectIDUnnamed2 65532
#define iVtObjectIDFontAttributesNormal6x8 65531
#define iVtObjectIDFontAttributesNormal6x8LangDep 65530
#define iVtObjectIDFontAttributesNormal6x8LangDep_1 65530
#define iVtObjectIDFontAttributesNormal6x8LangDep_2 65530
#define iVtObjectIDFontAttributesNormal8x12 65529
#define iVtObjectIDFontAttributesNormal6x8R 65528
#define iVtObjectIDFontAttributesNormal6x8B 65527
#define iVtObjectIDFontAttributesNormal8x8 65526
#define iVtObjectIDFontAttributesNormal12x16 65525
#define iVtObjectIDFontAttributesNormal16x16 65524
#define iVtObjectIDFontAttributesNormal16x24 65523
#define iVtObjectIDFontAttributesNormal24x32 65522
#define iVtObjectIDLineAttributesNormal 65521
#define iVtObjectIDLineAttributesDotted 65520
#define iVtObjectIDFontAttributesSKM6x8 65519
#define iVtObjectIDFontAttributesSKM8x8 65518
#define iVtObjectIDFontAttributesSKM12x16 65517
#define iVtObjectIDLineAttributesSKM 65516
#define iVtObjectIDFontAttributesNormal6x8_Button60x30 65515
#define iVtObjectIDValSpeed 65514
#define iVtObjectIDValAccel 65513
#define iVtObjectIDValMiles 1234
#define iVtObjectIDStrNone 65512
#define iVtObjectIDStrNone_1 65512
#define iVtObjectIDStrNone_2 65512
#define iVtObjectIDStrRed 65511
#define iVtObjectIDStrRed_1 65511
#define iVtObjectIDStrRed_2 65511
#define iVtObjectIDStrGreen 65510
#define iVtObjectIDStrGreen_1 65510
#define iVtObjectIDStrGreen_2 65510
#define iVtObjectIDStrBlue 65509
#define iVtObjectIDStrBlue_1 65509
#define iVtObjectIDStrBlue_2 65509
#define iVtObjectIDStrYellow 65508
#define iVtObjectIDStrCyan 65507
#define iVtObjectIDStrMagenta 65506
#define iVtObjectIDStrBlack 65505
#define iVtObjectIDStrWhite 65504
#define iVtObjectIDLikeIt 65503
#define iVtObjectIDLikeItNot 65502
#define iVtObjectIDcontainerInAllMasks 65501
#define iVtObjectIDUnnamed3 65500
#define iVtObjectIDBigLogo 65499
#define iVtObjectIDUnnamed4 65498
#define iVtObjectIDUnnamed5 65497
#define iVtObjectIDBigGC 65496
#define iVtObjectIDUnnamed6 65495
#define iVtObjectIDUnnamed7 65494
#define iVtObjectIDleine 65493
#define iVtObjectIDKeyReset 65492
#define vtKeyCodeKeyReset 254
#define iVtObjectIDresetTextOS 65491
#define iVtObjectIDresetTextOS_1 65491
#define iVtObjectIDresetTextOS_2 65491
#define iVtObjectIDInputMiles 65490
#define iVtObjectIDMainMask 1101
#define iVtObjectIDmask1contentscontainer 65489
#define iVtObjectIDUnnamed8 65488
#define iVtObjectIDspeedLabel 65487
#define iVtObjectIDUnnamed9 65486
#define iVtObjectIDUnnamed10 65485
#define iVtObjectIDUnnamed11 65484
#define iVtObjectIDUnnamed12 65483
#define iVtObjectIDUnnamed13 65482
#define iVtObjectIDColLabel 65481
#define iVtObjectIDColOS 65480
#define iVtObjectIDAccelArchedBarGraph 65476
#define iVtObjectIDOpsFakeMileage 65475
#define iVtObjectIDChangeAwayPointer 65474
#define iVtObjectIDInputListTypFakeMiles 65473
#define iVtObjectIDUnnamed16 65460
#define iVtObjectIDUnnamed17 65459
#define iVtObjectIDUnnamed18 65458
#define iVtObjectIDUnnamed19 65457
#define iVtObjectIDUnnamed14 65472
#define iVtObjectIDUnnamed15 65471
#define iVtObjectIDInputLikeage 65470
#define iVtObjectIDLikeageOP 65469
#define iVtObjectIDKeyMoreAccel 65468
#define vtKeyCodeKeyMoreAccel 253
#define iVtObjectIDUnnamed20 65456
#define iVtObjectIDKeyLessAccel 65467
#define vtKeyCodeKeyLessAccel 252
#define iVtObjectIDUnnamed21 65455
#define iVtObjectIDvtLang 65466
#define iVtObjectIDOSlanguage 65465
#define iVtObjectIDdriver 65464
#define iVtObjectIDresonible 65463
#define iVtObjectIDISdriver 65462
#define iVtObjectIDOSresonible 65461
#define iVtObjectIDsoftkeys1 65454
#define iVtObjectIDKeyMove 65453
#define vtKeyCodeKeyMove 251
#define iVtObjectIDUnnamed22 65447
#define iVtObjectIDKeyLogo 65452
#define vtKeyCodeKeyLogo 250
#define iVtObjectIDUnnamed23 65446
#define iVtObjectIDKeyChangeLang 65451
#define vtKeyCodeKeyChangeLang 249
#define iVtObjectIDUnnamed24 65445
#define iVtObjectIDKeyChangeCol 65450
#define vtKeyCodeKeyChangeCol 248
#define iVtObjectIDUnnamed25 65444
#define iVtObjectIDUnnamed26 65443
#define iVtObjectIDKeyForbidden 65449
#define vtKeyCodeKeyForbidden 247
#define iVtObjectIDUnnamed27 65442
#define iVtObjectIDKeyChangeFill 65448
#define vtKeyCodeKeyChangeFill 246
#define iVtObjectIDUnnamed28 65441
#define iVtObjectIDLineAttributes_Normal 65440
#define iVtObjectIDFillAttributes 65439
#define iVtObjectIDdEllipse 65479
#define iVtObjectIDdPolygon 65478
#define iVtObjectIDdMeter 65477
#define iVtObjectIDMacro_1 1
#define iVtObjectIDMacro_2 2
#define iVtObjectIDAnotherMask 65438
#define iVtObjectIDUnnamed29 65437
#define iVtObjectIDUnnamed30 65436
#define iVtObjectIDUnnamed31 65435
#define iVtObjectIDUnnamed32 65434
#define iVtObjectIDUnnamed33 65433
#define iVtObjectIDUnnamed34 65432
#define iVtObjectIDUnnamed35 65431
#define iVtObjectIDForbiddenAlarmMask 65430
#define iVtObjectIDalarm1contentscontainer 65429
#define iVtObjectIDUnnamed36 65428
#define iVtObjectIDUnnamed37 65427
#define iVtObjectIDUnnamed38 65426
#define iVtObjectIDsoftkeysAlarm 65425
#define vtObjectPoolDimension 200
#define vtObjectPoolSoftKeyWidth 60
#define vtObjectPoolSoftKeyHeight 32

#define vtKeyCodeACK 0
