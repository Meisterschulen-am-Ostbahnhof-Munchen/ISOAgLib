IsoAgLib::iVtObjectWorkingSet_c iVtObjectimiIsoMaskupload;
IsoAgLib::iVtObjectOutputString_c iVtObjectUnnamed1;
IsoAgLib::iVtObjectOutputString_c iVtObjectUnnamed2;
IsoAgLib::iVtObjectFontAttributes_c iVtObjectFontAttributesNormal6x8;
IsoAgLib::iVtObjectFontAttributes_c iVtObjectFontAttributesNormal6x8LangDep;
IsoAgLib::iVtObjectFontAttributes_c iVtObjectFontAttributesNormal6x8LangDep_1;
IsoAgLib::iVtObjectFontAttributes_c iVtObjectFontAttributesNormal6x8LangDep_2;
IsoAgLib::iVtObjectFontAttributes_c iVtObjectFontAttributesNormal8x12;
IsoAgLib::iVtObjectFontAttributes_c iVtObjectFontAttributesNormal6x8R;
IsoAgLib::iVtObjectFontAttributes_c iVtObjectFontAttributesNormal6x8B;
IsoAgLib::iVtObjectFontAttributes_c iVtObjectFontAttributesNormal8x8;
IsoAgLib::iVtObjectFontAttributes_c iVtObjectFontAttributesNormal12x16;
IsoAgLib::iVtObjectFontAttributes_c iVtObjectFontAttributesNormal16x16;
IsoAgLib::iVtObjectFontAttributes_c iVtObjectFontAttributesNormal16x24;
IsoAgLib::iVtObjectFontAttributes_c iVtObjectFontAttributesNormal24x32;
IsoAgLib::iVtObjectLineAttributes_c iVtObjectLineAttributesNormal;
IsoAgLib::iVtObjectLineAttributes_c iVtObjectLineAttributesDotted;
IsoAgLib::iVtObjectFontAttributes_c iVtObjectFontAttributesSKM6x8;
IsoAgLib::iVtObjectFontAttributes_c iVtObjectFontAttributesSKM8x8;
IsoAgLib::iVtObjectFontAttributes_c iVtObjectFontAttributesSKM12x16;
IsoAgLib::iVtObjectLineAttributes_c iVtObjectLineAttributesSKM;
IsoAgLib::iVtObjectFontAttributes_c iVtObjectFontAttributesNormal6x8_Button60x30;
IsoAgLib::iVtObjectNumberVariable_c iVtObjectValSpeed;
IsoAgLib::iVtObjectNumberVariable_c iVtObjectValAccel;
IsoAgLib::iVtObjectNumberVariable_c iVtObjectValMiles;
IsoAgLib::iVtObjectStringVariable_c iVtObjectStrNone;
IsoAgLib::iVtObjectStringVariable_c iVtObjectStrNone_1;
IsoAgLib::iVtObjectStringVariable_c iVtObjectStrNone_2;
IsoAgLib::iVtObjectStringVariable_c iVtObjectStrRed;
IsoAgLib::iVtObjectStringVariable_c iVtObjectStrRed_1;
IsoAgLib::iVtObjectStringVariable_c iVtObjectStrRed_2;
IsoAgLib::iVtObjectStringVariable_c iVtObjectStrGreen;
IsoAgLib::iVtObjectStringVariable_c iVtObjectStrBlue;
IsoAgLib::iVtObjectStringVariable_c iVtObjectStrYellow;
IsoAgLib::iVtObjectStringVariable_c iVtObjectStrCyan;
IsoAgLib::iVtObjectStringVariable_c iVtObjectStrMagenta;
IsoAgLib::iVtObjectStringVariable_c iVtObjectStrBlack;
IsoAgLib::iVtObjectStringVariable_c iVtObjectStrWhite;
IsoAgLib::iVtObjectOutputString_c iVtObjectLikeIt;
IsoAgLib::iVtObjectOutputString_c iVtObjectLikeItNot;
IsoAgLib::iVtObjectContainer_c iVtObjectcontainerInAllMasks;
IsoAgLib::iVtObjectRectangle_c iVtObjectUnnamed3;
IsoAgLib::iVtObjectPictureGraphic_c iVtObjectBigLogo;
IsoAgLib::iVtObjectLine_c iVtObjectleine;
IsoAgLib::iVtObjectKey_c iVtObjectKeyReset;
IsoAgLib::iVtObjectOutputString_c iVtObjectresetTextOS;
IsoAgLib::iVtObjectOutputString_c iVtObjectresetTextOS_1;
IsoAgLib::iVtObjectOutputString_c iVtObjectresetTextOS_2;
IsoAgLib::iVtObjectInputNumber_c iVtObjectInputMiles;
IsoAgLib::iVtObjectDataMask_c iVtObjectMainMask;
IsoAgLib::iVtObjectContainer_c iVtObjectmask1contentscontainer;
IsoAgLib::iVtObjectOutputString_c iVtObjectUnnamed4;
IsoAgLib::iVtObjectOutputString_c iVtObjectspeedLabel;
IsoAgLib::iVtObjectOutputString_c iVtObjectUnnamed5;
IsoAgLib::iVtObjectOutputNumber_c iVtObjectUnnamed6;
IsoAgLib::iVtObjectOutputNumber_c iVtObjectUnnamed7;
IsoAgLib::iVtObjectOutputNumber_c iVtObjectUnnamed8;
IsoAgLib::iVtObjectLinearBarGraph_c iVtObjectUnnamed9;
IsoAgLib::iVtObjectOutputString_c iVtObjectColLabel;
IsoAgLib::iVtObjectOutputString_c iVtObjectColOS;
IsoAgLib::iVtObjectArchedBarGraph_c iVtObjectAccelArchedBarGraph;
IsoAgLib::iVtObjectOutputString_c iVtObjectOpsFakeMileage;
IsoAgLib::iVtObjectObjectPointer_c iVtObjectChangeAwayPointer;
IsoAgLib::iVtObjectInputList_c iVtObjectInputListTypFakeMiles;
IsoAgLib::iVtObjectOutputNumber_c iVtObjectUnnamed12;
IsoAgLib::iVtObjectOutputNumber_c iVtObjectUnnamed13;
IsoAgLib::iVtObjectOutputNumber_c iVtObjectUnnamed14;
IsoAgLib::iVtObjectOutputNumber_c iVtObjectUnnamed15;
IsoAgLib::iVtObjectOutputString_c iVtObjectUnnamed10;
IsoAgLib::iVtObjectRectangle_c iVtObjectUnnamed11;
IsoAgLib::iVtObjectInputBoolean_c iVtObjectInputLikeage;
IsoAgLib::iVtObjectObjectPointer_c iVtObjectLikeageOP;
IsoAgLib::iVtObjectButton_c iVtObjectKeyMoreAccel;
IsoAgLib::iVtObjectOutputString_c iVtObjectUnnamed16;
IsoAgLib::iVtObjectButton_c iVtObjectKeyLessAccel;
IsoAgLib::iVtObjectOutputString_c iVtObjectUnnamed17;
IsoAgLib::iVtObjectOutputString_c iVtObjectvtLang;
IsoAgLib::iVtObjectOutputString_c iVtObjectOSlanguage;
IsoAgLib::iVtObjectOutputString_c iVtObjectdriver;
IsoAgLib::iVtObjectOutputString_c iVtObjectresonible;
IsoAgLib::iVtObjectInputString_c iVtObjectISdriver;
IsoAgLib::iVtObjectOutputString_c iVtObjectOSresonible;
IsoAgLib::iVtObjectSoftKeyMask_c iVtObjectsoftkeys1;
IsoAgLib::iVtObjectKey_c iVtObjectKeyMove;
IsoAgLib::iVtObjectOutputString_c iVtObjectUnnamed18;
IsoAgLib::iVtObjectKey_c iVtObjectKeyLogo;
IsoAgLib::iVtObjectOutputString_c iVtObjectUnnamed19;
IsoAgLib::iVtObjectKey_c iVtObjectKeyChangeLang;
IsoAgLib::iVtObjectOutputString_c iVtObjectUnnamed20;
IsoAgLib::iVtObjectKey_c iVtObjectKeyChangeCol;
IsoAgLib::iVtObjectOutputString_c iVtObjectUnnamed21;
IsoAgLib::iVtObjectOutputString_c iVtObjectUnnamed22;
IsoAgLib::iVtObjectKey_c iVtObjectKeyTransCol;
IsoAgLib::iVtObjectOutputString_c iVtObjectUnnamed23;
IsoAgLib::iVtObjectOutputString_c iVtObjectUnnamed24;
IsoAgLib::iVtObjectKey_c iVtObjectKeyForbidden;
IsoAgLib::iVtObjectOutputString_c iVtObjectUnnamed25;
IsoAgLib::iVtObjectKey_c iVtObjectKeyChangeFill;
IsoAgLib::iVtObjectOutputString_c iVtObjectUnnamed26;
IsoAgLib::iVtObjectKey_c iVtObjectKeyUpdatePool;
IsoAgLib::iVtObjectOutputString_c iVtObjectUnnamed27;
IsoAgLib::iVtObjectKey_c iVtObjectKeyChangeLogoPosition;
IsoAgLib::iVtObjectOutputString_c iVtObjectUnnamed28;
IsoAgLib::iVtObjectLineAttributes_c iVtObjectLineAttributes_Normal;
IsoAgLib::iVtObjectFillAttributes_c iVtObjectFillAttributes;
IsoAgLib::iVtObjectEllipse_c iVtObjectdEllipse;
IsoAgLib::iVtObjectPolygon_c iVtObjectdPolygon;
IsoAgLib::iVtObjectMeter_c iVtObjectdMeter;
IsoAgLib::iVtObjectMacro_c iVtObjectMacro_1;
IsoAgLib::iVtObjectMacro_c iVtObjectMacro_2;
IsoAgLib::iVtObjectDataMask_c iVtObjectAnotherMask;
IsoAgLib::iVtObjectOutputString_c iVtObjectUnnamed29;
IsoAgLib::iVtObjectOutputString_c iVtObjectUnnamed30;
IsoAgLib::iVtObjectOutputString_c iVtObjectUnnamed31;
IsoAgLib::iVtObjectOutputString_c iVtObjectUnnamed32;
IsoAgLib::iVtObjectOutputString_c iVtObjectUnnamed33;
IsoAgLib::iVtObjectOutputString_c iVtObjectUnnamed34;
IsoAgLib::iVtObjectOutputString_c iVtObjectUnnamed35;
IsoAgLib::iVtObjectAlarmMask_c iVtObjectForbiddenAlarmMask;
IsoAgLib::iVtObjectContainer_c iVtObjectalarm1contentscontainer;
IsoAgLib::iVtObjectOutputString_c iVtObjectUnnamed36;
IsoAgLib::iVtObjectOutputString_c iVtObjectUnnamed37;
IsoAgLib::iVtObjectOutputString_c iVtObjectUnnamed38;
IsoAgLib::iVtObjectSoftKeyMask_c iVtObjectsoftkeysAlarm;
