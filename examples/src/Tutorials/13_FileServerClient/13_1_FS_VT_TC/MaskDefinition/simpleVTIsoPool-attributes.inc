const IsoAgLib::repeat_vtLanguage_s ivtObjectimiIsoMaskupload_aLanguage [] = {{'e', 'n'}, {'d', 'e'}, {'i', 't'}};
const IsoAgLib::repeat_iVtObject_x_y_iVtObjectFontAttributes_row_col_s iVtObjectimiIsoMaskupload_aObject_x_y_font_row_col [] = {{&iVtObjectUnnamed1, 0, 0, NULL ,0, 0}, {&iVtObjectUnnamed2, 0, 8, NULL ,0, 0}};
const IsoAgLib::iVtObject_c::iVtObjectWorkingSet_s iVtObjectimiIsoMaskupload_sROM = {65534, 1, 1, &iVtObjectMainMask, 2,iVtObjectimiIsoMaskupload_aObject_x_y_font_row_col, 0,NULL, 3,ivtObjectimiIsoMaskupload_aLanguage};
const IsoAgLib::iVtObject_c::iVtObjectOutputString_s iVtObjectUnnamed1_sROM = {65533, 60, 8, 1, &iVtObjectFontAttributesSKM6x8, 2, NULL, 0, 8, "IsoAgLib", 0,NULL};
const IsoAgLib::iVtObject_c::iVtObjectOutputString_s iVtObjectUnnamed2_sROM = {65532, 60, 16, 1, &iVtObjectFontAttributesSKM6x8, 2, NULL, 0, 12, "Tutorial 3.0", 0,NULL};
const IsoAgLib::iVtObject_c::iVtObjectFontAttributes_s iVtObjectFontAttributesNormal6x8_sROM = {65531, 0, 0, 0, 0, 0,NULL};
const IsoAgLib::iVtObject_c::iVtObjectFontAttributes_s iVtObjectFontAttributesNormal6x8LangDep_sROM = {65530, 0, 0, 0, 0, 0,NULL};
const IsoAgLib::iVtObject_c::iVtObjectFontAttributes_s iVtObjectFontAttributesNormal6x8LangDep_1_sROM = {65530, 12, 0, 1, 0, 0,NULL};
const IsoAgLib::iVtObject_c::iVtObjectFontAttributes_s iVtObjectFontAttributesNormal6x8LangDep_2_sROM = {65530, 9, 0, 1, 0, 0,NULL};
const IsoAgLib::iVtObject_c::iVtObjectFontAttributes_s iVtObjectFontAttributesNormal8x12_sROM = {65529, 0, 2, 0, 0, 0,NULL};
const IsoAgLib::iVtObject_c::iVtObjectFontAttributes_s iVtObjectFontAttributesNormal6x8R_sROM = {65528, 12, 0, 0, 0, 0,NULL};
const IsoAgLib::iVtObject_c::iVtObjectFontAttributes_s iVtObjectFontAttributesNormal6x8B_sROM = {65527, 9, 0, 0, 13, 0,NULL};
const IsoAgLib::iVtObject_c::iVtObjectFontAttributes_s iVtObjectFontAttributesNormal8x8_sROM = {65526, 0, 1, 0, 0, 0,NULL};
const IsoAgLib::iVtObject_c::iVtObjectFontAttributes_s iVtObjectFontAttributesNormal12x16_sROM = {65525, 0, 3, 0, 0, 0,NULL};
const IsoAgLib::iVtObject_c::iVtObjectFontAttributes_s iVtObjectFontAttributesNormal16x16_sROM = {65524, 0, 4, 0, 0, 0,NULL};
const IsoAgLib::iVtObject_c::iVtObjectFontAttributes_s iVtObjectFontAttributesNormal16x24_sROM = {65523, 0, 5, 0, 0, 0,NULL};
const IsoAgLib::iVtObject_c::iVtObjectFontAttributes_s iVtObjectFontAttributesNormal24x32_sROM = {65522, 0, 6, 0, 0, 0,NULL};
const IsoAgLib::iVtObject_c::iVtObjectLineAttributes_s iVtObjectLineAttributesNormal_sROM = {65521, 0, 1, 0xffff, 0,NULL};
const IsoAgLib::iVtObject_c::iVtObjectLineAttributes_s iVtObjectLineAttributesDotted_sROM = {65520, 0, 1, 0x9999, 0,NULL};
const IsoAgLib::iVtObject_c::iVtObjectFontAttributes_s iVtObjectFontAttributesSKM6x8_sROM = {65519, 0, 0, 0, 0, 0,NULL};
const IsoAgLib::iVtObject_c::iVtObjectFontAttributes_s iVtObjectFontAttributesSKM8x8_sROM = {65518, 0, 1, 0, 0, 0,NULL};
const IsoAgLib::iVtObject_c::iVtObjectFontAttributes_s iVtObjectFontAttributesSKM12x16_sROM = {65517, 0, 3, 0, 0, 0,NULL};
const IsoAgLib::iVtObject_c::iVtObjectLineAttributes_s iVtObjectLineAttributesSKM_sROM = {65516, 0, 1, 0xffff, 0,NULL};
const IsoAgLib::iVtObject_c::iVtObjectFontAttributes_s iVtObjectFontAttributesNormal6x8_Button60x30_sROM = {65515, 0, 0, 0, 0, 0,NULL};
const IsoAgLib::iVtObject_c::iVtObjectNumberVariable_s iVtObjectValSpeed_sROM = {65514, 0UL};
const IsoAgLib::iVtObject_c::iVtObjectNumberVariable_s iVtObjectValAccel_sROM = {65513, 10UL};
const IsoAgLib::iVtObject_c::iVtObjectNumberVariable_s iVtObjectValMiles_sROM = {1234, 0UL};
const IsoAgLib::iVtObject_c::iVtObjectStringVariable_s iVtObjectStrNone_sROM = {65512, 14, "none selected!"};
const IsoAgLib::iVtObject_c::iVtObjectStringVariable_s iVtObjectStrNone_1_sROM = {65512, 17, "nichts ausgewählt"};
const IsoAgLib::iVtObject_c::iVtObjectStringVariable_s iVtObjectStrNone_2_sROM = {65512, 19, "niente selezionato!"};
const IsoAgLib::iVtObject_c::iVtObjectStringVariable_s iVtObjectStrRed_sROM = {65511, 3, "red"};
const IsoAgLib::iVtObject_c::iVtObjectStringVariable_s iVtObjectStrRed_1_sROM = {65511, 3, "rot"};
const IsoAgLib::iVtObject_c::iVtObjectStringVariable_s iVtObjectStrRed_2_sROM = {65511, 5, "rosso"};
const IsoAgLib::iVtObject_c::iVtObjectStringVariable_s iVtObjectStrGreen_sROM = {65510, 5, "green"};
const IsoAgLib::iVtObject_c::iVtObjectStringVariable_s iVtObjectStrBlue_sROM = {65509, 4, "blue"};
const IsoAgLib::iVtObject_c::iVtObjectStringVariable_s iVtObjectStrYellow_sROM = {65508, 6, "yellow"};
const IsoAgLib::iVtObject_c::iVtObjectStringVariable_s iVtObjectStrCyan_sROM = {65507, 4, "cyan"};
const IsoAgLib::iVtObject_c::iVtObjectStringVariable_s iVtObjectStrMagenta_sROM = {65506, 7, "magenta"};
const IsoAgLib::iVtObject_c::iVtObjectStringVariable_s iVtObjectStrBlack_sROM = {65505, 5, "black"};
const IsoAgLib::iVtObject_c::iVtObjectStringVariable_s iVtObjectStrWhite_sROM = {65504, 5, "white"};
const IsoAgLib::iVtObject_c::iVtObjectOutputString_s iVtObjectLikeIt_sROM = {65503, 200, 8, 1, &iVtObjectFontAttributesNormal6x8, 0, NULL, 0, 20, "That makes me happy.", 0,NULL};
const IsoAgLib::iVtObject_c::iVtObjectOutputString_s iVtObjectLikeItNot_sROM = {65502, 200, 8, 1, &iVtObjectFontAttributesNormal6x8, 0, NULL, 0, 20, "What did I do wrong?", 0,NULL};
const IsoAgLib::repeat_iVtObject_x_y_iVtObjectFontAttributes_row_col_s iVtObjectcontainerInAllMasks_aObject_x_y_font_row_col [] = {{&iVtObjectUnnamed3, 5, 5, NULL ,0, 0}, {&iVtObjectBigLogo, 0, 0, NULL ,0, 0}, {&iVtObjectleine, 0, 27, NULL ,0, 0}};
const IsoAgLib::iVtObject_c::iVtObjectContainer_s iVtObjectcontainerInAllMasks_sROM = {65501, 200, 30, 0, 3,iVtObjectcontainerInAllMasks_aObject_x_y_font_row_col, 0,NULL};
const IsoAgLib::iVtObject_c::iVtObjectRectangle_s iVtObjectUnnamed3_sROM = {65500, &iVtObjectLineAttributesDotted, 190, 15, 0, NULL, 0,NULL};
const HUGE_MEM uint8_t iVtObjectBigLogo_aRawBitmap0 [] = { /* Raw-Bitmap Data */ 255, 255, 255, 255, 255, 255, 255, 240, 0, 192, 0, 14, 0, 255, 255, 255, 255, 255, 255, 255, 240, 0, 192, 0, 14, 0, 255, 255, 255, 255, 255, 248, 127, 240, 0, 192, 0, 14, 0, 255, 255, 255, 255, 248, 112, 63, 240, 0, 192, 0, 14, 0, 224, 119, 231, 255, 248, 99, 159, 240, 0, 192, 0, 14, 0, 224, 103, 231, 254, 0, 119, 159, 240, 0, 192, 0, 14, 0, 249, 228, 230, 30, 0, 124, 31, 240, 0, 192, 0, 14, 0, 249, 224, 100, 94, 0, 113, 159, 240, 0, 192, 0, 14, 0, 249, 230, 100, 62, 0, 227, 159, 240, 0, 192, 0, 14, 0, 249, 230, 102, 30, 0, 231, 159, 255, 255, 248, 0, 15, 255, 249, 230, 103, 207, 255, 231, 31, 247, 255, 248, 0, 3, 255, 249, 230, 100, 31, 255, 224, 15, 195, 31, 255, 255, 255, 255, 253, 246, 239, 63, 63, 251, 15, 137, 31, 255, 255, 255, 255, 255, 255, 255, 255, 63, 255, 3, 137, 15, 24, 248, 252, 127, 255, 255, 240, 63, 253, 255, 0, 193, 6, 0, 96, 112, 63, 252, 0, 240, 62, 48, 63, 0, 195, 4, 0, 32, 48, 31, 252, 0, 240, 63, 51, 191, 24, 99, 28, 102, 2, 3, 144, 252, 0, 0, 7, 48, 127, 24, 99, 60, 102, 7, 3, 0, 252, 0, 0, 7, 60, 63, 0, 99, 28, 34, 0, 0, 16, 252, 0, 0, 7, 55, 159, 0, 227, 132, 0, 32, 0, 31, 255, 128, 0, 7, 48, 63, 1, 227, 196, 0, 48, 0, 63, 255, 128, 0, 6, 28, 255, 247, 231, 246, 102, 123, 32, 255, 255, 128, 0, 7, 255, 255, 255, 255, 255, 255, 255, 225, 255, 255, 255, 255, 255, 255, 255, 255, 255, 255, 255, 255, 225, 255, 255, 255, 255, 255, 255, 255, 255, 255, 255, 255, 255, 243, 255};
const HUGE_MEM uint8_t iVtObjectBigLogo_aRawBitmap2 [] = { /* RLE-Encoded Raw-Bitmap Data */ 60, 1,12, 180,2, 51,10, 56,8, 180,3, 11,5, 180,60, 1,12, 180,2, 51,10, 56,8, 180,3, 11,5, 180,45, 1,1, 8,3, 102,1, 7,10, 1,12, 180,2, 51,10, 56,8, 180,3, 11,5, 180,37, 1,4, 168,2, 1,1, 7,2, 59,2, 8,1, 59,1, 0,1, 7,9, 1,12, 180,2, 51,10, 56,8, 2,3, 11,5, 180,2, 1,1, 7,6, 102,1, 7,2, 1,1, 8,6, 1,1, 59,1, 102,16, 1,4, 168,2, 1,1, 102,1, 0,1, 8,2, 1,1, 7,1, 0,1, 102,9, 1,12, 180,2, 51,10, 56,8, 2,3, 11,5, 180,2, 1,1, 7,2, 8,1, 59,1, 0,2, 8,1, 7,1, 1,1, 102,1, 0,6, 1,1, 102,1, 8,10, 1,6, 139,4, 168,2, 1,1, 7,1, 8,1, 7,3, 1,1, 0,1, 102,9, 1,12, 180,2, 51,10, 56,8, 2,3, 11,5, 180,5, 1,1, 102,1, 0,4, 1,1, 102,1, 0,1, 7,2, 102,3, 1,1, 0,1, 102,2, 1,1, 102,2, 0,1, 59,1, 7,3, 1,6, 139,4, 168,5, 1,1, 8,2, 102,1, 0,1, 102,9, 1,12, 180,2, 51,10, 56,8, 2,3, 11,5, 180,5, 1,1, 102,1, 0,4, 1,1, 102,1, 0,1, 102,1, 8,1, 0,1, 102,2, 1,1, 0,1, 102,1, 1,1, 8,1, 0,1, 8,1, 1,1, 8,4, 1,6, 139,4, 168,3, 1,1, 102,1, 0,1, 102,1, 7,1, 1,1, 0,1, 102,9, 1,12, 180,2, 51,10, 56,8, 2,3, 11,5, 180,5, 1,1, 102,1, 0,4, 1,1, 102,1, 0,1, 7,1, 1,1, 0,1, 102,2, 1,1, 0,1, 102,1, 1,1, 8,1, 0,1, 59,1, 102,1, 7,4, 1,9, 139,3, 1,1, 102,1, 0,1, 8,3, 1,1, 0,1, 102,9, 1,12, 180,2, 51,3, 180,15, 2,3, 11,5, 180,5, 1,1, 102,1, 0,4, 1,1, 102,1, 0,2, 1,1, 0,1, 102,2, 1,1, 0,1, 102,2, 1,1, 8,1, 59,2, 0,1, 7,3, 1,9, 139,3, 1,2, 0,4, 1,1, 0,1, 102,21, 1,2, 51,3, 1,15, 2,3, 11,10, 1,1, 102,1, 0,4, 1,1, 102,1, 0,2, 1,1, 0,1, 102,2, 1,1, 0,1, 102,4, 1,1, 7,1, 0,1, 102,15, 1,1, 59,1, 0,1, 7,2, 1,1, 102,1, 0,1, 59,1, 7,7, 1,1, 7,1, 8,16, 1,17, 2,11, 1,1, 102,1, 0,4, 1,1, 102,1, 0,2, 1,1, 0,1, 102,2, 1,1, 0,1, 102,1, 1,1, 8,1, 59,1, 102,1, 59,1, 0,1, 7,15, 1,1, 8,2, 0,1, 102,2, 59,2, 0,1, 102,6, 1,1, 102,1, 0,1, 102,1, 59,1, 7,1, 1,3, 102,38, 1,1, 7,1, 8,4, 1,1, 7,1, 8,2, 1,1, 8,1, 7,2, 1,1, 8,1, 7,2, 1,1, 7,2, 8,6, 1,2, 8,10, 1,1, 7,1, 8,1, 7,1, 1,1, 102,2, 0,1, 102,5, 1,1, 8,1, 102,1, 8,1, 7,2, 102,1, 1,3, 0,65, 1,1, 102,1, 59,14, 1,1, 102,2, 0,1, 8,2, 102,1, 7,2, 1,1, 8,1, 59,1, 8,1, 1,1, 102,1, 59,1, 1,3, 0,1, 102,1, 7,2, 1,1, 7,2, 102,1, 8,1, 1,1, 7,2, 102,1, 8,4, 1,1, 7,2, 102,1, 8,1, 7,4, 1,1, 7,2, 102,1, 8,1, 7,22, 1,6, 106,6, 1,2, 7,3, 1,1, 7,1, 8,1, 7,8, 1,1, 102,2, 0,1, 59,3, 0,1, 8,1, 1,1, 7,1, 0,1, 8,3, 102,1, 1,4, 0,1, 8,1, 1,1, 7,1, 59,3, 0,1, 59,4, 0,1, 102,2, 1,1, 8,4, 0,1, 59,1, 7,2, 1,1, 8,1, 0,1, 59,2, 0,1, 59,1, 7,7, 1,10, 49,4, 1,6, 106,5, 1,1, 8,1, 59,1, 102,2, 1,1, 8,1, 59,2, 8,1, 59,1, 8,6, 1,1, 102,2, 0,1, 102,4, 0,1, 7,1, 1,1, 8,1, 59,1, 0,1, 102,2, 1,3, 0,2, 8,1, 1,1, 102,2, 0,1, 102,1, 0,1, 59,1, 0,1, 102,1, 0,1, 59,1, 0,1, 8,1, 7,3, 0,1, 59,1, 102,1, 0,1, 59,1, 1,1, 7,2, 0,1, 8,4, 59,7, 1,10, 49,4, 1,6, 106,6, 1,2, 102,2, 1,1, 0,1, 8,2, 1,1, 7,1, 102,6, 1,1, 102,2, 0,2, 7,1, 8,2, 0,1, 8,2, 1,2, 0,1, 102,2, 1,2, 0,1, 59,1, 1,1, 7,1, 1,1, 102,1, 0,1, 59,2, 7,1, 102,1, 59,2, 7,1, 8,1, 0,1, 102,1, 8,1, 0,1, 59,1, 8,1, 7,1, 102,2, 0,1, 8,1, 102,1, 0,1, 59,3, 7,2, 0,1, 7,6, 1,10, 49,4, 137,6, 106,3, 137,3, 1,2, 102,2, 1,1, 102,1, 0,1, 59,1, 102,1, 8,1, 7,6, 1,1, 102,1, 0,1, 8,1, 7,1, 1,1, 8,2, 0,1, 8,2, 1,2, 0,1, 102,2, 1,1, 0,1, 59,1, 7,3, 1,1, 102,1, 59,1, 8,2, 1,1, 102,1, 8,2, 1,1, 102,1, 0,2, 102,2, 0,1, 7,1, 1,1, 7,1, 102,1, 0,1, 8,1, 102,1, 59,1, 8,2, 1,1, 102,2, 0,1, 8,6, 1,10, 49,4, 137,6, 106,3, 137,3, 1,2, 102,1, 1,2, 7,1, 1,1, 8,1, 102,1, 59,1, 0,1, 7,5, 1,1, 102,2, 0,1, 8,2, 102,1, 59,1, 0,1, 8,2, 1,2, 0,1, 102,2, 1,1, 59,2, 0,2, 7,1, 1,1, 102,2, 0,1, 8,1, 7,1, 102,1, 0,1, 8,1, 7,1, 102,1, 0,1, 102,1, 8,1, 0,1, 59,1, 102,1, 8,1, 102,2, 0,1, 8,1, 102,2, 0,1, 8,1, 102,1, 8,1, 59,1, 0,1, 7,6, 1,10, 49,4, 137,6, 106,3, 137,3, 1,2, 102,2, 1,1, 102,4, 1,1, 0,1, 8,5, 1,1, 102,2, 0,1, 59,3, 0,1, 59,3, 1,2, 0,1, 102,2, 1,1, 7,2, 0,1, 102,1, 59,1, 1,1, 102,2, 0,2, 8,2, 0,2, 8,2, 0,1, 102,1, 7,1, 59,6, 0,1, 8,1, 102,6, 0,1, 59,10, 1,11, 137,6, 106,3, 137,3, 1,2, 59,2, 1,1, 59,1, 102,2, 8,1, 59,1, 102,6, 1,2, 102,1, 59,3, 0,1, 59,1, 7,3, 1,2, 0,1, 102,3, 1,1, 7,1, 59,2, 0,1, 7,1, 102,2, 0,2, 8,2, 0,2, 8,2, 0,1, 102,1, 1,1, 7,1, 59,2, 0,1, 59,2, 0,1, 8,1, 102,2, 0,1, 59,2, 0,1, 59,1, 7,10, 1,20, 137,2, 1,4, 8,3, 1,2, 8,1, 7,10, 1,1, 7,1, 8,1, 7,5, 1,2, 8,1, 7,5, 1,1, 7,1, 8,1, 1,1, 7,2, 8,2, 7,2, 8,2, 7,2, 8,1, 7,3, 1,1, 8,2, 7,2, 8,1, 7,1, 102,2, 0,2, 8,1, 7,12, 1,20, 137,62, 1,1, 102,2, 0,1, 8,96, 1,1, 102,2, 0,1, 8,96, 1,1, 7,2, 8,1, 7,5, 1};
const HUGE_MEM uint8_t iVtObjectBigLogo_aRawBitmap1Fixed0 [] = { /* RLE-Encoded Raw-Bitmap Data */ 255, 17,12, 17,1, 24,1, 136,1, 135,12, 17,1, 28,2, 204,1, 193,40, 17,1, 23,1, 0,1, 136,1, 12,1, 193,8, 17,1, 193,2, 17,1, 28,1, 193,1, 17,1, 193,1, 17,1, 28,18, 17,1, 120,2, 136,1, 135,1, 17,1, 129,2, 17,1, 16,1, 129,10, 17,1, 24,1, 8,1, 17,1, 124,1, 193,8, 17,1, 193,2, 17,1, 28,2, 17,1, 193,1, 17,1, 204,2, 17,1, 28,1, 204,14, 17,1, 120,1, 128,1, 8,1, 135,1, 24,1, 1,2, 17,1, 24,1, 129,10, 17,1, 23,1, 135,1, 17,1, 16,1, 129,8, 17,1, 193,5, 17,1, 193,1, 17,1, 193,2, 17,2, 28,15, 17,1, 24,1, 1,1, 17,1, 24,1, 7,1, 136,1, 17,1, 16,1, 129,1, 24,1, 0,1, 7,9, 17,1, 136,1, 128,1, 129,8, 17,1, 193,4, 17,1, 28,1, 193,1, 17,1, 193,2, 17,1, 193,1, 28,15, 17,1, 24,1, 1,1, 17,1, 24,1, 8,1, 128,1, 129,1, 16,1, 129,1, 128,2, 129,8, 17,1, 128,1, 135,1, 16,1, 129,1, 17,1, 28,1, 204,1, 193,3, 17,1, 28,1, 193,4, 17,1, 204,2, 17,1, 193,1, 28,1, 17,1, 193,1, 28,15, 17,1, 24,1, 1,1, 17,1, 24,1, 204,1, 192,1, 129,1, 16,1, 129,1, 128,1, 8,1, 113,7, 17,1, 24,1, 8,1, 17,1, 16,1, 193,1, 17,2, 28,1, 193,3, 17,1, 28,4, 17,1, 28,1, 193,2, 17,2, 204,1, 17,1, 193,1, 17,1, 193,14, 17,1, 24,1, 1,1, 17,1, 24,1, 193,1, 204,1, 129,1, 16,1, 129,1, 24,1, 0,1, 7,7, 17,1, 16,1, 1,1, 17,1, 16,1, 193,1, 17,2, 28,1, 193,3, 17,1, 28,3, 17,1, 28,1, 193,3, 17,1, 28,1, 204,2, 193,1, 28,1, 193,14, 17,1, 24,1, 1,1, 17,1, 24,1, 193,1, 28,1, 129,1, 16,1, 129,1, 17,1, 23,1, 8,6, 17,1, 204,1, 192,1, 7,1, 17,1, 128,1, 199,1, 17,1, 204,1, 28,1, 199,1, 129,2, 17,1, 28,3, 17,1, 28,5, 17,1, 193,1, 17,1, 193,1, 28,15, 17,1, 24,1, 1,1, 17,1, 24,1, 193,1, 28,1, 129,1, 16,1, 129,2, 128,1, 7,6, 17,1, 193,1, 24,1, 0,1, 128,1, 0,1, 200,1, 17,1, 193,1, 28,1, 192,1, 128,1, 113,1, 136,1, 193,3, 17,1, 28,2, 204,1, 193,2, 17,1, 193,1, 28,1, 17,1, 204,15, 17,1, 23,1, 129,1, 17,1, 23,1, 193,1, 24,1, 113,1, 24,2, 204,1, 136,1, 17,1, 28,2, 204,2, 17,1, 28,2, 17,1, 120,1, 113,1, 128,1, 200,1, 17,1, 193,1, 28,1, 200,1, 120,1, 129,1, 0,1, 193,8, 17,1, 28,1, 193,1, 28,1, 17,1, 193,19, 17,1, 193,2, 17,1, 28,1, 17,1, 28,2, 17,1, 204,1, 17,1, 140,1, 193,1, 17,1, 28,4, 17,1, 128,1, 200,1, 136,1, 193,1, 28,1, 200,1, 24,1, 1,1, 12,1, 200,1, 113,1, 23,1, 136,1, 129,1, 120,1, 136,2, 17,1, 124,1, 136,1, 124,1, 17,1, 199,1, 136,1, 135,17, 17,1, 193,1, 17,2, 28,1, 17,1, 28,2, 17,1, 193,1, 17,1, 119,1, 193,1, 23,1, 199,3, 17,1, 193,1, 128,1, 204,1, 0,1, 200,1, 28,1, 204,1, 200,1, 129,1, 204,1, 0,1, 129,1, 112,4, 0,1, 129,1, 24,1, 204,1, 0,1, 12,1, 204,1, 192,2, 0,1, 113,16, 17,1, 204,2, 17,1, 204,1, 17,1, 28,1, 17,1, 28,3, 204,1, 193,1, 128,1, 200,1, 8,1, 17,1, 28,1, 193,1, 128,1, 12,1, 0,1, 192,1, 193,1, 128,1, 8,1, 17,2, 204,1, 193,1, 128,1, 8,1, 0,1, 8,1, 0,1, 8,1, 112,1, 0,1, 8,1, 0,1, 23,1, 0,1, 128,1, 0,1, 1,14, 17,1, 193,2, 17,1, 204,1, 17,1, 204,1, 17,1, 28,2, 17,1, 193,1, 17,1, 136,1, 17,1, 8,2, 204,1, 17,1, 204,1, 17,1, 128,1, 12,1, 120,1, 204,1, 193,1, 16,1, 8,1, 17,1, 0,1, 1,1, 113,1, 128,1, 7,1, 120,1, 7,1, 120,1, 8,1, 128,1, 8,1, 120,1, 0,1, 136,1, 0,1, 119,1, 112,1, 7,14, 17,1, 204,2, 17,1, 28,1, 17,1, 204,1, 17,1, 204,2, 17,3, 204,1, 17,1, 128,1, 8,1, 140,1, 204,2, 17,1, 128,1, 135,1, 24,1, 0,1, 129,1, 16,1, 8,1, 17,1, 0,1, 113,1, 17,1, 128,1, 129,1, 24,1, 129,1, 24,1, 8,1, 128,1, 7,1, 23,1, 128,1, 136,1, 8,1, 17,1, 128,1, 8,14, 17,1, 28,2, 17,1, 204,1, 17,2, 204,1, 193,4, 17,1, 136,1, 23,1, 113,1, 136,1, 0,1, 113,2, 17,1, 128,1, 8,1, 136,1, 0,1, 129,1, 16,1, 8,1, 17,1, 0,1, 7,1, 113,1, 128,1, 8,1, 120,1, 8,1, 120,1, 8,1, 128,1, 8,1, 136,1, 0,1, 136,1, 0,1, 136,1, 128,1, 7,14, 17,1, 28,2, 204,1, 193,1, 17,1, 28,6, 17,1, 136,1, 17,1, 129,1, 17,1, 16,1, 129,2, 17,1, 128,3, 0,1, 17,1, 16,1, 8,1, 17,1, 112,1, 8,1, 1,1, 128,1, 8,1, 128,1, 8,1, 128,1, 8,1, 112,3, 0,1, 136,3, 0,1, 1,19, 17,1, 28,6, 17,1, 0,1, 17,1, 8,1, 136,1, 8,3, 17,1, 136,2, 0,1, 7,1, 17,1, 16,1, 8,1, 17,1, 23,1, 0,1, 7,1, 128,1, 8,1, 128,1, 8,1, 128,1, 8,1, 23,3, 0,1, 136,3, 0,1, 113,19, 17,1, 28,1, 193,4, 17,1, 24,1, 136,1, 129,1, 17,1, 136,1, 113,4, 17,1, 23,1, 135,2, 17,1, 24,1, 135,2, 17,1, 23,1, 129,1, 120,1, 135,1, 120,1, 135,1, 120,1, 135,1, 17,1, 24,1, 119,1, 136,1, 120,1, 0,1, 136,1, 113,20, 17,1, 28,1, 193,34, 17,1, 24,1, 0,1, 129,22, 17,1, 193,34, 17,1, 24,1, 0,1, 129,22, 17,1, 193,34, 17,1, 23,1, 136,1, 113,187, 17};
const IsoAgLib::repeat_rawData_rawBytes_actWidth_actHeight_formatoptions_s iVtObjectBigLogo_aFixedBitmaps [] = {{iVtObjectBigLogo_aRawBitmap1Fixed0, 1328, 120, 30, (1 << 6) | 7}};
const IsoAgLib::iVtObject_c::iVtObjectPictureGraphic_s iVtObjectBigLogo_sROM = {65499, 100, 100,25, 2, 27, 1, 325,iVtObjectBigLogo_aRawBitmap0, 0,NULL, 1514,iVtObjectBigLogo_aRawBitmap2, 1,iVtObjectBigLogo_aFixedBitmaps, 0,NULL};
const IsoAgLib::iVtObject_c::iVtObjectLine_s iVtObjectleine_sROM = {65498, &iVtObjectLineAttributesNormal, 200, 1, 0, 0,NULL};
const IsoAgLib::repeat_iVtObject_x_y_iVtObjectFontAttributes_row_col_s iVtObjectKeyReset_aObject_x_y_font_row_col [] = {{&iVtObjectresetTextOS, 0, 12, NULL ,0, 0}};
const IsoAgLib::iVtObject_c::iVtObjectKey_s iVtObjectKeyReset_sROM = {65497, 1, 254, 1,iVtObjectKeyReset_aObject_x_y_font_row_col, 0,NULL};
const IsoAgLib::iVtObject_c::iVtObjectOutputString_s iVtObjectresetTextOS_sROM = {65496, 60, 8, 1, &iVtObjectFontAttributesSKM6x8, 0, NULL, 1, 10, NULL, 0,NULL};
const IsoAgLib::iVtObject_c::iVtObjectOutputString_s iVtObjectresetTextOS_1_sROM = {65496, 60, 8, 1, &iVtObjectFontAttributesSKM6x8, 0, NULL, 1, 10, NULL, 0,NULL};
const IsoAgLib::iVtObject_c::iVtObjectOutputString_s iVtObjectresetTextOS_2_sROM = {65496, 60, 8, 1, &iVtObjectFontAttributesSKM6x8, 0, NULL, 1, 10, NULL, 0,NULL};
const IsoAgLib::iVtObject_c::iVtObjectInputNumber_s iVtObjectInputMiles_sROM = {65495, 36, 8, 1, &iVtObjectFontAttributesNormal6x8R, 0, NULL, 0UL, 0UL, 999999UL, 0L, 1, 0, 0, 0, 1, 0,NULL};
const IsoAgLib::repeat_iVtObject_x_y_iVtObjectFontAttributes_row_col_s iVtObjectMainMask_aObject_x_y_font_row_col [] = {{&iVtObjectmask1contentscontainer, 0, 30, NULL ,0, 0}, {&iVtObjectcontainerInAllMasks, 0, 0, NULL ,0, 0}};
const IsoAgLib::iVtObject_c::iVtObjectDataMask_s iVtObjectMainMask_sROM = {1101, 1, &iVtObjectsoftkeys1, 2,iVtObjectMainMask_aObject_x_y_font_row_col, 0,NULL};
const IsoAgLib::repeat_iVtObject_x_y_iVtObjectFontAttributes_row_col_s iVtObjectmask1contentscontainer_aObject_x_y_font_row_col [] = {{&iVtObjectUnnamed4, 4, 14, NULL ,0, 0}, {&iVtObjectspeedLabel, 4, 27, NULL ,0, 0}, {&iVtObjectUnnamed5, 4, 55, NULL ,0, 0}, {&iVtObjectUnnamed6, 4, 10, &iVtObjectFontAttributesNormal6x8LangDep ,0, 9}, {&iVtObjectUnnamed7, 4, 27, &iVtObjectFontAttributesNormal6x8LangDep ,0, 9}, {&iVtObjectUnnamed8, 4, 55, &iVtObjectFontAttributesNormal6x8LangDep ,0, 9}, {&iVtObjectUnnamed9, 4, 36, NULL ,0, 0}, {&iVtObjectColLabel, 4, 100, NULL ,0, 0}, {&iVtObjectColOS, 4, 100, &iVtObjectFontAttributesNormal6x8 ,0, 9}, {&iVtObjectdEllipse, 10, 120, NULL ,0, 0}, {&iVtObjectdPolygon, 100, 120, NULL ,0, 0}, {&iVtObjectdMeter, 128, 10, NULL ,0, 0}, {&iVtObjectAccelArchedBarGraph, 4, 50, &iVtObjectFontAttributesNormal6x8 ,0, 13}, {&iVtObjectOpsFakeMileage, 4, 70, NULL ,0, 0}, {&iVtObjectChangeAwayPointer, 4, 70, &iVtObjectFontAttributesNormal6x8 ,0, 13}, {&iVtObjectOpsFakeMileage, 4, 74, &iVtObjectFontAttributesNormal6x8 ,1, 0}, {&iVtObjectInputListTypFakeMiles, 4, 74, &iVtObjectFontAttributesNormal6x8 ,1, 13}, {&iVtObjectUnnamed10, 4, 2, NULL ,0, 0}, {&iVtObjectUnnamed11, 3, 1, &iVtObjectFontAttributesNormal6x8 ,0, 18}, {&iVtObjectInputLikeage, 4, 2, &iVtObjectFontAttributesNormal6x8 ,0, 18}, {&iVtObjectLikeageOP, 12, 2, &iVtObjectFontAttributesNormal6x8 ,0, 19}, {&iVtObjectKeyMoreAccel, 120, 55, NULL ,0, 0}, {&iVtObjectKeyLessAccel, 120, 90, NULL ,0, 0}, {&iVtObjectvtLang, 120, 125, NULL ,0, 0}, {&iVtObjectOSlanguage, 120, 135, NULL ,0, 0}, {&iVtObjectdriver, 30, 150, NULL ,0, 0}, {&iVtObjectresonible, 10, 160, NULL ,0, 0}, {&iVtObjectISdriver, 80, 150, NULL ,0, 0}, {&iVtObjectOSresonible, 80, 160, NULL ,0, 0}};
const IsoAgLib::iVtObject_c::iVtObjectContainer_s iVtObjectmask1contentscontainer_sROM = {65494, 200, 170, 0, 29,iVtObjectmask1contentscontainer_aObject_x_y_font_row_col, 0,NULL};
const IsoAgLib::iVtObject_c::iVtObjectOutputString_s iVtObjectUnnamed4_sROM = {65493, 66, 8, 1, &iVtObjectFontAttributesNormal6x8LangDep, 0, NULL, 0, 6, "Miles:", 0,NULL};
const IsoAgLib::iVtObject_c::iVtObjectOutputString_s iVtObjectspeedLabel_sROM = {65492, 66, 8, 1, &iVtObjectFontAttributesNormal6x8LangDep, 0, NULL, 0, 8, "Speed is", 0,NULL};
const IsoAgLib::iVtObject_c::iVtObjectOutputString_s iVtObjectUnnamed5_sROM = {65491, 66, 8, 1, &iVtObjectFontAttributesNormal6x8LangDep, 0, NULL, 0, 7, "Accel':", 0,NULL};
const IsoAgLib::iVtObject_c::iVtObjectOutputNumber_s iVtObjectUnnamed6_sROM = {65490, 60, 16, 1, &iVtObjectFontAttributesNormal12x16, 0, &iVtObjectValMiles, 0UL, -10000L, 1, 0, 0, 0, 0,NULL};
const IsoAgLib::iVtObject_c::iVtObjectOutputNumber_s iVtObjectUnnamed7_sROM = {65489, 18, 8, 1, &iVtObjectFontAttributesNormal6x8, 0, &iVtObjectValSpeed, 0UL, -10000L, 1, 0, 0, 0, 0,NULL};
const IsoAgLib::iVtObject_c::iVtObjectOutputNumber_s iVtObjectUnnamed8_sROM = {65488, 24, 8, 1, &iVtObjectFontAttributesNormal8x8, 0, &iVtObjectValAccel, 0UL, -10000L, 1, 0, 0, 0, 0,NULL};
const IsoAgLib::iVtObject_c::iVtObjectLinearBarGraph_s iVtObjectUnnamed9_sROM = {65487, 120, 8, 0, 0, 53, 4, 10000, 10100, &iVtObjectValSpeed, 0, NULL, 0, 0,NULL};
const IsoAgLib::iVtObject_c::iVtObjectOutputString_s iVtObjectColLabel_sROM = {65486, 42, 8, 1, &iVtObjectFontAttributesNormal6x8, 0, NULL, 0, 7, "Color: ", 0,NULL};
const IsoAgLib::iVtObject_c::iVtObjectOutputString_s iVtObjectColOS_sROM = {65485, 100, 8, 1, &iVtObjectFontAttributesNormal6x8, 0, &iVtObjectStrNone, 0, 0, NULL, 0,NULL};
const IsoAgLib::iVtObject_c::iVtObjectArchedBarGraph_s iVtObjectAccelArchedBarGraph_sROM = {65481, 40, 40, 6, 5, 19, 10, 80, 5, +9985, 10015, NULL, +10000, NULL, +10000, 0,NULL};
const IsoAgLib::iVtObject_c::iVtObjectOutputString_s iVtObjectOpsFakeMileage_sROM = {65480, 72, 8, 1, &iVtObjectFontAttributesNormal6x8R, 0, NULL, 0, 12, "Fake Mileage", 0,NULL};
const IsoAgLib::iVtObject_c::iVtObjectObjectPointer_s iVtObjectChangeAwayPointer_sROM = {65479, &iVtObjectInputMiles};
const IsoAgLib::repeat_iVtObject_s iVtObjectInputListTypFakeMiles_aObject [] = {{&iVtObjectUnnamed12}, {&iVtObjectUnnamed13}, {&iVtObjectUnnamed14}, {&iVtObjectUnnamed15}};
const IsoAgLib::iVtObject_c::iVtObjectInputList_s iVtObjectInputListTypFakeMiles_sROM = {65478, 24, 8, NULL, 0, 1, 4,iVtObjectInputListTypFakeMiles_aObject, 0,NULL};
const IsoAgLib::iVtObject_c::iVtObjectOutputNumber_s iVtObjectUnnamed12_sROM = {65465, 24, 8, 1, &iVtObjectFontAttributesNormal6x8, 0, NULL, 6398UL, 0L, 1.0, 0, 0, 0, 0,NULL};
const IsoAgLib::iVtObject_c::iVtObjectOutputNumber_s iVtObjectUnnamed13_sROM = {65464, 24, 8, 1, &iVtObjectFontAttributesNormal6x8, 0, NULL, 8743UL, 0L, 1.0, 0, 0, 0, 0,NULL};
const IsoAgLib::iVtObject_c::iVtObjectOutputNumber_s iVtObjectUnnamed14_sROM = {65463, 24, 8, 1, &iVtObjectFontAttributesNormal6x8, 0, NULL, 3948UL, 0L, 1.0, 0, 0, 0, 0,NULL};
const IsoAgLib::iVtObject_c::iVtObjectOutputNumber_s iVtObjectUnnamed15_sROM = {65462, 24, 8, 1, &iVtObjectFontAttributesNormal6x8, 0, NULL, 9467UL, 0L, 1.0, 0, 0, 0, 0,NULL};
const IsoAgLib::iVtObject_c::iVtObjectOutputString_s iVtObjectUnnamed10_sROM = {65477, 102, 8, 1, &iVtObjectFontAttributesNormal6x8B, 0, NULL, 0, 17, "Do you like this?", 0,NULL};
const IsoAgLib::iVtObject_c::iVtObjectRectangle_s iVtObjectUnnamed11_sROM = {65476, &iVtObjectLineAttributes_Normal, 10, 10, 0, NULL, 0,NULL};
const IsoAgLib::iVtObject_c::iVtObjectInputBoolean_s iVtObjectInputLikeage_sROM = {65475, 1, 8, &iVtObjectFontAttributesNormal6x8, NULL, 0, 1, 0,NULL};
const IsoAgLib::iVtObject_c::iVtObjectObjectPointer_s iVtObjectLikeageOP_sROM = {65474, NULL};
const IsoAgLib::repeat_iVtObject_x_y_iVtObjectFontAttributes_row_col_s iVtObjectKeyMoreAccel_aObject_x_y_font_row_col [] = {{&iVtObjectUnnamed16, 0, 7, NULL ,0, 0}};
const IsoAgLib::iVtObject_c::iVtObjectButton_s iVtObjectKeyMoreAccel_sROM = {65473, 60, 30, 1, 0, 253, 0, 1,iVtObjectKeyMoreAccel_aObject_x_y_font_row_col, 0,NULL};
const IsoAgLib::iVtObject_c::iVtObjectOutputString_s iVtObjectUnnamed16_sROM = {65461, 52, 8, 1, &iVtObjectFontAttributesNormal6x8_Button60x30, 0, NULL, 1, 7, "SpeedUp", 0,NULL};
const IsoAgLib::repeat_iVtObject_x_y_iVtObjectFontAttributes_row_col_s iVtObjectKeyLessAccel_aObject_x_y_font_row_col [] = {{&iVtObjectUnnamed17, 0, 7, NULL ,0, 0}};
const IsoAgLib::iVtObject_c::iVtObjectButton_s iVtObjectKeyLessAccel_sROM = {65472, 60, 30, 1, 0, 252, 0, 1,iVtObjectKeyLessAccel_aObject_x_y_font_row_col, 0,NULL};
const IsoAgLib::iVtObject_c::iVtObjectOutputString_s iVtObjectUnnamed17_sROM = {65460, 52, 8, 1, &iVtObjectFontAttributesNormal6x8_Button60x30, 0, NULL, 1, 5, "Brake", 0,NULL};
const IsoAgLib::iVtObject_c::iVtObjectOutputString_s iVtObjectvtLang_sROM = {65471, 78, 8, 1, &iVtObjectFontAttributesNormal6x8, 0, NULL, 0, 13, "VT's language", 0,NULL};
const IsoAgLib::iVtObject_c::iVtObjectOutputString_s iVtObjectOSlanguage_sROM = {65470, 12, 8, 1, &iVtObjectFontAttributesNormal6x8, 0, NULL, 0, 2, "--", 0,NULL};
const IsoAgLib::iVtObject_c::iVtObjectOutputString_s iVtObjectdriver_sROM = {65469, 45, 8, 1, &iVtObjectFontAttributesNormal6x8, 0, NULL, 1, 7, "Driver:", 0,NULL};
const IsoAgLib::iVtObject_c::iVtObjectOutputString_s iVtObjectresonible_sROM = {65468, 65, 8, 1, &iVtObjectFontAttributesNormal6x8, 0, NULL, 1, 11, "Responible:", 0,NULL};
const IsoAgLib::iVtObject_c::iVtObjectInputString_s iVtObjectISdriver_sROM = {65467, 122, 8, 1, &iVtObjectFontAttributesNormal6x8, NULL, 2, NULL, 1, 20, "put in driver's name", 1, 0,NULL};
const IsoAgLib::iVtObject_c::iVtObjectOutputString_s iVtObjectOSresonible_sROM = {65466, 122, 8, 1, &iVtObjectFontAttributesNormal6x8, 0, NULL, 1, 20, "                    ", 0,NULL};
const IsoAgLib::repeat_iVtObject_s iVtObjectsoftkeys1_aObject [] = {{&iVtObjectKeyReset}, {&iVtObjectKeyMove}, {&iVtObjectKeyLogo}, {&iVtObjectKeyChangeLang}, {&iVtObjectKeyChangeCol}, {&iVtObjectKeyTransCol}, {&iVtObjectKeyForbidden}, {&iVtObjectKeyChangeFill}, {&iVtObjectKeyUpdatePool}, {&iVtObjectKeyChangeLogoPosition}};
const IsoAgLib::iVtObject_c::iVtObjectSoftKeyMask_s iVtObjectsoftkeys1_sROM = {65459, 1, 10,iVtObjectsoftkeys1_aObject, 0,NULL};
const IsoAgLib::repeat_iVtObject_x_y_iVtObjectFontAttributes_row_col_s iVtObjectKeyMove_aObject_x_y_font_row_col [] = {{&iVtObjectUnnamed18, 0, 12, NULL ,0, 0}};
const IsoAgLib::iVtObject_c::iVtObjectKey_s iVtObjectKeyMove_sROM = {65458, 1, 251, 1,iVtObjectKeyMove_aObject_x_y_font_row_col, 0,NULL};
const IsoAgLib::iVtObject_c::iVtObjectOutputString_s iVtObjectUnnamed18_sROM = {65449, 60, 8, 1, &iVtObjectFontAttributesSKM6x8, 0, NULL, 1, 4, "Move", 0,NULL};
const IsoAgLib::repeat_iVtObject_x_y_iVtObjectFontAttributes_row_col_s iVtObjectKeyLogo_aObject_x_y_font_row_col [] = {{&iVtObjectUnnamed19, 0, 12, NULL ,0, 0}};
const IsoAgLib::iVtObject_c::iVtObjectKey_s iVtObjectKeyLogo_sROM = {65457, 1, 250, 1,iVtObjectKeyLogo_aObject_x_y_font_row_col, 0,NULL};
const IsoAgLib::iVtObject_c::iVtObjectOutputString_s iVtObjectUnnamed19_sROM = {65448, 60, 8, 1, &iVtObjectFontAttributesSKM6x8, 0, NULL, 1, 4, "Logo", 0,NULL};
const IsoAgLib::repeat_iVtObject_x_y_iVtObjectFontAttributes_row_col_s iVtObjectKeyChangeLang_aObject_x_y_font_row_col [] = {{&iVtObjectUnnamed20, 0, 12, NULL ,0, 0}};
const IsoAgLib::iVtObject_c::iVtObjectKey_s iVtObjectKeyChangeLang_sROM = {65456, 1, 249, 1,iVtObjectKeyChangeLang_aObject_x_y_font_row_col, 0,NULL};
const IsoAgLib::iVtObject_c::iVtObjectOutputString_s iVtObjectUnnamed20_sROM = {65447, 60, 8, 1, &iVtObjectFontAttributesSKM6x8, 0, NULL, 1, 9, "AE <-> BE", 0,NULL};
const IsoAgLib::repeat_iVtObject_x_y_iVtObjectFontAttributes_row_col_s iVtObjectKeyChangeCol_aObject_x_y_font_row_col [] = {{&iVtObjectUnnamed21, 0, 8, NULL ,0, 0}, {&iVtObjectUnnamed22, 0, 16, NULL ,0, 0}};
const IsoAgLib::iVtObject_c::iVtObjectKey_s iVtObjectKeyChangeCol_sROM = {65455, 1, 248, 2,iVtObjectKeyChangeCol_aObject_x_y_font_row_col, 0,NULL};
const IsoAgLib::iVtObject_c::iVtObjectOutputString_s iVtObjectUnnamed21_sROM = {65446, 60, 8, 1, &iVtObjectFontAttributesSKM6x8, 0, NULL, 1, 6, "Change", 0,NULL};
const IsoAgLib::iVtObject_c::iVtObjectOutputString_s iVtObjectUnnamed22_sROM = {65445, 60, 8, 1, &iVtObjectFontAttributesSKM6x8, 0, NULL, 1, 6, "Colour", 0,NULL};
const IsoAgLib::repeat_iVtObject_x_y_iVtObjectFontAttributes_row_col_s iVtObjectKeyTransCol_aObject_x_y_font_row_col [] = {{&iVtObjectUnnamed23, 0, 8, NULL ,0, 0}, {&iVtObjectUnnamed24, 0, 16, NULL ,0, 0}};
const IsoAgLib::iVtObject_c::iVtObjectKey_s iVtObjectKeyTransCol_sROM = {65454, 1, 247, 2,iVtObjectKeyTransCol_aObject_x_y_font_row_col, 0,NULL};
const IsoAgLib::iVtObject_c::iVtObjectOutputString_s iVtObjectUnnamed23_sROM = {65444, 60, 8, 1, &iVtObjectFontAttributesSKM6x8, 0, NULL, 1, 6, "Change", 0,NULL};
const IsoAgLib::iVtObject_c::iVtObjectOutputString_s iVtObjectUnnamed24_sROM = {65443, 60, 8, 1, &iVtObjectFontAttributesSKM6x8, 0, NULL, 1, 10, "Transp-Col", 0,NULL};
const IsoAgLib::repeat_iVtObject_x_y_iVtObjectFontAttributes_row_col_s iVtObjectKeyForbidden_aObject_x_y_font_row_col [] = {{&iVtObjectUnnamed25, 0, 12, NULL ,0, 0}};
const IsoAgLib::iVtObject_c::iVtObjectKey_s iVtObjectKeyForbidden_sROM = {65453, 1, 246, 1,iVtObjectKeyForbidden_aObject_x_y_font_row_col, 0,NULL};
const IsoAgLib::iVtObject_c::iVtObjectOutputString_s iVtObjectUnnamed25_sROM = {65442, 60, 8, 1, &iVtObjectFontAttributesSKM6x8, 0, NULL, 1, 10, "Forbidden!", 0,NULL};
const IsoAgLib::repeat_iVtObject_x_y_iVtObjectFontAttributes_row_col_s iVtObjectKeyChangeFill_aObject_x_y_font_row_col [] = {{&iVtObjectUnnamed26, 0, 0, NULL ,0, 0}};
const IsoAgLib::iVtObject_c::iVtObjectKey_s iVtObjectKeyChangeFill_sROM = {65452, 1, 245, 1,iVtObjectKeyChangeFill_aObject_x_y_font_row_col, 0,NULL};
const IsoAgLib::iVtObject_c::iVtObjectOutputString_s iVtObjectUnnamed26_sROM = {65441, 60, 32, 1, &iVtObjectFontAttributesSKM6x8, 2, NULL, 1, 22, "Toggle Fill Attributes", 0,NULL};
const IsoAgLib::repeat_iVtObject_x_y_iVtObjectFontAttributes_row_col_s iVtObjectKeyUpdatePool_aObject_x_y_font_row_col [] = {{&iVtObjectUnnamed27, 0, 0, NULL ,0, 0}};
const IsoAgLib::iVtObject_c::iVtObjectKey_s iVtObjectKeyUpdatePool_sROM = {65451, 1, 244, 1,iVtObjectKeyUpdatePool_aObject_x_y_font_row_col, 0,NULL};
const IsoAgLib::iVtObject_c::iVtObjectOutputString_s iVtObjectUnnamed27_sROM = {65440, 60, 32, 1, &iVtObjectFontAttributesSKM6x8, 2, NULL, 1, 26, "Partial Object Pool Update", 0,NULL};
const IsoAgLib::repeat_iVtObject_x_y_iVtObjectFontAttributes_row_col_s iVtObjectKeyChangeLogoPosition_aObject_x_y_font_row_col [] = {{&iVtObjectUnnamed28, 0, 0, NULL ,0, 0}};
const IsoAgLib::iVtObject_c::iVtObjectKey_s iVtObjectKeyChangeLogoPosition_sROM = {65450, 1, 243, 1,iVtObjectKeyChangeLogoPosition_aObject_x_y_font_row_col, 0,NULL};
const IsoAgLib::iVtObject_c::iVtObjectOutputString_s iVtObjectUnnamed28_sROM = {65439, 60, 32, 1, &iVtObjectFontAttributesSKM6x8, 2, NULL, 1, 15, "Reposition Logo", 0,NULL};
const IsoAgLib::iVtObject_c::iVtObjectLineAttributes_s iVtObjectLineAttributes_Normal_sROM = {65438, 0, 1, 0xffff, 0,NULL};
const IsoAgLib::iVtObject_c::iVtObjectFillAttributes_s iVtObjectFillAttributes_sROM = {65437,2, 2, NULL, 0,NULL};
const IsoAgLib::iVtObject_c::iVtObjectEllipse_s iVtObjectdEllipse_sROM = {65484, &iVtObjectLineAttributes_Normal, 64, 32, 2, 0, 1, &iVtObjectFillAttributes, 0,NULL};
const IsoAgLib::repeat_x_y_s iVtObjectdPolygon_aPoints [] = {{0, 20}, {10, 10}, {10, 20}, {0, 10}, {10, 10}, {5, 0}, {0, 10}, {0, 20}, {10, 20}};
const IsoAgLib::iVtObject_c::iVtObjectPolygon_s iVtObjectdPolygon_sROM = {65483, 41, 35, &iVtObjectLineAttributes_Normal, NULL, 0, 9,iVtObjectdPolygon_aPoints, 0,NULL};
const IsoAgLib::iVtObject_c::iVtObjectMeter_s iVtObjectdMeter_sROM = {65482, 40, 161, 0, 15, 13, 31, 157, 112, 10000, 10100, &iVtObjectValSpeed, 0, 0,NULL};
const uint8_t iVtObjectMacro_1_aMacro_Commands [] = {0xA0, 184, 11, 1, 0xFF, 0xFF, 0xFF, 0xFF};
const IsoAgLib::iVtObject_c::iVtObjectMacro_s iVtObjectMacro_1_sROM = {1, 8, iVtObjectMacro_1_aMacro_Commands};
const uint8_t iVtObjectMacro_2_aMacro_Commands [] = {0xA0, 184, 11, 0, 0xFF, 0xFF, 0xFF, 0xFF};
const IsoAgLib::iVtObject_c::iVtObjectMacro_s iVtObjectMacro_2_sROM = {2, 8, iVtObjectMacro_2_aMacro_Commands};
const IsoAgLib::repeat_iVtObject_x_y_iVtObjectFontAttributes_row_col_s iVtObjectAnotherMask_aObject_x_y_font_row_col [] = {{&iVtObjectUnnamed29, 0, 40, NULL ,0, 0}, {&iVtObjectUnnamed30, 0, 50, NULL ,0, 0}, {&iVtObjectUnnamed31, 0, 60, NULL ,0, 0}, {&iVtObjectUnnamed32, 0, 74, NULL ,0, 0}, {&iVtObjectUnnamed33, 0, 92, NULL ,0, 0}, {&iVtObjectUnnamed34, 0, 120, NULL ,0, 0}, {&iVtObjectUnnamed35, 0, 150, NULL ,0, 0}};
const IsoAgLib::iVtObject_c::iVtObjectDataMask_s iVtObjectAnotherMask_sROM = {65436, 1, &iVtObjectsoftkeysAlarm, 7,iVtObjectAnotherMask_aObject_x_y_font_row_col, 0,NULL};
const IsoAgLib::iVtObject_c::iVtObjectOutputString_s iVtObjectUnnamed29_sROM = {65435, 480, 8, 1, &iVtObjectFontAttributesNormal6x8, 0, NULL, 1, 23, "Just Another Mask  6x 8", 0,NULL};
const IsoAgLib::iVtObject_c::iVtObjectOutputString_s iVtObjectUnnamed30_sROM = {65434, 480, 8, 1, &iVtObjectFontAttributesNormal8x8, 0, NULL, 1, 23, "Just Another Mask  8x 8", 0,NULL};
const IsoAgLib::iVtObject_c::iVtObjectOutputString_s iVtObjectUnnamed31_sROM = {65433, 480, 12, 1, &iVtObjectFontAttributesNormal8x12, 0, NULL, 1, 23, "Just Another Mask  8x12", 0,NULL};
const IsoAgLib::iVtObject_c::iVtObjectOutputString_s iVtObjectUnnamed32_sROM = {65432, 480, 16, 1, &iVtObjectFontAttributesNormal12x16, 0, NULL, 1, 23, "Just Another Mask 12x16", 0,NULL};
const IsoAgLib::iVtObject_c::iVtObjectOutputString_s iVtObjectUnnamed33_sROM = {65431, 480, 16, 1, &iVtObjectFontAttributesNormal16x16, 0, NULL, 1, 23, "Just Another Mask 16x16", 0,NULL};
const IsoAgLib::iVtObject_c::iVtObjectOutputString_s iVtObjectUnnamed34_sROM = {65430, 480, 24, 1, &iVtObjectFontAttributesNormal16x24, 0, NULL, 1, 23, "Just Another Mask 16x24", 0,NULL};
const IsoAgLib::iVtObject_c::iVtObjectOutputString_s iVtObjectUnnamed35_sROM = {65429, 480, 32, 1, &iVtObjectFontAttributesNormal24x32, 0, NULL, 1, 23, "Just Another Mask 24x32", 0,NULL};
const IsoAgLib::repeat_iVtObject_x_y_iVtObjectFontAttributes_row_col_s iVtObjectForbiddenAlarmMask_aObject_x_y_font_row_col [] = {{&iVtObjectcontainerInAllMasks, 0, 0, NULL ,0, 0}, {&iVtObjectalarm1contentscontainer, 0, 30, NULL ,0, 0}};
const IsoAgLib::iVtObject_c::iVtObjectAlarmMask_s iVtObjectForbiddenAlarmMask_sROM = {65428, 1, &iVtObjectsoftkeysAlarm, 2, 1, 2,iVtObjectForbiddenAlarmMask_aObject_x_y_font_row_col, 0,NULL};
const IsoAgLib::repeat_iVtObject_x_y_iVtObjectFontAttributes_row_col_s iVtObjectalarm1contentscontainer_aObject_x_y_font_row_col [] = {{&iVtObjectUnnamed36, 0, 12, NULL ,0, 0}, {&iVtObjectUnnamed37, 0, 40, NULL ,0, 0}, {&iVtObjectUnnamed38, 0, 55, NULL ,0, 0}};
const IsoAgLib::iVtObject_c::iVtObjectContainer_s iVtObjectalarm1contentscontainer_sROM = {65427, 200, 170, 0, 3,iVtObjectalarm1contentscontainer_aObject_x_y_font_row_col, 0,NULL};
const IsoAgLib::iVtObject_c::iVtObjectOutputString_s iVtObjectUnnamed36_sROM = {65426, 200, 16, 1, &iVtObjectFontAttributesNormal12x16, 0, NULL, 1, 5, "ALARM", 0,NULL};
const IsoAgLib::iVtObject_c::iVtObjectOutputString_s iVtObjectUnnamed37_sROM = {65425, 200, 8, 1, &iVtObjectFontAttributesNormal6x8, 0, NULL, 0, 27, "I told you it is forbidden!", 0,NULL};
const IsoAgLib::iVtObject_c::iVtObjectOutputString_s iVtObjectUnnamed38_sROM = {65424, 200, 8, 1, &iVtObjectFontAttributesNormal6x8, 0, NULL, 2, 25, "(Press ESC to go back...)", 0,NULL};
const IsoAgLib::iVtObject_c::iVtObjectSoftKeyMask_s iVtObjectsoftkeysAlarm_sROM = {65423, 1, 0,NULL, 0,NULL};
