#define iVtObjectIDimiIsoMaskupload 65534
#define iVtObjectIDUnnamed1 65533
#define iVtObjectIDUnnamed2 65532
#define iVtObjectIDFontAttributesNormal6x8 65531
#define iVtObjectIDFontAttributesNormal6x8LangDep 65530
#define iVtObjectIDFontAttributesNormal6x8LangDep_1 65530
#define iVtObjectIDFontAttributesNormal6x8LangDep_2 65530
#define iVtObjectIDFontAttributesNormal8x12 65529
#define iVtObjectIDFontAttributesNormal6x8R 65528
#define iVtObjectIDFontAttributesNormal6x8B 65527
#define iVtObjectIDFontAttributesNormal8x8 65526
#define iVtObjectIDFontAttributesNormal12x16 65525
#define iVtObjectIDFontAttributesNormal16x16 65524
#define iVtObjectIDFontAttributesNormal16x24 65523
#define iVtObjectIDFontAttributesNormal24x32 65522
#define iVtObjectIDLineAttributesNormal 65521
#define iVtObjectIDLineAttributesDotted 65520
#define iVtObjectIDFontAttributesSKM6x8 65519
#define iVtObjectIDFontAttributesSKM8x8 65518
#define iVtObjectIDFontAttributesSKM12x16 65517
#define iVtObjectIDLineAttributesSKM 65516
#define iVtObjectIDFontAttributesNormal6x8_Button60x30 65515
#define iVtObjectIDValSpeed 65514
#define iVtObjectIDValAccel 65513
#define iVtObjectIDValMiles 1234
#define iVtObjectIDStrNone 65512
#define iVtObjectIDStrNone_1 65512
#define iVtObjectIDStrNone_2 65512
#define iVtObjectIDStrRed 65511
#define iVtObjectIDStrRed_1 65511
#define iVtObjectIDStrRed_2 65511
#define iVtObjectIDStrGreen 65510
#define iVtObjectIDStrBlue 65509
#define iVtObjectIDStrYellow 65508
#define iVtObjectIDStrCyan 65507
#define iVtObjectIDStrMagenta 65506
#define iVtObjectIDStrBlack 65505
#define iVtObjectIDStrWhite 65504
#define iVtObjectIDLikeIt 65503
#define iVtObjectIDLikeItNot 65502
#define iVtObjectIDcontainerInAllMasks 65501
#define iVtObjectIDUnnamed3 65500
#define iVtObjectIDBigLogo 65499
#define iVtObjectIDleine 65498
#define iVtObjectIDKeyReset 65497
#define vtKeyCodeKeyReset 254
#define iVtObjectIDresetTextOS 65496
#define iVtObjectIDresetTextOS_1 65496
#define iVtObjectIDresetTextOS_2 65496
#define iVtObjectIDInputMiles 65495
#define iVtObjectIDMainMask 1101
#define iVtObjectIDmask1contentscontainer 65494
#define iVtObjectIDUnnamed4 65493
#define iVtObjectIDspeedLabel 65492
#define iVtObjectIDUnnamed5 65491
#define iVtObjectIDUnnamed6 65490
#define iVtObjectIDUnnamed7 65489
#define iVtObjectIDUnnamed8 65488
#define iVtObjectIDUnnamed9 65487
#define iVtObjectIDColLabel 65486
#define iVtObjectIDColOS 65485
#define iVtObjectIDAccelArchedBarGraph 65481
#define iVtObjectIDOpsFakeMileage 65480
#define iVtObjectIDChangeAwayPointer 65479
#define iVtObjectIDInputListTypFakeMiles 65478
#define iVtObjectIDUnnamed12 65465
#define iVtObjectIDUnnamed13 65464
#define iVtObjectIDUnnamed14 65463
#define iVtObjectIDUnnamed15 65462
#define iVtObjectIDUnnamed10 65477
#define iVtObjectIDUnnamed11 65476
#define iVtObjectIDInputLikeage 65475
#define iVtObjectIDLikeageOP 65474
#define iVtObjectIDKeyMoreAccel 65473
#define vtKeyCodeKeyMoreAccel 253
#define iVtObjectIDUnnamed16 65461
#define iVtObjectIDKeyLessAccel 65472
#define vtKeyCodeKeyLessAccel 252
#define iVtObjectIDUnnamed17 65460
#define iVtObjectIDvtLang 65471
#define iVtObjectIDOSlanguage 65470
#define iVtObjectIDdriver 65469
#define iVtObjectIDresonible 65468
#define iVtObjectIDISdriver 65467
#define iVtObjectIDOSresonible 65466
#define iVtObjectIDsoftkeys1 65459
#define iVtObjectIDKeyMove 65458
#define vtKeyCodeKeyMove 251
#define iVtObjectIDUnnamed18 65449
#define iVtObjectIDKeyLogo 65457
#define vtKeyCodeKeyLogo 250
#define iVtObjectIDUnnamed19 65448
#define iVtObjectIDKeyChangeLang 65456
#define vtKeyCodeKeyChangeLang 249
#define iVtObjectIDUnnamed20 65447
#define iVtObjectIDKeyChangeCol 65455
#define vtKeyCodeKeyChangeCol 248
#define iVtObjectIDUnnamed21 65446
#define iVtObjectIDUnnamed22 65445
#define iVtObjectIDKeyTransCol 65454
#define vtKeyCodeKeyTransCol 247
#define iVtObjectIDUnnamed23 65444
#define iVtObjectIDUnnamed24 65443
#define iVtObjectIDKeyForbidden 65453
#define vtKeyCodeKeyForbidden 246
#define iVtObjectIDUnnamed25 65442
#define iVtObjectIDKeyChangeFill 65452
#define vtKeyCodeKeyChangeFill 245
#define iVtObjectIDUnnamed26 65441
#define iVtObjectIDKeyUpdatePool 65451
#define vtKeyCodeKeyUpdatePool 244
#define iVtObjectIDUnnamed27 65440
#define iVtObjectIDKeyChangeLogoPosition 65450
#define vtKeyCodeKeyChangeLogoPosition 243
#define iVtObjectIDUnnamed28 65439
#define iVtObjectIDLineAttributes_Normal 65438
#define iVtObjectIDFillAttributes 65437
#define iVtObjectIDdEllipse 65484
#define iVtObjectIDdPolygon 65483
#define iVtObjectIDdMeter 65482
#define iVtObjectIDMacro_1 1
#define iVtObjectIDMacro_2 2
#define iVtObjectIDAnotherMask 65436
#define iVtObjectIDUnnamed29 65435
#define iVtObjectIDUnnamed30 65434
#define iVtObjectIDUnnamed31 65433
#define iVtObjectIDUnnamed32 65432
#define iVtObjectIDUnnamed33 65431
#define iVtObjectIDUnnamed34 65430
#define iVtObjectIDUnnamed35 65429
#define iVtObjectIDForbiddenAlarmMask 65428
#define iVtObjectIDalarm1contentscontainer 65427
#define iVtObjectIDUnnamed36 65426
#define iVtObjectIDUnnamed37 65425
#define iVtObjectIDUnnamed38 65424
#define iVtObjectIDsoftkeysAlarm 65423
#define vtObjectPoolDimension 200
#define vtObjectPoolSoftKeyWidth 60
#define vtObjectPoolSoftKeyHeight 32

#define vtKeyCodeACK 0
