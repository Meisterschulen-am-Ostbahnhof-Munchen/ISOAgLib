;-----------------------------------------------------------------------------
;  Name: 	simcs.cmm         Description: T32-Command-File for ESX2-Project
;  Version:	26.03.01 /Fi                            Copyrights (c) 1998, STW
;-----------------------------------------------------------------------------*/

	;--- START DEFINITIONS OF EMULATOR ---
	b:
	winclear
	res
	sys.cpu 167CS
;	sys.cpu 167CR

	;--- MEMORY MAPPING FOR EMULATOR ---
	map.res
	map.frag 1 000000 000000--00DFFF
	map.gap 1  00E000--00FFFF
	map.frag 1 010000 010000--07FFFF
	map.bus16

	; for use of ESI-CON
	map.word

	;--- LOAD PROGRAMS ---
	;ESX2 Monitorprogram (change path, if necessary)
	d.load.auto rom166wu.hex

	;ESX2 Loaderprogram (normally actual directory)	depending on the used Controllertype!
	;For Controller C167CS-32FM use
	;d.load.auto xcs_32FM.hex
	;For Controller C167CS-L33M use
	d.load.auto xcsL33M.hex
	; For Controller C167CR use
	; d.load.auto xos20sim.hex

	;ESX2 Applicationprogram (change path and files of project,if necessary)
	y.dem on on
	sYmbol.DEMangle on on

	;d.load.auto ..\EDE\taskcontroller_esx\taskcontroller_rs232.abs /cfront
	y.spath + ..
	y.spath + ..\..
	y.spath + ..\..\xgpl_src
	y.spath + ..\..\xgpl_src\supplementary_driver\driver\actor\impl
	y.spath + ..\..\xgpl_src\supplementary_driver\driver\sensor\impl
	y.spath + ..\..\xgpl_src\supplementary_driver\driver\rs232\impl
	y.spath + ..\..\xgpl_src\IsoAgLib\comm\Multipacket\impl
	y.spath + ..\..\xgpl_src\IsoAgLib\comm\DIN_Terminal\impl
	y.spath + ..\..\xgpl_src\IsoAgLib\comm\ISO_Terminal\impl
	y.spath + ..\..\xgpl_src\IsoAgLib\comm\SystemMgmt\impl
	y.spath + ..\..\xgpl_src\IsoAgLib\comm\SystemMgmt\DIN9684\impl
	y.spath + ..\..\xgpl_src\IsoAgLib\comm\SystemMgmt\ISO11783\impl
	y.spath + ..\..\xgpl_src\IsoAgLib\comm\Base\impl
	y.spath + ..\..\xgpl_src\IsoAgLib\comm\Base\ext\impl
	y.spath + ..\..\xgpl_src\IsoAgLib\comm\Process\impl
	y.spath + ..\..\xgpl_src\IsoAgLib\comm\Process\StdMeasureElements\impl
	y.spath + ..\..\xgpl_src\IsoAgLib\comm\Process\Local\SimpleSetpoint\impl
	y.spath + ..\..\xgpl_src\IsoAgLib\comm\Process\Local\SimpleMeasureSetpoint\impl
	y.spath + ..\..\xgpl_src\IsoAgLib\comm\Process\Local\impl
	y.spath + ..\..\xgpl_src\IsoAgLib\comm\Process\Local\StdMeasureElements\impl
	y.spath + ..\..\xgpl_src\IsoAgLib\comm\Process\Local\Std\impl
	y.spath + ..\..\xgpl_src\IsoAgLib\comm\Process\Local\SimpleMeasure\impl
	y.spath + ..\..\xgpl_src\IsoAgLib\comm\Process\Local\SimpleSetpointElements\impl
	y.spath + ..\..\xgpl_src\IsoAgLib\comm\Process\Local\StdSetpointElements\impl
	y.spath + ..\..\xgpl_src\IsoAgLib\comm\Process\Remote\SimpleSetpoint\impl
	y.spath + ..\..\xgpl_src\IsoAgLib\comm\Process\Remote\SimpleMeasureSetpoint\impl
	y.spath + ..\..\xgpl_src\IsoAgLib\comm\Process\Remote\impl
	y.spath + ..\..\xgpl_src\IsoAgLib\comm\Process\Remote\SimpleMeasureElements\impl
	y.spath + ..\..\xgpl_src\IsoAgLib\comm\Process\Remote\StdMeasureElements\impl
	y.spath + ..\..\xgpl_src\IsoAgLib\comm\Process\Remote\Std\impl
	y.spath + ..\..\xgpl_src\IsoAgLib\comm\Process\Remote\SimpleMeasure\impl
	y.spath + ..\..\xgpl_src\IsoAgLib\comm\Process\Remote\SimpleSetpointElements\impl
	y.spath + ..\..\xgpl_src\IsoAgLib\comm\Process\Remote\StdSetpointElements\impl
	y.spath + ..\..\xgpl_src\IsoAgLib\comm\Process\StdSetpointElements\impl
	y.spath + ..\..\xgpl_src\IsoAgLib\scheduler\impl
	y.spath + ..\..\xgpl_src\IsoAgLib\driver\can\impl
	y.spath + ..\..\xgpl_src\IsoAgLib\driver\system\impl
	y.spath + ..\..\xgpl_src\IsoAgLib\driver\eeprom\impl
	y.spath + ..\..\xgpl_src\IsoAgLib\util\impl
	y.spath + ..\..\commercial_BIOS
	y.spath + ..\..\commercial_BIOS\bios_esx
	y.spath + ..\..\commercial_DIOS
	
	; Load Appplication and select path for the EXEC
	y.spath + ..\EDE\tractor\
	d.load.Ieee ..\EDE\tractor\traktor.abs /Include /cfront /int16 /puzzled
	
	y.dem on on
	sYmbol.DEMangle on on


	;--- INTERNAL DEFINITIONS AND PROGRAMS OF EMULATOR FOR ESX2 ---
	;Interrupt Vectors
	d.a 00 jmps 0,1440      ; Reset
	d.a 08 jmps 0,1460      ; NMI
	d.a 20 jmps 0,1450      ; Breakpoints
	;C167 processor
	d.s 1400 %b 1
	;Disable internal Watchdog
	d.s 1402 %b 0
	; Lock all Interrupts (0:= run; 1:= stopped)
	d.s 1404 %w 1
	;Userwatchdog triggern
	d.a 1406--141f nop
	d.a 1406 bset dp6.5; Direction Output
	d.a     ,bset p6.5;  Watchdog = High
	d.a     ,nop
	d.a     ,nop
	d.a     ,nop
	d.a     ,nop
	d.a     ,nop
	d.a     ,nop
	d.a     ,nop
	d.a     ,nop
	d.a     ,nop
	d.a     ,bclr p6.5; Watchdog = Low
	d.a     ,jmpi cc_uc,[r4]
	;RESET and NMI-Polarity
	x.respol -
	x.nmipol -

	;NMI
	x.nmibreak on
	;stop interrupts while program stepping (On or Off)
	setup.imaskasm ON
	setup.imaskhll ON

	;--- SYSTEM ON ---
	sys.up

	;--- DEFINES OF EMULATOR DESKTOP ---
	mode.hll
	screen.always
	r.s pp 202
	var.local
	d.l main
	d.l

	go main
	y.dem on on
	sYmbol.DEMangle on on
	wait !run()
	;wait 1.s
	d.s D:0xF1C6 %WORD 0100
end
