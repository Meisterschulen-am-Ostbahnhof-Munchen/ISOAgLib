;-----------------------------------------------------------------------------
;  Name: 	micro.cmm (simcs.cmm)         Description: T32-Command-File for ESX-MICRO-Project
;-----------------------------------------------------------------------------*/

  // Generate Projekt with Debug Information for C++ C Assembler set: 
  // Tasking /EDE/[C++ C Assembler]CompilerOptions/ProjektOptions/Miscellanous
  // Tasking C++CompilerOptions/ProjektOptions/Miscellanous set "Keep c and Assembler Files"  

	;--- START DEFINITIONS OF EMULATOR ---
	b:
	winclear
	res
	sys.cpu F269


	;--- MEMORY MAPPING FOR EMULATOR ---
	map.res

	map.rom 000000--00BFFF
	map.rom 018000--0FFFFF

	map.frag 1 000000 000000--00BFFF
	map.frag 1 018000 018000--0FFFFF

	map.bus16
	; für ESI-CON
	map.word

	;--- LOAD PROGRAMS ---
	;ESX2 Monitorprogram (change path, if necessary)
	d.load.auto rom166wu.hex

	;ESX2 Loaderprogram (normally actual directory)
	d.load.auto xfl__hp0.hex

	; set paths
	y.spath + ..
	y.spath + ..\..
	y.spath + ..\..\xgpl_src
	y.spath + ..\..\xgpl_src\supplementary_driver\driver\actor\impl
	y.spath + ..\..\xgpl_src\supplementary_driver\driver\sensor\impl
	y.spath + ..\..\xgpl_src\supplementary_driver\driver\rs232\impl
	y.spath + ..\..\xgpl_src\IsoAgLib\comm\Multipacket\impl
	y.spath + ..\..\xgpl_src\IsoAgLib\comm\DIN_Terminal\impl
	y.spath + ..\..\xgpl_src\IsoAgLib\comm\ISO_Terminal\impl
	y.spath + ..\..\xgpl_src\IsoAgLib\comm\SystemMgmt\impl
	y.spath + ..\..\xgpl_src\IsoAgLib\comm\SystemMgmt\DIN9684\impl
	y.spath + ..\..\xgpl_src\IsoAgLib\comm\SystemMgmt\ISO11783\impl
	y.spath + ..\..\xgpl_src\IsoAgLib\comm\Base\impl
	y.spath + ..\..\xgpl_src\IsoAgLib\comm\Base\ext\impl
	y.spath + ..\..\xgpl_src\IsoAgLib\comm\Process\impl
	y.spath + ..\..\xgpl_src\IsoAgLib\comm\Process\StdMeasureElements\impl
	y.spath + ..\..\xgpl_src\IsoAgLib\comm\Process\Local\SimpleSetpoint\impl
	y.spath + ..\..\xgpl_src\IsoAgLib\comm\Process\Local\SimpleMeasureSetpoint\impl
	y.spath + ..\..\xgpl_src\IsoAgLib\comm\Process\Local\impl
	y.spath + ..\..\xgpl_src\IsoAgLib\comm\Process\Local\StdMeasureElements\impl
	y.spath + ..\..\xgpl_src\IsoAgLib\comm\Process\Local\Std\impl
	y.spath + ..\..\xgpl_src\IsoAgLib\comm\Process\Local\SimpleMeasure\impl
	y.spath + ..\..\xgpl_src\IsoAgLib\comm\Process\Local\SimpleSetpointElements\impl
	y.spath + ..\..\xgpl_src\IsoAgLib\comm\Process\Local\StdSetpointElements\impl
	y.spath + ..\..\xgpl_src\IsoAgLib\comm\Process\Remote\SimpleSetpoint\impl
	y.spath + ..\..\xgpl_src\IsoAgLib\comm\Process\Remote\SimpleMeasureSetpoint\impl
	y.spath + ..\..\xgpl_src\IsoAgLib\comm\Process\Remote\impl
	y.spath + ..\..\xgpl_src\IsoAgLib\comm\Process\Remote\SimpleMeasureElements\impl
	y.spath + ..\..\xgpl_src\IsoAgLib\comm\Process\Remote\StdMeasureElements\impl
	y.spath + ..\..\xgpl_src\IsoAgLib\comm\Process\Remote\Std\impl
	y.spath + ..\..\xgpl_src\IsoAgLib\comm\Process\Remote\SimpleMeasure\impl
	y.spath + ..\..\xgpl_src\IsoAgLib\comm\Process\Remote\SimpleSetpointElements\impl
	y.spath + ..\..\xgpl_src\IsoAgLib\comm\Process\Remote\StdSetpointElements\impl
	y.spath + ..\..\xgpl_src\IsoAgLib\comm\Process\StdSetpointElements\impl
	y.spath + ..\..\xgpl_src\IsoAgLib\comm\MultiPacket\impl
    y.spath + ..\..\xgpl_src\IsoAgLib\scheduler\impl
	y.spath + ..\..\xgpl_src\IsoAgLib\hal\esxu\system
    y.spath + ..\..\xgpl_src\IsoAgLib\hal\esxu\system
	y.spath + ..\..\xgpl_src\IsoAgLib\driver\can\impl
	y.spath + ..\..\xgpl_src\IsoAgLib\driver\system\impl
	y.spath + ..\..\xgpl_src\IsoAgLib\driver\eeprom\impl
	y.spath + ..\..\xgpl_src\IsoAgLib\util\impl
	y.spath + ..\..\examples\tutorial\3_VirtualTerminal_Client\3_0_VirtualTerminalIso
    y.spath + ..\..\commercial_BIOS
	y.spath + ..\..\commercial_BIOS\bios_esxu
	y.spath + ..\..\commercial_DIOS
	
    ; Load Appplication and select path for the EXEC
	y.spath + ..\EDE\3_0_VirtualTerminalIsoEsxu
	d.load.Ieee C:\Projekte_Subversion\IsoFass\IsoAgLib\compiler_projects\EDE\3_0_VirtualTerminalIsoEsxu\3_0_virtualterminalisoesxu_esxu.abs /cfront /int16 /puzzled /pack

  //possible Options for Ieee see below or pdf/general_ref_d.pdf: NOT USE /PATH USE Y.SPATH for directory settings         
  //cfront is needed for demangle cmd below
  // /path /Include /cfront /int16 /puzzled /lpath /large / pack

	//Open window with sourcefiles and paths that are known by the debugger on runtime
      y.list.source; 
      y.list.spath 
 
	; 1 demangler on / 2 demangle function parameters on / for C++ Projekts 
	 sYmbol.DEMangle on on



	;--- INTERNAL DEFINITIONS AND PROGRAMS OF EMULATOR FOR ESX2 ---
	;C167 processor
	d.s 1400 %b 1
	;Disable internal Watchdog
	d.s 1402 %b 0
	; Lock all Interrupts (0:= run; 1:= stopped)
	;d.s 1404 %w 0
	d.s 1404 %w 1
	;Userwatchdog triggern
	d.a 1406--141f nop
	d.a 1406 bset dp3.4; Direction Output
	d.a     ,bset p3.4;  Watchdog = High
	d.a     ,nop
	d.a     ,nop
	d.a     ,nop
	d.a     ,nop
	d.a     ,nop
	d.a     ,nop
	d.a     ,nop
	d.a     ,nop
	d.a     ,nop
	d.a     ,bclr p3.4; Watchdog = Low
	d.a     ,jmpi cc_uc,[r4]
	;Interrupt Vectors
	d.a 00 jmps 0,1440      ; Reset
	d.a 08 jmps 0,1460      ; NMI
	d.a 20 jmps 0,1450      ; Breakpoints
	;RESET and NMI-Polarity
	x.respol -
	x.nmipol -
	;NMI
	x.nmibreak on
	;stop interrupts while program stepping
	setup.imaskasm On
	setup.imaskhll On

	;--- SYSTEM ON ---
	sys.up

	;--- DEFINES OF EMULATOR DESKTOP ---
	mode.hll
	screen.always
	;r.s pp main ; __CSTART
;	r.s pp 202
	r.s pp __CSTART
	//open window with local vars 
	var.local

  ;Show Variables in HEX Format  
  ;SETUP.VAR %HEX  

  ;Show Variables in all Formats
  SETUP.VAR %all  

	
    ;Load file with breakpoints 
   ;do demo01_breakpoints.cmm
   ;Show window with breakpoints
    ;You can use breakpoint window for setting BPs and save in new *.cmm 
  ;b.l
  
  ;Show window with programm an go to main
	;d.l main
	d.l
	go main

	wait !run()
	;wait 1.s
	;d.s D:0xF1C6 %WORD 0100
	
	
end



