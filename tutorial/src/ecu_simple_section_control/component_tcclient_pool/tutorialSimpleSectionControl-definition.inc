#include "tutorialSimpleSectionControl-bytestream.inc"

namespace tutorialSimpleSectionControl {

IsoAgLib::iProcData_c c_xOffset;
IsoAgLib::iProcData_c c_actualWidth;
IsoAgLib::iProcData_c c_maxWidth;
IsoAgLib::iProcData_c c_setpointVolumeRate;
IsoAgLib::iProcData_c c_actualVolumeRate;
IsoAgLib::iProcData_c c_workState;
IsoAgLib::iProcData_c c_sectionControlState;
IsoAgLib::iProcData_c c_condensedWorkState;
IsoAgLib::iProcData_c c_workStateSection01;
IsoAgLib::iProcData_c c_workStateSection02;
IsoAgLib::iProcData_c c_workStateSection03;
IsoAgLib::iProcData_c c_workStateSection04;
IsoAgLib::iProcData_c c_workStateSection05;
IsoAgLib::iProcData_c c_workStateSection06;
IsoAgLib::iProcData_c c_workStateSection07;
IsoAgLib::iProcData_c c_workStateSection08;

}

