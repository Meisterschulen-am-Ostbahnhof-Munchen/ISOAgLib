const HUGE_MEM uint8_t deviceDescription_en [] = {0x61, 
'D', 'V', 'C', 0, 0, 0xa, 'O', 'S', 'B', 'S', 'p', 'r', 'a', 'y', 'e', 'r', 0x3, '0', '.', '1', 0x1b, 0, 0xa0, 0x2c, 0, 0x80, 0xc, 0xa0, 0x7, 'W', 'X', 'Y', 'Z', '0', '1', '7', 'T', 'C', '0', '0', '0', '0', '1', 'e', 'n', 0x50, 0x1, 0x5a, 0x56, 0xff, 
'D', 'E', 'T', 0xfe, 0xff, 0x1, 0x11, 'S', 'p', 'r', 'a', 'y', 'e', 'r', ' ', 'I', 'n', 't', 'e', 'r', 'f', 'a', 'c', 'e', 0, 0, 0, 0, 0xa, 0, 0xf5, 0xff, 0xf4, 0xff, 0xf3, 0xff, 0xf2, 0xff, 0xf1, 0xff, 0xf0, 0xff, 0xef, 0xff, 0xee, 0xff, 0xed, 0xff, 0xec, 0xff, 
'D', 'P', 'D', 0xf5, 0xff, 0x86, 0, 0, 0x8, 0x8, 'X', ' ', 'O', 'f', 'f', 's', 'e', 't', 0xff, 0xff, 
'D', 'P', 'D', 0xf4, 0xff, 0x43, 0, 0, 0x8, 0xc, 'A', 'c', 't', 'u', 'a', 'l', ' ', 'W', 'i', 'd', 't', 'h', 0xff, 0xff, 
'D', 'P', 'D', 0xf3, 0xff, 0x46, 0, 0, 0x8, 0x9, 'M', 'a', 'x', ' ', 'W', 'i', 'd', 't', 'h', 0xff, 0xff, 
'D', 'P', 'T', 0xf2, 0xff, 0x87, 0, 0, 0, 0, 0, 0x8, 'Y', ' ', 'O', 'f', 'f', 's', 'e', 't', 0xff, 0xff, 
'D', 'P', 'T', 0xf1, 0xff, 0x88, 0, 0, 0, 0, 0, 0x8, 'Z', ' ', 'O', 'f', 'f', 's', 'e', 't', 0xff, 0xff, 
'D', 'P', 'D', 0xf0, 0xff, 0x1, 0, 0x2, 0x9, 0x14, 'S', 'e', 't', 'p', 'o', 'i', 'n', 't', ' ', 'V', 'o', 'l', 'u', 'm', 'e', ' ', 'R', 'a', 't', 'e', 0xff, 0xff, 
'D', 'P', 'D', 0xef, 0xff, 0x2, 0, 0x1, 0x9, 0x12, 'A', 'c', 't', 'u', 'a', 'l', ' ', 'V', 'o', 'l', 'u', 'm', 'e', ' ', 'R', 'a', 't', 'e', 0xff, 0xff, 
'D', 'P', 'D', 0xee, 0xff, 0x8d, 0, 0, 0x9, 0xa, 'W', 'o', 'r', 'k', ' ', 'S', 't', 'a', 't', 'e', 0xff, 0xff, 
'D', 'P', 'D', 0xed, 0xff, 0xa0, 0, 0x2, 0x8, 0x15, 'S', 'e', 'c', 't', 'i', 'o', 'n', ' ', 'C', 'o', 'n', 't', 'r', 'o', 'l', ' ', 'S', 't', 'a', 't', 'e', 0xff, 0xff, 
'D', 'P', 'D', 0xec, 0xff, 0xa1, 0, 0x2, 0x9, 0x14, 'C', 'o', 'n', 'd', 'e', 'n', 's', 'e', 'd', ' ', 'W', 'o', 'r', 'k', ' ', 'S', 't', 'a', 't', 'e', 0xff, 0xff, 
'D', 'E', 'T', 0xfd, 0xff, 0x4, 0xa, 'S', 'e', 'c', 't', 'i', 'o', 'n', ' ', '0', '1', 0x1, 0, 0xfe, 0xff, 0x6, 0, 0xeb, 0xff, 0xea, 0xff, 0xe9, 0xff, 0xe8, 0xff, 0xe7, 0xff, 0xe6, 0xff, 
'D', 'P', 'T', 0xeb, 0xff, 0x86, 0, 0, 0, 0, 0, 0xb, 'X', ' ', 'O', 'f', 'f', 's', 'e', 't', ' ', '0', '1', 0xff, 0xff, 
'D', 'P', 'T', 0xea, 0xff, 0x87, 0, 0x20, 0xd1, 0xff, 0xff, 0xb, 'Y', ' ', 'O', 'f', 'f', 's', 'e', 't', ' ', '0', '1', 0xff, 0xff, 
'D', 'P', 'T', 0xe9, 0xff, 0x88, 0, 0, 0, 0, 0, 0xb, 'Z', ' ', 'O', 'f', 'f', 's', 'e', 't', ' ', '0', '1', 0xff, 0xff, 
'D', 'P', 'T', 0xe8, 0xff, 0x43, 0, 0xb8, 0xb, 0, 0, 0xf, 'A', 'c', 't', 'u', 'a', 'l', ' ', 'W', 'i', 'd', 't', 'h', ' ', '0', '1', 0xff, 0xff, 
'D', 'P', 'T', 0xe7, 0xff, 0x46, 0, 0xb8, 0xb, 0, 0, 0xc, 'M', 'a', 'x', ' ', 'W', 'i', 'd', 't', 'h', ' ', '0', '1', 0xff, 0xff, 
'D', 'P', 'D', 0xe6, 0xff, 0x8d, 0, 0x2, 0x9, 0xd, 'W', 'S', ' ', 'S', 'e', 'c', 't', 'i', 'o', 'n', ' ', '0', '1', 0xff, 0xff, 
'D', 'E', 'T', 0xfc, 0xff, 0x4, 0xa, 'S', 'e', 'c', 't', 'i', 'o', 'n', ' ', '0', '2', 0x2, 0, 0xfe, 0xff, 0x6, 0, 0xe5, 0xff, 0xe4, 0xff, 0xe3, 0xff, 0xe2, 0xff, 0xe1, 0xff, 0xe0, 0xff, 
'D', 'P', 'T', 0xe5, 0xff, 0x86, 0, 0, 0, 0, 0, 0xb, 'X', ' ', 'O', 'f', 'f', 's', 'e', 't', ' ', '0', '2', 0xff, 0xff, 
'D', 'P', 'T', 0xe4, 0xff, 0x87, 0, 0xd8, 0xdc, 0xff, 0xff, 0xb, 'Y', ' ', 'O', 'f', 'f', 's', 'e', 't', ' ', '0', '2', 0xff, 0xff, 
'D', 'P', 'T', 0xe3, 0xff, 0x88, 0, 0, 0, 0, 0, 0xb, 'Z', ' ', 'O', 'f', 'f', 's', 'e', 't', ' ', '0', '2', 0xff, 0xff, 
'D', 'P', 'T', 0xe2, 0xff, 0x43, 0, 0xb8, 0xb, 0, 0, 0xf, 'A', 'c', 't', 'u', 'a', 'l', ' ', 'W', 'i', 'd', 't', 'h', ' ', '0', '2', 0xff, 0xff, 
'D', 'P', 'T', 0xe1, 0xff, 0x46, 0, 0xb8, 0xb, 0, 0, 0xc, 'M', 'a', 'x', ' ', 'W', 'i', 'd', 't', 'h', ' ', '0', '2', 0xff, 0xff, 
'D', 'P', 'D', 0xe0, 0xff, 0x8d, 0, 0x2, 0x9, 0xd, 'W', 'S', ' ', 'S', 'e', 'c', 't', 'i', 'o', 'n', ' ', '0', '2', 0xff, 0xff, 
'D', 'E', 'T', 0xfb, 0xff, 0x4, 0xa, 'S', 'e', 'c', 't', 'i', 'o', 'n', ' ', '0', '3', 0x3, 0, 0xfe, 0xff, 0x6, 0, 0xdf, 0xff, 0xde, 0xff, 0xdd, 0xff, 0xdc, 0xff, 0xdb, 0xff, 0xda, 0xff, 
'D', 'P', 'T', 0xdf, 0xff, 0x86, 0, 0, 0, 0, 0, 0xb, 'X', ' ', 'O', 'f', 'f', 's', 'e', 't', ' ', '0', '3', 0xff, 0xff, 
'D', 'P', 'T', 0xde, 0xff, 0x87, 0, 0x90, 0xe8, 0xff, 0xff, 0xb, 'Y', ' ', 'O', 'f', 'f', 's', 'e', 't', ' ', '0', '3', 0xff, 0xff, 
'D', 'P', 'T', 0xdd, 0xff, 0x88, 0, 0, 0, 0, 0, 0xb, 'Z', ' ', 'O', 'f', 'f', 's', 'e', 't', ' ', '0', '3', 0xff, 0xff, 
'D', 'P', 'T', 0xdc, 0xff, 0x43, 0, 0xb8, 0xb, 0, 0, 0xf, 'A', 'c', 't', 'u', 'a', 'l', ' ', 'W', 'i', 'd', 't', 'h', ' ', '0', '3', 0xff, 0xff, 
'D', 'P', 'T', 0xdb, 0xff, 0x46, 0, 0xb8, 0xb, 0, 0, 0xc, 'M', 'a', 'x', ' ', 'W', 'i', 'd', 't', 'h', ' ', '0', '3', 0xff, 0xff, 
'D', 'P', 'D', 0xda, 0xff, 0x8d, 0, 0x2, 0x9, 0xd, 'W', 'S', ' ', 'S', 'e', 'c', 't', 'i', 'o', 'n', ' ', '0', '3', 0xff, 0xff, 
'D', 'E', 'T', 0xfa, 0xff, 0x4, 0xa, 'S', 'e', 'c', 't', 'i', 'o', 'n', ' ', '0', '4', 0x4, 0, 0xfe, 0xff, 0x6, 0, 0xd9, 0xff, 0xd8, 0xff, 0xd7, 0xff, 0xd6, 0xff, 0xd5, 0xff, 0xd4, 0xff, 
'D', 'P', 'T', 0xd9, 0xff, 0x86, 0, 0, 0, 0, 0, 0xb, 'X', ' ', 'O', 'f', 'f', 's', 'e', 't', ' ', '0', '4', 0xff, 0xff, 
'D', 'P', 'T', 0xd8, 0xff, 0x87, 0, 0x48, 0xf4, 0xff, 0xff, 0xb, 'Y', ' ', 'O', 'f', 'f', 's', 'e', 't', ' ', '0', '4', 0xff, 0xff, 
'D', 'P', 'T', 0xd7, 0xff, 0x88, 0, 0, 0, 0, 0, 0xb, 'Z', ' ', 'O', 'f', 'f', 's', 'e', 't', ' ', '0', '4', 0xff, 0xff, 
'D', 'P', 'T', 0xd6, 0xff, 0x43, 0, 0xb8, 0xb, 0, 0, 0xf, 'A', 'c', 't', 'u', 'a', 'l', ' ', 'W', 'i', 'd', 't', 'h', ' ', '0', '4', 0xff, 0xff, 
'D', 'P', 'T', 0xd5, 0xff, 0x46, 0, 0xb8, 0xb, 0, 0, 0xc, 'M', 'a', 'x', ' ', 'W', 'i', 'd', 't', 'h', ' ', '0', '4', 0xff, 0xff, 
'D', 'P', 'D', 0xd4, 0xff, 0x8d, 0, 0x2, 0x9, 0xd, 'W', 'S', ' ', 'S', 'e', 'c', 't', 'i', 'o', 'n', ' ', '0', '4', 0xff, 0xff, 
'D', 'E', 'T', 0xf9, 0xff, 0x4, 0xa, 'S', 'e', 'c', 't', 'i', 'o', 'n', ' ', '0', '5', 0x5, 0, 0xfe, 0xff, 0x6, 0, 0xd3, 0xff, 0xd2, 0xff, 0xd1, 0xff, 0xd0, 0xff, 0xcf, 0xff, 0xce, 0xff, 
'D', 'P', 'T', 0xd3, 0xff, 0x86, 0, 0, 0, 0, 0, 0xb, 'X', ' ', 'O', 'f', 'f', 's', 'e', 't', ' ', '0', '5', 0xff, 0xff, 
'D', 'P', 'T', 0xd2, 0xff, 0x87, 0, 0, 0, 0, 0, 0xb, 'Y', ' ', 'O', 'f', 'f', 's', 'e', 't', ' ', '0', '5', 0xff, 0xff, 
'D', 'P', 'T', 0xd1, 0xff, 0x88, 0, 0, 0, 0, 0, 0xb, 'Z', ' ', 'O', 'f', 'f', 's', 'e', 't', ' ', '0', '5', 0xff, 0xff, 
'D', 'P', 'T', 0xd0, 0xff, 0x43, 0, 0xb8, 0xb, 0, 0, 0xf, 'A', 'c', 't', 'u', 'a', 'l', ' ', 'W', 'i', 'd', 't', 'h', ' ', '0', '5', 0xff, 0xff, 
'D', 'P', 'T', 0xcf, 0xff, 0x46, 0, 0xb8, 0xb, 0, 0, 0xc, 'M', 'a', 'x', ' ', 'W', 'i', 'd', 't', 'h', ' ', '0', '5', 0xff, 0xff, 
'D', 'P', 'D', 0xce, 0xff, 0x8d, 0, 0x2, 0x9, 0xd, 'W', 'S', ' ', 'S', 'e', 'c', 't', 'i', 'o', 'n', ' ', '0', '5', 0xff, 0xff, 
'D', 'E', 'T', 0xf8, 0xff, 0x4, 0xa, 'S', 'e', 'c', 't', 'i', 'o', 'n', ' ', '0', '6', 0x6, 0, 0xfe, 0xff, 0x6, 0, 0xcd, 0xff, 0xcc, 0xff, 0xcb, 0xff, 0xca, 0xff, 0xc9, 0xff, 0xc8, 0xff, 
'D', 'P', 'T', 0xcd, 0xff, 0x86, 0, 0, 0, 0, 0, 0xb, 'X', ' ', 'O', 'f', 'f', 's', 'e', 't', ' ', '0', '6', 0xff, 0xff, 
'D', 'P', 'T', 0xcc, 0xff, 0x87, 0, 0xb8, 0xb, 0, 0, 0xb, 'Y', ' ', 'O', 'f', 'f', 's', 'e', 't', ' ', '0', '6', 0xff, 0xff, 
'D', 'P', 'T', 0xcb, 0xff, 0x88, 0, 0, 0, 0, 0, 0xb, 'Z', ' ', 'O', 'f', 'f', 's', 'e', 't', ' ', '0', '6', 0xff, 0xff, 
'D', 'P', 'T', 0xca, 0xff, 0x43, 0, 0xb8, 0xb, 0, 0, 0xf, 'A', 'c', 't', 'u', 'a', 'l', ' ', 'W', 'i', 'd', 't', 'h', ' ', '0', '6', 0xff, 0xff, 
'D', 'P', 'T', 0xc9, 0xff, 0x46, 0, 0xb8, 0xb, 0, 0, 0xc, 'M', 'a', 'x', ' ', 'W', 'i', 'd', 't', 'h', ' ', '0', '6', 0xff, 0xff, 
'D', 'P', 'D', 0xc8, 0xff, 0x8d, 0, 0x2, 0x9, 0xd, 'W', 'S', ' ', 'S', 'e', 'c', 't', 'i', 'o', 'n', ' ', '0', '6', 0xff, 0xff, 
'D', 'E', 'T', 0xf7, 0xff, 0x4, 0xa, 'S', 'e', 'c', 't', 'i', 'o', 'n', ' ', '0', '7', 0x7, 0, 0xfe, 0xff, 0x6, 0, 0xc7, 0xff, 0xc6, 0xff, 0xc5, 0xff, 0xc4, 0xff, 0xc3, 0xff, 0xc2, 0xff, 
'D', 'P', 'T', 0xc7, 0xff, 0x86, 0, 0, 0, 0, 0, 0xb, 'X', ' ', 'O', 'f', 'f', 's', 'e', 't', ' ', '0', '7', 0xff, 0xff, 
'D', 'P', 'T', 0xc6, 0xff, 0x87, 0, 0x70, 0x17, 0, 0, 0xb, 'Y', ' ', 'O', 'f', 'f', 's', 'e', 't', ' ', '0', '7', 0xff, 0xff, 
'D', 'P', 'T', 0xc5, 0xff, 0x88, 0, 0, 0, 0, 0, 0xb, 'Z', ' ', 'O', 'f', 'f', 's', 'e', 't', ' ', '0', '7', 0xff, 0xff, 
'D', 'P', 'T', 0xc4, 0xff, 0x43, 0, 0xb8, 0xb, 0, 0, 0xf, 'A', 'c', 't', 'u', 'a', 'l', ' ', 'W', 'i', 'd', 't', 'h', ' ', '0', '7', 0xff, 0xff, 
'D', 'P', 'T', 0xc3, 0xff, 0x46, 0, 0xb8, 0xb, 0, 0, 0xc, 'M', 'a', 'x', ' ', 'W', 'i', 'd', 't', 'h', ' ', '0', '7', 0xff, 0xff, 
'D', 'P', 'D', 0xc2, 0xff, 0x8d, 0, 0x2, 0x9, 0xd, 'W', 'S', ' ', 'S', 'e', 'c', 't', 'i', 'o', 'n', ' ', '0', '7', 0xff, 0xff, 
'D', 'E', 'T', 0xf6, 0xff, 0x4, 0xa, 'S', 'e', 'c', 't', 'i', 'o', 'n', ' ', '0', '8', 0x8, 0, 0xfe, 0xff, 0x6, 0, 0xc1, 0xff, 0xc0, 0xff, 0xbf, 0xff, 0xbe, 0xff, 0xbd, 0xff, 0xbc, 0xff, 
'D', 'P', 'T', 0xc1, 0xff, 0x86, 0, 0, 0, 0, 0, 0xb, 'X', ' ', 'O', 'f', 'f', 's', 'e', 't', ' ', '0', '8', 0xff, 0xff, 
'D', 'P', 'T', 0xc0, 0xff, 0x87, 0, 0x28, 0x23, 0, 0, 0xb, 'Y', ' ', 'O', 'f', 'f', 's', 'e', 't', ' ', '0', '8', 0xff, 0xff, 
'D', 'P', 'T', 0xbf, 0xff, 0x88, 0, 0, 0, 0, 0, 0xb, 'Z', ' ', 'O', 'f', 'f', 's', 'e', 't', ' ', '0', '8', 0xff, 0xff, 
'D', 'P', 'T', 0xbe, 0xff, 0x43, 0, 0xb8, 0xb, 0, 0, 0xf, 'A', 'c', 't', 'u', 'a', 'l', ' ', 'W', 'i', 'd', 't', 'h', ' ', '0', '8', 0xff, 0xff, 
'D', 'P', 'T', 0xbd, 0xff, 0x46, 0, 0xb8, 0xb, 0, 0, 0xc, 'M', 'a', 'x', ' ', 'W', 'i', 'd', 't', 'h', ' ', '0', '8', 0xff, 0xff, 
'D', 'P', 'D', 0xbc, 0xff, 0x8d, 0, 0x2, 0x9, 0xd, 'W', 'S', ' ', 'S', 'e', 'c', 't', 'i', 'o', 'n', ' ', '0', '8', 0xff, 0xff};

static const uint32_t ui32_arrayLength_en = 1879;
