extern const IsoAgLib::iVtObject_c::iVtObjectWorkingSet_s iVtObjectwsTutorialDisplay_sROM;
extern const IsoAgLib::iVtObject_c::iVtObjectOutputString_s iVtObjectosWsDesc_sROM;
extern const IsoAgLib::iVtObject_c::iVtObjectMacro_s iVtObjectmacroChangeMaskAbout_sROM;
extern const IsoAgLib::iVtObject_c::iVtObjectMacro_s iVtObjectmacroChangeMaskTecu_sROM;
extern const IsoAgLib::iVtObject_c::iVtObjectMacro_s iVtObjectmacroChangeMaskTimePos_sROM;
extern const IsoAgLib::iVtObject_c::iVtObjectDataMask_s iVtObjectdmTimePos_sROM;
extern const IsoAgLib::iVtObject_c::iVtObjectDataMask_s iVtObjectdmTecu_sROM;
extern const IsoAgLib::iVtObject_c::iVtObjectDataMask_s iVtObjectdmAbout_sROM;
extern const IsoAgLib::iVtObject_c::iVtObjectContainer_s iVtObjectctnMaxPower_sROM;
extern const IsoAgLib::iVtObject_c::iVtObjectContainer_s iVtObjectctnLat_sROM;
extern const IsoAgLib::iVtObject_c::iVtObjectContainer_s iVtObjectctnLon_sROM;
extern const IsoAgLib::iVtObject_c::iVtObjectContainer_s iVtObjectctnKeySwitch_sROM;
extern const IsoAgLib::iVtObject_c::iVtObjectContainer_s iVtObjectctnIsoAgLib_sROM;
extern const IsoAgLib::iVtObject_c::iVtObjectContainer_s iVtObjectctnTime_sROM;
extern const IsoAgLib::iVtObject_c::iVtObjectContainer_s iVtObjectctnPtoFront_sROM;
extern const IsoAgLib::iVtObject_c::iVtObjectContainer_s iVtObjectctnPtoRear_sROM;
extern const IsoAgLib::iVtObject_c::iVtObjectContainer_s iVtObjectctnSpeedReal_sROM;
extern const IsoAgLib::iVtObject_c::iVtObjectContainer_s iVtObjectctnDistReal_sROM;
extern const IsoAgLib::iVtObject_c::iVtObjectContainer_s iVtObjectctnTimeValue_sROM;
extern const IsoAgLib::iVtObject_c::iVtObjectContainer_s iVtObjectctnIsoaglibVersion_sROM;
extern const IsoAgLib::iVtObject_c::iVtObjectContainer_s iVtObjectctnTutorialVersion_sROM;
extern const IsoAgLib::iVtObject_c::iVtObjectContainer_s iVtObjectctnBuildDate_sROM;
extern const IsoAgLib::iVtObject_c::iVtObjectContainer_s iVtObjectctnAbout_sROM;
extern const IsoAgLib::iVtObject_c::iVtObjectContainer_s iVtObjectctnSpeedDisplay_sROM;
extern const IsoAgLib::iVtObject_c::iVtObjectContainer_s iVtObjectctnPto_sROM;
extern const IsoAgLib::iVtObject_c::iVtObjectContainer_s iVtObjectctnDirectionDisplay_sROM;
extern const IsoAgLib::iVtObject_c::iVtObjectContainer_s iVtObjectctrHitchSetCurTrgt_sROM;
extern const IsoAgLib::iVtObject_c::iVtObjectContainer_s iVtObjectctrHitchGraphDisplay_sROM;
extern const IsoAgLib::iVtObject_c::iVtObjectContainer_s iVtObjectctrHitchTrgtStrDisplay_sROM;
extern const IsoAgLib::iVtObject_c::iVtObjectContainer_s iVtObjectctrHitch_sROM;
extern const IsoAgLib::iVtObject_c::iVtObjectContainer_s iVtObjectctrSpeed_sROM;
extern const IsoAgLib::iVtObject_c::iVtObjectButton_s iVtObjectbtnHitchSetCurTrgt_sROM;
extern const IsoAgLib::iVtObject_c::iVtObjectOutputNumber_s iVtObjectopnHitchTargetAngle_sROM;
extern const IsoAgLib::iVtObject_c::iVtObjectRectangle_s iVtObjectrctHitch_sROM;
extern const IsoAgLib::iVtObject_c::iVtObjectRectangle_s iVtObjectrctSpeed_sROM;
extern const IsoAgLib::iVtObject_c::iVtObjectRectangle_s iVtObjectrctIsoAgLibVersion_sROM;
extern const IsoAgLib::iVtObject_c::iVtObjectRectangle_s iVtObjectrctTutorialVersion_sROM;
extern const IsoAgLib::iVtObject_c::iVtObjectRectangle_s iVtObjectrctPto_sROM;
extern const IsoAgLib::iVtObject_c::iVtObjectRectangle_s iVtObjectrctMaxPower_sROM;
extern const IsoAgLib::iVtObject_c::iVtObjectRectangle_s iVtObjectrctKeySwitch_sROM;
extern const IsoAgLib::iVtObject_c::iVtObjectRectangle_s iVtObjectrctDistReal_sROM;
extern const IsoAgLib::iVtObject_c::iVtObjectRectangle_s iVtObjectrctBuildDate_sROM;
extern const IsoAgLib::iVtObject_c::iVtObjectRectangle_s iVtObjectrctTime_sROM;
extern const IsoAgLib::iVtObject_c::iVtObjectMeter_s iVtObjectmtrDirection_sROM;
extern const IsoAgLib::iVtObject_c::iVtObjectMeter_s iVtObjectmtrHitch_sROM;
extern const IsoAgLib::iVtObject_c::iVtObjectArchedBarGraph_s iVtObjectabgSpeed_sROM;
extern const IsoAgLib::iVtObject_c::iVtObjectArchedBarGraph_s iVtObjectabgHitch_sROM;
extern const IsoAgLib::iVtObject_c::iVtObjectPictureGraphic_s iVtObjectpicWindrose_sROM;
extern const IsoAgLib::iVtObject_c::iVtObjectPictureGraphic_s iVtObjectpicIsoAgLib_sROM;
extern const IsoAgLib::iVtObject_c::iVtObjectPictureGraphic_s iVtObjectpicHitch_sROM;
extern const IsoAgLib::iVtObject_c::iVtObjectPictureGraphic_s iVtObjectpicSpeed_sROM;
extern const IsoAgLib::iVtObject_c::iVtObjectPictureGraphic_s iVtObjectpicKeyNavTecu_sROM;
extern const IsoAgLib::iVtObject_c::iVtObjectPictureGraphic_s iVtObjectpicKeyNavTimePos_sROM;
extern const IsoAgLib::iVtObject_c::iVtObjectPictureGraphic_s iVtObjectpicKeyNavAbout_sROM;
extern const IsoAgLib::iVtObject_c::iVtObjectNumberVariable_s iVtObjectnvHitchAngle_sROM;
extern const IsoAgLib::iVtObject_c::iVtObjectNumberVariable_s iVtObjectnvHitchAngleTarget_sROM;
extern const IsoAgLib::iVtObject_c::iVtObjectOutputString_s iVtObjectopsHitchTargetAngle_sROM;
extern const IsoAgLib::iVtObject_c::iVtObjectOutputString_s iVtObjectopsHItchDegree_sROM;
extern const IsoAgLib::iVtObject_c::iVtObjectOutputString_s iVtObjectopsHitchPlus45Deg_sROM;
extern const IsoAgLib::iVtObject_c::iVtObjectOutputString_s iVtObjectopsHitchMinus45Deg_sROM;
extern const IsoAgLib::iVtObject_c::iVtObjectOutputString_s iVtObjectopsHitch0Deg_sROM;
extern const IsoAgLib::iVtObject_c::iVtObjectOutputString_s iVtObjectopsHitchSetTrgtBtnLabel_sROM;
extern const IsoAgLib::iVtObject_c::iVtObjectOutputString_s iVtObjectopsSpeed0_sROM;
extern const IsoAgLib::iVtObject_c::iVtObjectOutputString_s iVtObjectopsSpeed150_sROM;
extern const IsoAgLib::iVtObject_c::iVtObjectOutputString_s iVtObjectopsSpeed300_sROM;
extern const IsoAgLib::iVtObject_c::iVtObjectOutputString_s iVtObjectosRpm_sROM;
extern const IsoAgLib::iVtObject_c::iVtObjectObjectPointer_s iVtObjectopPtoRearEngaged_sROM;
extern const IsoAgLib::iVtObject_c::iVtObjectObjectPointer_s iVtObjectopPtoFrontEngaged_sROM;
extern const IsoAgLib::iVtObject_c::iVtObjectOutputString_s iVtObjectosBuildDate_sROM;
extern const IsoAgLib::iVtObject_c::iVtObjectOutputString_s iVtObjectosBuildDateLabel_sROM;
extern const IsoAgLib::iVtObject_c::iVtObjectOutputString_s iVtObjectosBuildDateLabel_1_sROM;
extern const IsoAgLib::iVtObject_c::iVtObjectOutputString_s iVtObjectosTutorialVersion_sROM;
extern const IsoAgLib::iVtObject_c::iVtObjectOutputString_s iVtObjectosTutorialVersionLabel_sROM;
extern const IsoAgLib::iVtObject_c::iVtObjectOutputString_s iVtObjectosTutorialVersionLabel_1_sROM;
extern const IsoAgLib::iVtObject_c::iVtObjectOutputString_s iVtObjectosIsoaglibVersion_sROM;
extern const IsoAgLib::iVtObject_c::iVtObjectOutputString_s iVtObjectosIsoAgLibVersionLabel_sROM;
extern const IsoAgLib::iVtObject_c::iVtObjectOutputString_s iVtObjectosIsoAgLibVersionLabel_1_sROM;
extern const IsoAgLib::iVtObject_c::iVtObjectOutputString_s iVtObjectosColon_sROM;
extern const IsoAgLib::iVtObject_c::iVtObjectOutputNumber_s iVtObjectonTimeS_sROM;
extern const IsoAgLib::iVtObject_c::iVtObjectEllipse_s iVtObjectelStateGreen_sROM;
extern const IsoAgLib::iVtObject_c::iVtObjectLinearBarGraph_s iVtObjectlbPtoRear_sROM;
extern const IsoAgLib::iVtObject_c::iVtObjectLinearBarGraph_s iVtObjectlbPtoFront_sROM;
extern const IsoAgLib::iVtObject_c::iVtObjectNumberVariable_s iVtObjectnvSpeedTheor_sROM;
extern const IsoAgLib::iVtObject_c::iVtObjectNumberVariable_s iVtObjectnvDistTheor_sROM;
extern const IsoAgLib::iVtObject_c::iVtObjectNumberVariable_s iVtObjectnvMaxPowerTime_sROM;
extern const IsoAgLib::iVtObject_c::iVtObjectNumberVariable_s iVtObjectnvDistReal_sROM;
extern const IsoAgLib::iVtObject_c::iVtObjectOutputNumber_s iVtObjectonDistReal_sROM;
extern const IsoAgLib::iVtObject_c::iVtObjectOutputString_s iVtObjectosDistReal_sROM;
extern const IsoAgLib::iVtObject_c::iVtObjectNumberVariable_s iVtObjectnvSpeedReal_sROM;
extern const IsoAgLib::iVtObject_c::iVtObjectOutputNumber_s iVtObjectonSpeedReal_sROM;
extern const IsoAgLib::iVtObject_c::iVtObjectOutputString_s iVtObjectosSpeedReal_sROM;
extern const IsoAgLib::iVtObject_c::iVtObjectNumberVariable_s iVtObjectnvPtoRear_sROM;
extern const IsoAgLib::iVtObject_c::iVtObjectOutputNumber_s iVtObjectonPtoRear_sROM;
extern const IsoAgLib::iVtObject_c::iVtObjectOutputString_s iVtObjectosPtoRear_sROM;
extern const IsoAgLib::iVtObject_c::iVtObjectNumberVariable_s iVtObjectnvPtoFront_sROM;
extern const IsoAgLib::iVtObject_c::iVtObjectOutputNumber_s iVtObjectonPtoFront_sROM;
extern const IsoAgLib::iVtObject_c::iVtObjectOutputString_s iVtObjectosAboutTitle_sROM;
extern const IsoAgLib::iVtObject_c::iVtObjectOutputString_s iVtObjectosM_sROM;
extern const IsoAgLib::iVtObject_c::iVtObjectOutputString_s iVtObjectosMin_sROM;
extern const IsoAgLib::iVtObject_c::iVtObjectEllipse_s iVtObjectelStateRed_sROM;
extern const IsoAgLib::iVtObject_c::iVtObjectOutputString_s iVtObjectosPtoFront_sROM;
extern const IsoAgLib::iVtObject_c::iVtObjectOutputString_s iVtObjectosCmS_sROM;
extern const IsoAgLib::iVtObject_c::iVtObjectOutputNumber_s iVtObjectonMaxPowerTime_sROM;
extern const IsoAgLib::iVtObject_c::iVtObjectObjectPointer_s iVtObjectopKeySwitch_sROM;
extern const IsoAgLib::iVtObject_c::iVtObjectOutputString_s iVtObjectosKeySwitch_sROM;
extern const IsoAgLib::iVtObject_c::iVtObjectOutputNumber_s iVtObjectonTimeM_sROM;
extern const IsoAgLib::iVtObject_c::iVtObjectOutputString_s iVtObjectosMaskTecu_sROM;
extern const IsoAgLib::iVtObject_c::iVtObjectNumberVariable_s iVtObjectnvSec_sROM;
extern const IsoAgLib::iVtObject_c::iVtObjectNumberVariable_s iVtObjectnvMin_sROM;
extern const IsoAgLib::iVtObject_c::iVtObjectOutputString_s iVtObjectosNavTECU_sROM;
extern const IsoAgLib::iVtObject_c::iVtObjectOutputString_s iVtObjectosNavTimePos_sROM;
extern const IsoAgLib::iVtObject_c::iVtObjectOutputString_s iVtObjectosNavAbout_sROM;
extern const IsoAgLib::iVtObject_c::iVtObjectKey_s iVtObjectkeyNavTECU_sROM;
extern const IsoAgLib::iVtObject_c::iVtObjectNumberVariable_s iVtObjectnvHr_sROM;
extern const IsoAgLib::iVtObject_c::iVtObjectKey_s iVtObjectkeyNavTimePos_sROM;
extern const IsoAgLib::iVtObject_c::iVtObjectSoftKeyMask_s iVtObjectskmDisplay_sROM;
extern const IsoAgLib::iVtObject_c::iVtObjectOutputString_s iVtObjectosMaskTimePos_sROM;
extern const IsoAgLib::iVtObject_c::iVtObjectRectangle_s iVtObjectrecLogoFrame_sROM;
extern const IsoAgLib::iVtObject_c::iVtObjectMeter_s iVtObjectmtrSpeed_sROM;
extern const IsoAgLib::iVtObject_c::iVtObjectKey_s iVtObjectkeyNavAbout_sROM;
extern const IsoAgLib::iVtObject_c::iVtObjectOutputNumber_s iVtObjectonTimeH_sROM;
extern const IsoAgLib::iVtObject_c::iVtObjectNumberVariable_s iVtObjectnvLon_sROM;
extern const IsoAgLib::iVtObject_c::iVtObjectNumberVariable_s iVtObjectnvLat_sROM;
extern const IsoAgLib::iVtObject_c::iVtObjectOutputNumber_s iVtObjectonLon_sROM;
extern const IsoAgLib::iVtObject_c::iVtObjectOutputString_s iVtObjectosLon_sROM;
extern const IsoAgLib::iVtObject_c::iVtObjectOutputNumber_s iVtObjectonLat_sROM;
extern const IsoAgLib::iVtObject_c::iVtObjectOutputString_s iVtObjectosLat_sROM;
extern const IsoAgLib::iVtObject_c::iVtObjectOutputString_s iVtObjectosMaxPower_sROM;
extern const IsoAgLib::iVtObject_c::iVtObjectOutputString_s iVtObjectosTime_sROM;
extern const IsoAgLib::iVtObject_c::iVtObjectOutputString_s iVtObjectosTime_1_sROM;
extern const IsoAgLib::iVtObject_c::iVtObjectFontAttributes_s iVtObjectfta6x8_sROM;
extern const IsoAgLib::iVtObject_c::iVtObjectFontAttributes_s iVtObjectfta8x12_SK_sROM;
extern const IsoAgLib::iVtObject_c::iVtObjectFontAttributes_s iVtObjectfta8x8_sROM;
extern const IsoAgLib::iVtObject_c::iVtObjectFillAttributes_s iVtObjectflaContentBg_sROM;
extern const IsoAgLib::iVtObject_c::iVtObjectFillAttributes_s iVtObjectflaFalse_sROM;
extern const IsoAgLib::iVtObject_c::iVtObjectFillAttributes_s iVtObjectflaOk_sROM;
extern const IsoAgLib::iVtObject_c::iVtObjectFillAttributes_s iVtObjectflaLogo_sROM;
extern const IsoAgLib::iVtObject_c::iVtObjectLineAttributes_s iVtObjectlnSolidBlack_sROM;
