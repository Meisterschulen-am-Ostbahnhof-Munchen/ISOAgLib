IsoAgLib::iVtObjectWorkingSet_c iVtObjectwsTutorialDisplay;
IsoAgLib::iVtObjectOutputString_c iVtObjectosWsDesc;
IsoAgLib::iVtObjectMacro_c iVtObjectmacroChangeMaskAbout;
IsoAgLib::iVtObjectMacro_c iVtObjectmacroChangeMaskTecu;
IsoAgLib::iVtObjectMacro_c iVtObjectmacroChangeMaskTimePos;
IsoAgLib::iVtObjectDataMask_c iVtObjectdmTimePos;
IsoAgLib::iVtObjectDataMask_c iVtObjectdmTecu;
IsoAgLib::iVtObjectDataMask_c iVtObjectdmAbout;
IsoAgLib::iVtObjectContainer_c iVtObjectctnMaxPower;
IsoAgLib::iVtObjectContainer_c iVtObjectctnLat;
IsoAgLib::iVtObjectContainer_c iVtObjectctnLon;
IsoAgLib::iVtObjectContainer_c iVtObjectctnKeySwitch;
IsoAgLib::iVtObjectContainer_c iVtObjectctnIsoAgLib;
IsoAgLib::iVtObjectContainer_c iVtObjectctnTime;
IsoAgLib::iVtObjectContainer_c iVtObjectctnPtoFront;
IsoAgLib::iVtObjectContainer_c iVtObjectctnPtoRear;
IsoAgLib::iVtObjectContainer_c iVtObjectctnSpeedReal;
IsoAgLib::iVtObjectContainer_c iVtObjectctnDistReal;
IsoAgLib::iVtObjectContainer_c iVtObjectctnTimeValue;
IsoAgLib::iVtObjectContainer_c iVtObjectctnIsoaglibVersion;
IsoAgLib::iVtObjectContainer_c iVtObjectctnTutorialVersion;
IsoAgLib::iVtObjectContainer_c iVtObjectctnBuildDate;
IsoAgLib::iVtObjectContainer_c iVtObjectctnAbout;
IsoAgLib::iVtObjectContainer_c iVtObjectctnSpeedDisplay;
IsoAgLib::iVtObjectContainer_c iVtObjectctnPto;
IsoAgLib::iVtObjectContainer_c iVtObjectctnDirectionDisplay;
IsoAgLib::iVtObjectContainer_c iVtObjectctrHitchSetCurTrgt;
IsoAgLib::iVtObjectContainer_c iVtObjectctrHitchGraphDisplay;
IsoAgLib::iVtObjectContainer_c iVtObjectctrHitchTrgtStrDisplay;
IsoAgLib::iVtObjectContainer_c iVtObjectctrHitch;
IsoAgLib::iVtObjectContainer_c iVtObjectctrSpeed;
IsoAgLib::iVtObjectButton_c iVtObjectbtnHitchSetCurTrgt;
IsoAgLib::iVtObjectOutputNumber_c iVtObjectopnHitchTargetAngle;
IsoAgLib::iVtObjectRectangle_c iVtObjectrctHitch;
IsoAgLib::iVtObjectRectangle_c iVtObjectrctSpeed;
IsoAgLib::iVtObjectRectangle_c iVtObjectrctIsoAgLibVersion;
IsoAgLib::iVtObjectRectangle_c iVtObjectrctTutorialVersion;
IsoAgLib::iVtObjectRectangle_c iVtObjectrctPto;
IsoAgLib::iVtObjectRectangle_c iVtObjectrctMaxPower;
IsoAgLib::iVtObjectRectangle_c iVtObjectrctKeySwitch;
IsoAgLib::iVtObjectRectangle_c iVtObjectrctDistReal;
IsoAgLib::iVtObjectRectangle_c iVtObjectrctBuildDate;
IsoAgLib::iVtObjectRectangle_c iVtObjectrctTime;
IsoAgLib::iVtObjectMeter_c iVtObjectmtrDirection;
IsoAgLib::iVtObjectMeter_c iVtObjectmtrHitch;
IsoAgLib::iVtObjectArchedBarGraph_c iVtObjectabgSpeed;
IsoAgLib::iVtObjectArchedBarGraph_c iVtObjectabgHitch;
IsoAgLib::iVtObjectPictureGraphic_c iVtObjectpicWindrose;
IsoAgLib::iVtObjectPictureGraphic_c iVtObjectpicIsoAgLib;
IsoAgLib::iVtObjectPictureGraphic_c iVtObjectpicHitch;
IsoAgLib::iVtObjectPictureGraphic_c iVtObjectpicSpeed;
IsoAgLib::iVtObjectPictureGraphic_c iVtObjectpicKeyNavTecu;
IsoAgLib::iVtObjectPictureGraphic_c iVtObjectpicKeyNavTimePos;
IsoAgLib::iVtObjectPictureGraphic_c iVtObjectpicKeyNavAbout;
IsoAgLib::iVtObjectNumberVariable_c iVtObjectnvHitchAngle;
IsoAgLib::iVtObjectNumberVariable_c iVtObjectnvHitchAngleTarget;
IsoAgLib::iVtObjectOutputString_c iVtObjectopsHitchTargetAngle;
IsoAgLib::iVtObjectOutputString_c iVtObjectopsHItchDegree;
IsoAgLib::iVtObjectOutputString_c iVtObjectopsHitchPlus45Deg;
IsoAgLib::iVtObjectOutputString_c iVtObjectopsHitchMinus45Deg;
IsoAgLib::iVtObjectOutputString_c iVtObjectopsHitch0Deg;
IsoAgLib::iVtObjectOutputString_c iVtObjectopsHitchSetTrgtBtnLabel;
IsoAgLib::iVtObjectOutputString_c iVtObjectopsSpeed0;
IsoAgLib::iVtObjectOutputString_c iVtObjectopsSpeed150;
IsoAgLib::iVtObjectOutputString_c iVtObjectopsSpeed300;
IsoAgLib::iVtObjectOutputString_c iVtObjectosRpm;
IsoAgLib::iVtObjectObjectPointer_c iVtObjectopPtoRearEngaged;
IsoAgLib::iVtObjectObjectPointer_c iVtObjectopPtoFrontEngaged;
IsoAgLib::iVtObjectOutputString_c iVtObjectosBuildDate;
IsoAgLib::iVtObjectOutputString_c iVtObjectosBuildDateLabel;
IsoAgLib::iVtObjectOutputString_c iVtObjectosBuildDateLabel_1;
IsoAgLib::iVtObjectOutputString_c iVtObjectosTutorialVersion;
IsoAgLib::iVtObjectOutputString_c iVtObjectosTutorialVersionLabel;
IsoAgLib::iVtObjectOutputString_c iVtObjectosTutorialVersionLabel_1;
IsoAgLib::iVtObjectOutputString_c iVtObjectosIsoaglibVersion;
IsoAgLib::iVtObjectOutputString_c iVtObjectosIsoAgLibVersionLabel;
IsoAgLib::iVtObjectOutputString_c iVtObjectosIsoAgLibVersionLabel_1;
IsoAgLib::iVtObjectOutputString_c iVtObjectosColon;
IsoAgLib::iVtObjectOutputNumber_c iVtObjectonTimeS;
IsoAgLib::iVtObjectEllipse_c iVtObjectelStateGreen;
IsoAgLib::iVtObjectLinearBarGraph_c iVtObjectlbPtoRear;
IsoAgLib::iVtObjectLinearBarGraph_c iVtObjectlbPtoFront;
IsoAgLib::iVtObjectNumberVariable_c iVtObjectnvSpeedTheor;
IsoAgLib::iVtObjectNumberVariable_c iVtObjectnvDistTheor;
IsoAgLib::iVtObjectNumberVariable_c iVtObjectnvMaxPowerTime;
IsoAgLib::iVtObjectNumberVariable_c iVtObjectnvDistReal;
IsoAgLib::iVtObjectOutputNumber_c iVtObjectonDistReal;
IsoAgLib::iVtObjectOutputString_c iVtObjectosDistReal;
IsoAgLib::iVtObjectNumberVariable_c iVtObjectnvSpeedReal;
IsoAgLib::iVtObjectOutputNumber_c iVtObjectonSpeedReal;
IsoAgLib::iVtObjectOutputString_c iVtObjectosSpeedReal;
IsoAgLib::iVtObjectNumberVariable_c iVtObjectnvPtoRear;
IsoAgLib::iVtObjectOutputNumber_c iVtObjectonPtoRear;
IsoAgLib::iVtObjectOutputString_c iVtObjectosPtoRear;
IsoAgLib::iVtObjectNumberVariable_c iVtObjectnvPtoFront;
IsoAgLib::iVtObjectOutputNumber_c iVtObjectonPtoFront;
IsoAgLib::iVtObjectOutputString_c iVtObjectosAboutTitle;
IsoAgLib::iVtObjectOutputString_c iVtObjectosM;
IsoAgLib::iVtObjectOutputString_c iVtObjectosMin;
IsoAgLib::iVtObjectEllipse_c iVtObjectelStateRed;
IsoAgLib::iVtObjectOutputString_c iVtObjectosPtoFront;
IsoAgLib::iVtObjectOutputString_c iVtObjectosCmS;
IsoAgLib::iVtObjectOutputNumber_c iVtObjectonMaxPowerTime;
IsoAgLib::iVtObjectObjectPointer_c iVtObjectopKeySwitch;
IsoAgLib::iVtObjectOutputString_c iVtObjectosKeySwitch;
IsoAgLib::iVtObjectOutputNumber_c iVtObjectonTimeM;
IsoAgLib::iVtObjectOutputString_c iVtObjectosMaskTecu;
IsoAgLib::iVtObjectNumberVariable_c iVtObjectnvSec;
IsoAgLib::iVtObjectNumberVariable_c iVtObjectnvMin;
IsoAgLib::iVtObjectOutputString_c iVtObjectosNavTECU;
IsoAgLib::iVtObjectOutputString_c iVtObjectosNavTimePos;
IsoAgLib::iVtObjectOutputString_c iVtObjectosNavAbout;
IsoAgLib::iVtObjectKey_c iVtObjectkeyNavTECU;
IsoAgLib::iVtObjectNumberVariable_c iVtObjectnvHr;
IsoAgLib::iVtObjectKey_c iVtObjectkeyNavTimePos;
IsoAgLib::iVtObjectSoftKeyMask_c iVtObjectskmDisplay;
IsoAgLib::iVtObjectOutputString_c iVtObjectosMaskTimePos;
IsoAgLib::iVtObjectRectangle_c iVtObjectrecLogoFrame;
IsoAgLib::iVtObjectMeter_c iVtObjectmtrSpeed;
IsoAgLib::iVtObjectKey_c iVtObjectkeyNavAbout;
IsoAgLib::iVtObjectOutputNumber_c iVtObjectonTimeH;
IsoAgLib::iVtObjectNumberVariable_c iVtObjectnvLon;
IsoAgLib::iVtObjectNumberVariable_c iVtObjectnvLat;
IsoAgLib::iVtObjectOutputNumber_c iVtObjectonLon;
IsoAgLib::iVtObjectOutputString_c iVtObjectosLon;
IsoAgLib::iVtObjectOutputNumber_c iVtObjectonLat;
IsoAgLib::iVtObjectOutputString_c iVtObjectosLat;
IsoAgLib::iVtObjectOutputString_c iVtObjectosMaxPower;
IsoAgLib::iVtObjectOutputString_c iVtObjectosTime;
IsoAgLib::iVtObjectOutputString_c iVtObjectosTime_1;
IsoAgLib::iVtObjectFontAttributes_c iVtObjectfta6x8;
IsoAgLib::iVtObjectFontAttributes_c iVtObjectfta8x12_SK;
IsoAgLib::iVtObjectFontAttributes_c iVtObjectfta8x8;
IsoAgLib::iVtObjectFillAttributes_c iVtObjectflaContentBg;
IsoAgLib::iVtObjectFillAttributes_c iVtObjectflaFalse;
IsoAgLib::iVtObjectFillAttributes_c iVtObjectflaOk;
IsoAgLib::iVtObjectFillAttributes_c iVtObjectflaLogo;
IsoAgLib::iVtObjectLineAttributes_c iVtObjectlnSolidBlack;
