IsoAgLib::iVtObject_c::iVtObject_s* HUGE_MEM all_sROMs [] = {
 (IsoAgLib::iVtObject_c::iVtObject_s*)&iVtObjectwsTutorialDisplay_sROM,
 (IsoAgLib::iVtObject_c::iVtObject_s*)&iVtObjectmacroChangeMaskAbout_sROM,
 (IsoAgLib::iVtObject_c::iVtObject_s*)&iVtObjectmacroChangeMaskTecu_sROM,
 (IsoAgLib::iVtObject_c::iVtObject_s*)&iVtObjectmacroChangeMaskTimePos_sROM,
 (IsoAgLib::iVtObject_c::iVtObject_s*)&iVtObjectosWsDesc_sROM,
 (IsoAgLib::iVtObject_c::iVtObject_s*)&iVtObjectdmTimePos_sROM,
 (IsoAgLib::iVtObject_c::iVtObject_s*)&iVtObjectdmTecu_sROM,
 (IsoAgLib::iVtObject_c::iVtObject_s*)&iVtObjectdmAbout_sROM,
 (IsoAgLib::iVtObject_c::iVtObject_s*)&iVtObjectctnMaxPower_sROM,
 (IsoAgLib::iVtObject_c::iVtObject_s*)&iVtObjectctnLat_sROM,
 (IsoAgLib::iVtObject_c::iVtObject_s*)&iVtObjectctnLon_sROM,
 (IsoAgLib::iVtObject_c::iVtObject_s*)&iVtObjectctnKeySwitch_sROM,
 (IsoAgLib::iVtObject_c::iVtObject_s*)&iVtObjectctnIsoAgLib_sROM,
 (IsoAgLib::iVtObject_c::iVtObject_s*)&iVtObjectctnTime_sROM,
 (IsoAgLib::iVtObject_c::iVtObject_s*)&iVtObjectctnPtoFront_sROM,
 (IsoAgLib::iVtObject_c::iVtObject_s*)&iVtObjectctnPtoRear_sROM,
 (IsoAgLib::iVtObject_c::iVtObject_s*)&iVtObjectctnSpeedReal_sROM,
 (IsoAgLib::iVtObject_c::iVtObject_s*)&iVtObjectctnDistReal_sROM,
 (IsoAgLib::iVtObject_c::iVtObject_s*)&iVtObjectctnTimeValue_sROM,
 (IsoAgLib::iVtObject_c::iVtObject_s*)&iVtObjectctnIsoaglibVersion_sROM,
 (IsoAgLib::iVtObject_c::iVtObject_s*)&iVtObjectctnTutorialVersion_sROM,
 (IsoAgLib::iVtObject_c::iVtObject_s*)&iVtObjectctnBuildDate_sROM,
 (IsoAgLib::iVtObject_c::iVtObject_s*)&iVtObjectctnAbout_sROM,
 (IsoAgLib::iVtObject_c::iVtObject_s*)&iVtObjectctnSpeedDisplay_sROM,
 (IsoAgLib::iVtObject_c::iVtObject_s*)&iVtObjectctnPto_sROM,
 (IsoAgLib::iVtObject_c::iVtObject_s*)&iVtObjectctnDirectionDisplay_sROM,
 (IsoAgLib::iVtObject_c::iVtObject_s*)&iVtObjectctrHitchSetCurTrgt_sROM,
 (IsoAgLib::iVtObject_c::iVtObject_s*)&iVtObjectctrHitchGraphDisplay_sROM,
 (IsoAgLib::iVtObject_c::iVtObject_s*)&iVtObjectctrHitchTrgtStrDisplay_sROM,
 (IsoAgLib::iVtObject_c::iVtObject_s*)&iVtObjectctrHitch_sROM,
 (IsoAgLib::iVtObject_c::iVtObject_s*)&iVtObjectctrSpeed_sROM,
 (IsoAgLib::iVtObject_c::iVtObject_s*)&iVtObjectbtnHitchSetCurTrgt_sROM,
 (IsoAgLib::iVtObject_c::iVtObject_s*)&iVtObjectfta6x8_sROM,
 (IsoAgLib::iVtObject_c::iVtObject_s*)&iVtObjectopnHitchTargetAngle_sROM,
 (IsoAgLib::iVtObject_c::iVtObject_s*)&iVtObjectrctHitch_sROM,
 (IsoAgLib::iVtObject_c::iVtObject_s*)&iVtObjectrctSpeed_sROM,
 (IsoAgLib::iVtObject_c::iVtObject_s*)&iVtObjectrctIsoAgLibVersion_sROM,
 (IsoAgLib::iVtObject_c::iVtObject_s*)&iVtObjectrctTutorialVersion_sROM,
 (IsoAgLib::iVtObject_c::iVtObject_s*)&iVtObjectrctPto_sROM,
 (IsoAgLib::iVtObject_c::iVtObject_s*)&iVtObjectrctMaxPower_sROM,
 (IsoAgLib::iVtObject_c::iVtObject_s*)&iVtObjectrctKeySwitch_sROM,
 (IsoAgLib::iVtObject_c::iVtObject_s*)&iVtObjectrctDistReal_sROM,
 (IsoAgLib::iVtObject_c::iVtObject_s*)&iVtObjectrctBuildDate_sROM,
 (IsoAgLib::iVtObject_c::iVtObject_s*)&iVtObjectrctTime_sROM,
 (IsoAgLib::iVtObject_c::iVtObject_s*)&iVtObjectmtrDirection_sROM,
 (IsoAgLib::iVtObject_c::iVtObject_s*)&iVtObjectmtrHitch_sROM,
 (IsoAgLib::iVtObject_c::iVtObject_s*)&iVtObjectabgSpeed_sROM,
 (IsoAgLib::iVtObject_c::iVtObject_s*)&iVtObjectabgHitch_sROM,
 (IsoAgLib::iVtObject_c::iVtObject_s*)&iVtObjectpicWindrose_sROM,
 (IsoAgLib::iVtObject_c::iVtObject_s*)&iVtObjectpicIsoAgLib_sROM,
 (IsoAgLib::iVtObject_c::iVtObject_s*)&iVtObjectpicHitch_sROM,
 (IsoAgLib::iVtObject_c::iVtObject_s*)&iVtObjectpicSpeed_sROM,
 (IsoAgLib::iVtObject_c::iVtObject_s*)&iVtObjectpicKeyNavTecu_sROM,
 (IsoAgLib::iVtObject_c::iVtObject_s*)&iVtObjectpicKeyNavTimePos_sROM,
 (IsoAgLib::iVtObject_c::iVtObject_s*)&iVtObjectpicKeyNavAbout_sROM,
 (IsoAgLib::iVtObject_c::iVtObject_s*)&iVtObjectnvHitchAngle_sROM,
 (IsoAgLib::iVtObject_c::iVtObject_s*)&iVtObjectnvHitchAngleTarget_sROM,
 (IsoAgLib::iVtObject_c::iVtObject_s*)&iVtObjectfta8x12_SK_sROM,
 (IsoAgLib::iVtObject_c::iVtObject_s*)&iVtObjectfta8x8_sROM,
 (IsoAgLib::iVtObject_c::iVtObject_s*)&iVtObjectflaContentBg_sROM,
 (IsoAgLib::iVtObject_c::iVtObject_s*)&iVtObjectopsHitchTargetAngle_sROM,
 (IsoAgLib::iVtObject_c::iVtObject_s*)&iVtObjectopsHItchDegree_sROM,
 (IsoAgLib::iVtObject_c::iVtObject_s*)&iVtObjectopsHitchPlus45Deg_sROM,
 (IsoAgLib::iVtObject_c::iVtObject_s*)&iVtObjectopsHitchMinus45Deg_sROM,
 (IsoAgLib::iVtObject_c::iVtObject_s*)&iVtObjectopsHitch0Deg_sROM,
 (IsoAgLib::iVtObject_c::iVtObject_s*)&iVtObjectopsHitchSetTrgtBtnLabel_sROM,
 (IsoAgLib::iVtObject_c::iVtObject_s*)&iVtObjectopsSpeed0_sROM,
 (IsoAgLib::iVtObject_c::iVtObject_s*)&iVtObjectopsSpeed150_sROM,
 (IsoAgLib::iVtObject_c::iVtObject_s*)&iVtObjectopsSpeed300_sROM,
 (IsoAgLib::iVtObject_c::iVtObject_s*)&iVtObjectosRpm_sROM,
 (IsoAgLib::iVtObject_c::iVtObject_s*)&iVtObjectopPtoRearEngaged_sROM,
 (IsoAgLib::iVtObject_c::iVtObject_s*)&iVtObjectopPtoFrontEngaged_sROM,
 (IsoAgLib::iVtObject_c::iVtObject_s*)&iVtObjectosBuildDate_sROM,
 (IsoAgLib::iVtObject_c::iVtObject_s*)&iVtObjectosTutorialVersion_sROM,
 (IsoAgLib::iVtObject_c::iVtObject_s*)&iVtObjectosIsoaglibVersion_sROM,
 (IsoAgLib::iVtObject_c::iVtObject_s*)&iVtObjectosColon_sROM,
 (IsoAgLib::iVtObject_c::iVtObject_s*)&iVtObjectonTimeS_sROM,
 (IsoAgLib::iVtObject_c::iVtObject_s*)&iVtObjectelStateGreen_sROM,
 (IsoAgLib::iVtObject_c::iVtObject_s*)&iVtObjectlbPtoRear_sROM,
 (IsoAgLib::iVtObject_c::iVtObject_s*)&iVtObjectlbPtoFront_sROM,
 (IsoAgLib::iVtObject_c::iVtObject_s*)&iVtObjectnvSpeedTheor_sROM,
 (IsoAgLib::iVtObject_c::iVtObject_s*)&iVtObjectnvDistTheor_sROM,
 (IsoAgLib::iVtObject_c::iVtObject_s*)&iVtObjectnvMaxPowerTime_sROM,
 (IsoAgLib::iVtObject_c::iVtObject_s*)&iVtObjectnvDistReal_sROM,
 (IsoAgLib::iVtObject_c::iVtObject_s*)&iVtObjectonDistReal_sROM,
 (IsoAgLib::iVtObject_c::iVtObject_s*)&iVtObjectosDistReal_sROM,
 (IsoAgLib::iVtObject_c::iVtObject_s*)&iVtObjectnvSpeedReal_sROM,
 (IsoAgLib::iVtObject_c::iVtObject_s*)&iVtObjectonSpeedReal_sROM,
 (IsoAgLib::iVtObject_c::iVtObject_s*)&iVtObjectosSpeedReal_sROM,
 (IsoAgLib::iVtObject_c::iVtObject_s*)&iVtObjectnvPtoRear_sROM,
 (IsoAgLib::iVtObject_c::iVtObject_s*)&iVtObjectonPtoRear_sROM,
 (IsoAgLib::iVtObject_c::iVtObject_s*)&iVtObjectosPtoRear_sROM,
 (IsoAgLib::iVtObject_c::iVtObject_s*)&iVtObjectnvPtoFront_sROM,
 (IsoAgLib::iVtObject_c::iVtObject_s*)&iVtObjectonPtoFront_sROM,
 (IsoAgLib::iVtObject_c::iVtObject_s*)&iVtObjectosAboutTitle_sROM,
 (IsoAgLib::iVtObject_c::iVtObject_s*)&iVtObjectosM_sROM,
 (IsoAgLib::iVtObject_c::iVtObject_s*)&iVtObjectosMin_sROM,
 (IsoAgLib::iVtObject_c::iVtObject_s*)&iVtObjectelStateRed_sROM,
 (IsoAgLib::iVtObject_c::iVtObject_s*)&iVtObjectflaFalse_sROM,
 (IsoAgLib::iVtObject_c::iVtObject_s*)&iVtObjectosPtoFront_sROM,
 (IsoAgLib::iVtObject_c::iVtObject_s*)&iVtObjectosCmS_sROM,
 (IsoAgLib::iVtObject_c::iVtObject_s*)&iVtObjectflaOk_sROM,
 (IsoAgLib::iVtObject_c::iVtObject_s*)&iVtObjectonMaxPowerTime_sROM,
 (IsoAgLib::iVtObject_c::iVtObject_s*)&iVtObjectopKeySwitch_sROM,
 (IsoAgLib::iVtObject_c::iVtObject_s*)&iVtObjectosKeySwitch_sROM,
 (IsoAgLib::iVtObject_c::iVtObject_s*)&iVtObjectonTimeM_sROM,
 (IsoAgLib::iVtObject_c::iVtObject_s*)&iVtObjectosMaskTecu_sROM,
 (IsoAgLib::iVtObject_c::iVtObject_s*)&iVtObjectnvSec_sROM,
 (IsoAgLib::iVtObject_c::iVtObject_s*)&iVtObjectnvMin_sROM,
 (IsoAgLib::iVtObject_c::iVtObject_s*)&iVtObjectosNavTECU_sROM,
 (IsoAgLib::iVtObject_c::iVtObject_s*)&iVtObjectosNavTimePos_sROM,
 (IsoAgLib::iVtObject_c::iVtObject_s*)&iVtObjectosNavAbout_sROM,
 (IsoAgLib::iVtObject_c::iVtObject_s*)&iVtObjectkeyNavTECU_sROM,
 (IsoAgLib::iVtObject_c::iVtObject_s*)&iVtObjectnvHr_sROM,
 (IsoAgLib::iVtObject_c::iVtObject_s*)&iVtObjectkeyNavTimePos_sROM,
 (IsoAgLib::iVtObject_c::iVtObject_s*)&iVtObjectskmDisplay_sROM,
 (IsoAgLib::iVtObject_c::iVtObject_s*)&iVtObjectosMaskTimePos_sROM,
 (IsoAgLib::iVtObject_c::iVtObject_s*)&iVtObjectrecLogoFrame_sROM,
 (IsoAgLib::iVtObject_c::iVtObject_s*)&iVtObjectflaLogo_sROM,
 (IsoAgLib::iVtObject_c::iVtObject_s*)&iVtObjectmtrSpeed_sROM,
 (IsoAgLib::iVtObject_c::iVtObject_s*)&iVtObjectkeyNavAbout_sROM,
 (IsoAgLib::iVtObject_c::iVtObject_s*)&iVtObjectonTimeH_sROM,
 (IsoAgLib::iVtObject_c::iVtObject_s*)&iVtObjectnvLon_sROM,
 (IsoAgLib::iVtObject_c::iVtObject_s*)&iVtObjectnvLat_sROM,
 (IsoAgLib::iVtObject_c::iVtObject_s*)&iVtObjectonLon_sROM,
 (IsoAgLib::iVtObject_c::iVtObject_s*)&iVtObjectosLon_sROM,
 (IsoAgLib::iVtObject_c::iVtObject_s*)&iVtObjectonLat_sROM,
 (IsoAgLib::iVtObject_c::iVtObject_s*)&iVtObjectosLat_sROM,
 (IsoAgLib::iVtObject_c::iVtObject_s*)&iVtObjectosMaxPower_sROM,
 (IsoAgLib::iVtObject_c::iVtObject_s*)&iVtObjectlnSolidBlack_sROM,
 (IsoAgLib::iVtObject_c::iVtObject_s*)&iVtObjectosBuildDateLabel_sROM,
 (IsoAgLib::iVtObject_c::iVtObject_s*)&iVtObjectosTutorialVersionLabel_sROM,
 (IsoAgLib::iVtObject_c::iVtObject_s*)&iVtObjectosIsoAgLibVersionLabel_sROM,
 (IsoAgLib::iVtObject_c::iVtObject_s*)&iVtObjectosTime_sROM,
 (IsoAgLib::iVtObject_c::iVtObject_s*)&iVtObjectosBuildDateLabel_1_sROM,
 (IsoAgLib::iVtObject_c::iVtObject_s*)&iVtObjectosTutorialVersionLabel_1_sROM,
 (IsoAgLib::iVtObject_c::iVtObject_s*)&iVtObjectosIsoAgLibVersionLabel_1_sROM,
 (IsoAgLib::iVtObject_c::iVtObject_s*)&iVtObjectosTime_1_sROM
};
