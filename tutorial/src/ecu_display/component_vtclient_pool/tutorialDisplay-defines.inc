static const unsigned int iVtObjectIDwsTutorialDisplay = 0;
static const unsigned int iVtObjectIDosWsDesc = 555;
static const unsigned int iVtObjectIDmacroChangeMaskAbout = 252;
static const unsigned int iVtObjectIDmacroChangeMaskTecu = 254;
static const unsigned int iVtObjectIDmacroChangeMaskTimePos = 255;
static const unsigned int iVtObjectIDdmTimePos = 1000;
static const unsigned int iVtObjectIDdmTecu = 1001;
static const unsigned int iVtObjectIDdmAbout = 1004;
static const unsigned int iVtObjectIDctnMaxPower = 2000;
static const unsigned int iVtObjectIDctnLat = 2001;
static const unsigned int iVtObjectIDctnLon = 2002;
static const unsigned int iVtObjectIDctnKeySwitch = 2003;
static const unsigned int iVtObjectIDctnIsoAgLib = 2004;
static const unsigned int iVtObjectIDctnTime = 2008;
static const unsigned int iVtObjectIDctnPtoFront = 2009;
static const unsigned int iVtObjectIDctnPtoRear = 2010;
static const unsigned int iVtObjectIDctnSpeedReal = 2011;
static const unsigned int iVtObjectIDctnDistReal = 2012;
static const unsigned int iVtObjectIDctnTimeValue = 2013;
static const unsigned int iVtObjectIDctnIsoaglibVersion = 2014;
static const unsigned int iVtObjectIDctnTutorialVersion = 2015;
static const unsigned int iVtObjectIDctnBuildDate = 2016;
static const unsigned int iVtObjectIDctnAbout = 2017;
static const unsigned int iVtObjectIDctnSpeedDisplay = 2018;
static const unsigned int iVtObjectIDctnPto = 2019;
static const unsigned int iVtObjectIDctnDirectionDisplay = 3000;
static const unsigned int iVtObjectIDctrHitchSetCurTrgt = 3001;
static const unsigned int iVtObjectIDctrHitchGraphDisplay = 3002;
static const unsigned int iVtObjectIDctrHitchTrgtStrDisplay = 3003;
static const unsigned int iVtObjectIDctrHitch = 3005;
static const unsigned int iVtObjectIDctrSpeed = 3006;
static const unsigned int iVtObjectIDbtnHitchSetCurTrgt = 6000;
static const unsigned int vtKeyCodebtnHitchSetCurTrgt =  253;
static const unsigned int iVtObjectIDopnHitchTargetAngle = 12001;
static const unsigned int iVtObjectIDrctHitch = 14000;
static const unsigned int iVtObjectIDrctSpeed = 14001;
static const unsigned int iVtObjectIDrctIsoAgLibVersion = 14002;
static const unsigned int iVtObjectIDrctTutorialVersion = 14003;
static const unsigned int iVtObjectIDrctPto = 14004;
static const unsigned int iVtObjectIDrctMaxPower = 14005;
static const unsigned int iVtObjectIDrctKeySwitch = 14006;
static const unsigned int iVtObjectIDrctDistReal = 14007;
static const unsigned int iVtObjectIDrctBuildDate = 14008;
static const unsigned int iVtObjectIDrctTime = 14009;
static const unsigned int iVtObjectIDmtrDirection = 17000;
static const unsigned int iVtObjectIDmtrHitch = 17002;
static const unsigned int iVtObjectIDabgSpeed = 19000;
static const unsigned int iVtObjectIDabgHitch = 19001;
static const unsigned int iVtObjectIDpicWindrose = 20000;
static const unsigned int iVtObjectIDpicIsoAgLib = 20001;
static const unsigned int iVtObjectIDpicHitch = 20002;
static const unsigned int iVtObjectIDpicSpeed = 20003;
static const unsigned int iVtObjectIDpicKeyNavTecu = 20004;
static const unsigned int iVtObjectIDpicKeyNavTimePos = 20005;
static const unsigned int iVtObjectIDpicKeyNavAbout = 20006;
static const unsigned int iVtObjectIDnvHitchAngle = 21000;
static const unsigned int iVtObjectIDnvHitchAngleTarget = 21001;
static const unsigned int iVtObjectIDopsHitchTargetAngle = 40002;
static const unsigned int iVtObjectIDopsHItchDegree = 40003;
static const unsigned int iVtObjectIDopsHitchPlus45Deg = 40004;
static const unsigned int iVtObjectIDopsHitchMinus45Deg = 40005;
static const unsigned int iVtObjectIDopsHitch0Deg = 40006;
static const unsigned int iVtObjectIDopsHitchSetTrgtBtnLabel = 40009;
static const unsigned int iVtObjectIDopsSpeed0 = 40011;
static const unsigned int iVtObjectIDopsSpeed150 = 40012;
static const unsigned int iVtObjectIDopsSpeed300 = 40014;
static const unsigned int iVtObjectIDosRpm = 65458;
static const unsigned int iVtObjectIDopPtoRearEngaged = 65459;
static const unsigned int iVtObjectIDopPtoFrontEngaged = 65460;
static const unsigned int iVtObjectIDosBuildDate = 65464;
static const unsigned int iVtObjectIDosBuildDateLabel = 65465;
static const unsigned int iVtObjectIDosBuildDateLabel_1 = 65465;
static const unsigned int iVtObjectIDosTutorialVersion = 65466;
static const unsigned int iVtObjectIDosTutorialVersionLabel = 65467;
static const unsigned int iVtObjectIDosTutorialVersionLabel_1 = 65467;
static const unsigned int iVtObjectIDosIsoaglibVersion = 65468;
static const unsigned int iVtObjectIDosIsoAgLibVersionLabel = 65469;
static const unsigned int iVtObjectIDosIsoAgLibVersionLabel_1 = 65469;
static const unsigned int iVtObjectIDosColon = 65470;
static const unsigned int iVtObjectIDonTimeS = 65471;
static const unsigned int iVtObjectIDelStateGreen = 65472;
static const unsigned int iVtObjectIDlbPtoRear = 65473;
static const unsigned int iVtObjectIDlbPtoFront = 65474;
static const unsigned int iVtObjectIDnvSpeedTheor = 65476;
static const unsigned int iVtObjectIDnvDistTheor = 65477;
static const unsigned int iVtObjectIDnvMaxPowerTime = 65478;
static const unsigned int iVtObjectIDnvDistReal = 65479;
static const unsigned int iVtObjectIDonDistReal = 65480;
static const unsigned int iVtObjectIDosDistReal = 65481;
static const unsigned int iVtObjectIDnvSpeedReal = 65482;
static const unsigned int iVtObjectIDonSpeedReal = 65483;
static const unsigned int iVtObjectIDosSpeedReal = 65484;
static const unsigned int iVtObjectIDnvPtoRear = 65485;
static const unsigned int iVtObjectIDonPtoRear = 65486;
static const unsigned int iVtObjectIDosPtoRear = 65487;
static const unsigned int iVtObjectIDnvPtoFront = 65488;
static const unsigned int iVtObjectIDonPtoFront = 65489;
static const unsigned int iVtObjectIDosAboutTitle = 65490;
static const unsigned int iVtObjectIDosM = 65494;
static const unsigned int iVtObjectIDosMin = 65496;
static const unsigned int iVtObjectIDelStateRed = 65497;
static const unsigned int iVtObjectIDosPtoFront = 65499;
static const unsigned int iVtObjectIDosCmS = 65500;
static const unsigned int iVtObjectIDonMaxPowerTime = 65502;
static const unsigned int iVtObjectIDopKeySwitch = 65503;
static const unsigned int iVtObjectIDosKeySwitch = 65504;
static const unsigned int iVtObjectIDonTimeM = 65505;
static const unsigned int iVtObjectIDosMaskTecu = 65506;
static const unsigned int iVtObjectIDnvSec = 65508;
static const unsigned int iVtObjectIDnvMin = 65509;
static const unsigned int iVtObjectIDosNavTECU = 65510;
static const unsigned int iVtObjectIDosNavTimePos = 65511;
static const unsigned int iVtObjectIDosNavAbout = 65512;
static const unsigned int iVtObjectIDkeyNavTECU = 65513;
static const unsigned int vtKeyCodekeyNavTECU = 254;
static const unsigned int iVtObjectIDnvHr = 65514;
static const unsigned int iVtObjectIDkeyNavTimePos = 65515;
static const unsigned int vtKeyCodekeyNavTimePos = 255;
static const unsigned int iVtObjectIDskmDisplay = 65516;
static const unsigned int iVtObjectIDosMaskTimePos = 65517;
static const unsigned int iVtObjectIDrecLogoFrame = 65518;
static const unsigned int iVtObjectIDmtrSpeed = 65522;
static const unsigned int iVtObjectIDkeyNavAbout = 65523;
static const unsigned int vtKeyCodekeyNavAbout = 252;
static const unsigned int iVtObjectIDonTimeH = 65524;
static const unsigned int iVtObjectIDnvLon = 65525;
static const unsigned int iVtObjectIDnvLat = 65526;
static const unsigned int iVtObjectIDonLon = 65527;
static const unsigned int iVtObjectIDosLon = 65528;
static const unsigned int iVtObjectIDonLat = 65529;
static const unsigned int iVtObjectIDosLat = 65530;
static const unsigned int iVtObjectIDosMaxPower = 65531;
static const unsigned int iVtObjectIDosTime = 65533;
static const unsigned int iVtObjectIDosTime_1 = 65533;
static const unsigned int iVtObjectIDfta6x8 = 10000;
static const unsigned int iVtObjectIDfta8x12_SK = 23001;
static const unsigned int iVtObjectIDfta8x8 = 23002;
static const unsigned int iVtObjectIDflaContentBg = 25000;
static const unsigned int iVtObjectIDflaFalse = 65498;
static const unsigned int iVtObjectIDflaOk = 65501;
static const unsigned int iVtObjectIDflaLogo = 65519;
static const unsigned int iVtObjectIDlnSolidBlack = 65532;
static const unsigned int vtObjectPoolDimension = 200;
static const unsigned int vtObjectPoolSoftKeyWidth = 60;
static const unsigned int vtObjectPoolSoftKeyHeight = 47;

static const unsigned int vtKeyCodeACK = 0;
