extern IsoAgLib::iVtObjectWorkingSet_c iVtObjectwsTutorialDisplay;
extern IsoAgLib::iVtObjectOutputString_c iVtObjectosWsDesc;
extern IsoAgLib::iVtObjectMacro_c iVtObjectmacroChangeMaskAbout;
extern IsoAgLib::iVtObjectMacro_c iVtObjectmacroChangeMaskTecu;
extern IsoAgLib::iVtObjectMacro_c iVtObjectmacroChangeMaskTimePos;
extern IsoAgLib::iVtObjectDataMask_c iVtObjectdmTimePos;
extern IsoAgLib::iVtObjectDataMask_c iVtObjectdmTecu;
extern IsoAgLib::iVtObjectDataMask_c iVtObjectdmAbout;
extern IsoAgLib::iVtObjectContainer_c iVtObjectctnMaxPower;
extern IsoAgLib::iVtObjectContainer_c iVtObjectctnLat;
extern IsoAgLib::iVtObjectContainer_c iVtObjectctnLon;
extern IsoAgLib::iVtObjectContainer_c iVtObjectctnKeySwitch;
extern IsoAgLib::iVtObjectContainer_c iVtObjectctnIsoAgLib;
extern IsoAgLib::iVtObjectContainer_c iVtObjectctnTime;
extern IsoAgLib::iVtObjectContainer_c iVtObjectctnPtoFront;
extern IsoAgLib::iVtObjectContainer_c iVtObjectctnPtoRear;
extern IsoAgLib::iVtObjectContainer_c iVtObjectctnSpeedReal;
extern IsoAgLib::iVtObjectContainer_c iVtObjectctnDistReal;
extern IsoAgLib::iVtObjectContainer_c iVtObjectctnTimeValue;
extern IsoAgLib::iVtObjectContainer_c iVtObjectctnIsoaglibVersion;
extern IsoAgLib::iVtObjectContainer_c iVtObjectctnTutorialVersion;
extern IsoAgLib::iVtObjectContainer_c iVtObjectctnBuildDate;
extern IsoAgLib::iVtObjectContainer_c iVtObjectctnAbout;
extern IsoAgLib::iVtObjectContainer_c iVtObjectctnSpeedDisplay;
extern IsoAgLib::iVtObjectContainer_c iVtObjectctnPto;
extern IsoAgLib::iVtObjectContainer_c iVtObjectctnDirectionDisplay;
extern IsoAgLib::iVtObjectContainer_c iVtObjectctrHitchSetCurTrgt;
extern IsoAgLib::iVtObjectContainer_c iVtObjectctrHitchGraphDisplay;
extern IsoAgLib::iVtObjectContainer_c iVtObjectctrHitchTrgtStrDisplay;
extern IsoAgLib::iVtObjectContainer_c iVtObjectctrHitch;
extern IsoAgLib::iVtObjectContainer_c iVtObjectctrSpeed;
extern IsoAgLib::iVtObjectButton_c iVtObjectbtnHitchSetCurTrgt;
extern IsoAgLib::iVtObjectOutputNumber_c iVtObjectopnHitchTargetAngle;
extern IsoAgLib::iVtObjectRectangle_c iVtObjectrctHitch;
extern IsoAgLib::iVtObjectRectangle_c iVtObjectrctSpeed;
extern IsoAgLib::iVtObjectRectangle_c iVtObjectrctIsoAgLibVersion;
extern IsoAgLib::iVtObjectRectangle_c iVtObjectrctTutorialVersion;
extern IsoAgLib::iVtObjectRectangle_c iVtObjectrctPto;
extern IsoAgLib::iVtObjectRectangle_c iVtObjectrctMaxPower;
extern IsoAgLib::iVtObjectRectangle_c iVtObjectrctKeySwitch;
extern IsoAgLib::iVtObjectRectangle_c iVtObjectrctDistReal;
extern IsoAgLib::iVtObjectRectangle_c iVtObjectrctBuildDate;
extern IsoAgLib::iVtObjectRectangle_c iVtObjectrctTime;
extern IsoAgLib::iVtObjectMeter_c iVtObjectmtrDirection;
extern IsoAgLib::iVtObjectMeter_c iVtObjectmtrHitch;
extern IsoAgLib::iVtObjectArchedBarGraph_c iVtObjectabgSpeed;
extern IsoAgLib::iVtObjectArchedBarGraph_c iVtObjectabgHitch;
extern IsoAgLib::iVtObjectPictureGraphic_c iVtObjectpicWindrose;
extern IsoAgLib::iVtObjectPictureGraphic_c iVtObjectpicIsoAgLib;
extern IsoAgLib::iVtObjectPictureGraphic_c iVtObjectpicHitch;
extern IsoAgLib::iVtObjectPictureGraphic_c iVtObjectpicSpeed;
extern IsoAgLib::iVtObjectPictureGraphic_c iVtObjectpicKeyNavTecu;
extern IsoAgLib::iVtObjectPictureGraphic_c iVtObjectpicKeyNavTimePos;
extern IsoAgLib::iVtObjectPictureGraphic_c iVtObjectpicKeyNavAbout;
extern IsoAgLib::iVtObjectNumberVariable_c iVtObjectnvHitchAngle;
extern IsoAgLib::iVtObjectNumberVariable_c iVtObjectnvHitchAngleTarget;
extern IsoAgLib::iVtObjectOutputString_c iVtObjectopsHitchTargetAngle;
extern IsoAgLib::iVtObjectOutputString_c iVtObjectopsHItchDegree;
extern IsoAgLib::iVtObjectOutputString_c iVtObjectopsHitchPlus45Deg;
extern IsoAgLib::iVtObjectOutputString_c iVtObjectopsHitchMinus45Deg;
extern IsoAgLib::iVtObjectOutputString_c iVtObjectopsHitch0Deg;
extern IsoAgLib::iVtObjectOutputString_c iVtObjectopsHitchSetTrgtBtnLabel;
extern IsoAgLib::iVtObjectOutputString_c iVtObjectopsSpeed0;
extern IsoAgLib::iVtObjectOutputString_c iVtObjectopsSpeed150;
extern IsoAgLib::iVtObjectOutputString_c iVtObjectopsSpeed300;
extern IsoAgLib::iVtObjectOutputString_c iVtObjectosRpm;
extern IsoAgLib::iVtObjectObjectPointer_c iVtObjectopPtoRearEngaged;
extern IsoAgLib::iVtObjectObjectPointer_c iVtObjectopPtoFrontEngaged;
extern IsoAgLib::iVtObjectOutputString_c iVtObjectosBuildDate;
extern IsoAgLib::iVtObjectOutputString_c iVtObjectosBuildDateLabel;
extern IsoAgLib::iVtObjectOutputString_c iVtObjectosBuildDateLabel_1;
extern IsoAgLib::iVtObjectOutputString_c iVtObjectosTutorialVersion;
extern IsoAgLib::iVtObjectOutputString_c iVtObjectosTutorialVersionLabel;
extern IsoAgLib::iVtObjectOutputString_c iVtObjectosTutorialVersionLabel_1;
extern IsoAgLib::iVtObjectOutputString_c iVtObjectosIsoaglibVersion;
extern IsoAgLib::iVtObjectOutputString_c iVtObjectosIsoAgLibVersionLabel;
extern IsoAgLib::iVtObjectOutputString_c iVtObjectosIsoAgLibVersionLabel_1;
extern IsoAgLib::iVtObjectOutputString_c iVtObjectosColon;
extern IsoAgLib::iVtObjectOutputNumber_c iVtObjectonTimeS;
extern IsoAgLib::iVtObjectEllipse_c iVtObjectelStateGreen;
extern IsoAgLib::iVtObjectLinearBarGraph_c iVtObjectlbPtoRear;
extern IsoAgLib::iVtObjectLinearBarGraph_c iVtObjectlbPtoFront;
extern IsoAgLib::iVtObjectNumberVariable_c iVtObjectnvSpeedTheor;
extern IsoAgLib::iVtObjectNumberVariable_c iVtObjectnvDistTheor;
extern IsoAgLib::iVtObjectNumberVariable_c iVtObjectnvMaxPowerTime;
extern IsoAgLib::iVtObjectNumberVariable_c iVtObjectnvDistReal;
extern IsoAgLib::iVtObjectOutputNumber_c iVtObjectonDistReal;
extern IsoAgLib::iVtObjectOutputString_c iVtObjectosDistReal;
extern IsoAgLib::iVtObjectNumberVariable_c iVtObjectnvSpeedReal;
extern IsoAgLib::iVtObjectOutputNumber_c iVtObjectonSpeedReal;
extern IsoAgLib::iVtObjectOutputString_c iVtObjectosSpeedReal;
extern IsoAgLib::iVtObjectNumberVariable_c iVtObjectnvPtoRear;
extern IsoAgLib::iVtObjectOutputNumber_c iVtObjectonPtoRear;
extern IsoAgLib::iVtObjectOutputString_c iVtObjectosPtoRear;
extern IsoAgLib::iVtObjectNumberVariable_c iVtObjectnvPtoFront;
extern IsoAgLib::iVtObjectOutputNumber_c iVtObjectonPtoFront;
extern IsoAgLib::iVtObjectOutputString_c iVtObjectosAboutTitle;
extern IsoAgLib::iVtObjectOutputString_c iVtObjectosM;
extern IsoAgLib::iVtObjectOutputString_c iVtObjectosMin;
extern IsoAgLib::iVtObjectEllipse_c iVtObjectelStateRed;
extern IsoAgLib::iVtObjectOutputString_c iVtObjectosPtoFront;
extern IsoAgLib::iVtObjectOutputString_c iVtObjectosCmS;
extern IsoAgLib::iVtObjectOutputNumber_c iVtObjectonMaxPowerTime;
extern IsoAgLib::iVtObjectObjectPointer_c iVtObjectopKeySwitch;
extern IsoAgLib::iVtObjectOutputString_c iVtObjectosKeySwitch;
extern IsoAgLib::iVtObjectOutputNumber_c iVtObjectonTimeM;
extern IsoAgLib::iVtObjectOutputString_c iVtObjectosMaskTecu;
extern IsoAgLib::iVtObjectNumberVariable_c iVtObjectnvSec;
extern IsoAgLib::iVtObjectNumberVariable_c iVtObjectnvMin;
extern IsoAgLib::iVtObjectOutputString_c iVtObjectosNavTECU;
extern IsoAgLib::iVtObjectOutputString_c iVtObjectosNavTimePos;
extern IsoAgLib::iVtObjectOutputString_c iVtObjectosNavAbout;
extern IsoAgLib::iVtObjectKey_c iVtObjectkeyNavTECU;
extern IsoAgLib::iVtObjectNumberVariable_c iVtObjectnvHr;
extern IsoAgLib::iVtObjectKey_c iVtObjectkeyNavTimePos;
extern IsoAgLib::iVtObjectSoftKeyMask_c iVtObjectskmDisplay;
extern IsoAgLib::iVtObjectOutputString_c iVtObjectosMaskTimePos;
extern IsoAgLib::iVtObjectRectangle_c iVtObjectrecLogoFrame;
extern IsoAgLib::iVtObjectMeter_c iVtObjectmtrSpeed;
extern IsoAgLib::iVtObjectKey_c iVtObjectkeyNavAbout;
extern IsoAgLib::iVtObjectOutputNumber_c iVtObjectonTimeH;
extern IsoAgLib::iVtObjectNumberVariable_c iVtObjectnvLon;
extern IsoAgLib::iVtObjectNumberVariable_c iVtObjectnvLat;
extern IsoAgLib::iVtObjectOutputNumber_c iVtObjectonLon;
extern IsoAgLib::iVtObjectOutputString_c iVtObjectosLon;
extern IsoAgLib::iVtObjectOutputNumber_c iVtObjectonLat;
extern IsoAgLib::iVtObjectOutputString_c iVtObjectosLat;
extern IsoAgLib::iVtObjectOutputString_c iVtObjectosMaxPower;
extern IsoAgLib::iVtObjectOutputString_c iVtObjectosTime;
extern IsoAgLib::iVtObjectOutputString_c iVtObjectosTime_1;
extern IsoAgLib::iVtObjectFontAttributes_c iVtObjectfta6x8;
extern IsoAgLib::iVtObjectFontAttributes_c iVtObjectfta8x12_SK;
extern IsoAgLib::iVtObjectFontAttributes_c iVtObjectfta8x8;
extern IsoAgLib::iVtObjectFillAttributes_c iVtObjectflaContentBg;
extern IsoAgLib::iVtObjectFillAttributes_c iVtObjectflaFalse;
extern IsoAgLib::iVtObjectFillAttributes_c iVtObjectflaOk;
extern IsoAgLib::iVtObjectFillAttributes_c iVtObjectflaLogo;
extern IsoAgLib::iVtObjectLineAttributes_c iVtObjectlnSolidBlack;
