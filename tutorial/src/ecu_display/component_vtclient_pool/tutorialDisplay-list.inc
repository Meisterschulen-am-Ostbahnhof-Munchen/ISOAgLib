IsoAgLib::iVtObject_c* HUGE_MEM all_iVtObjects [] = {
 &iVtObjectwsTutorialDisplay,
 &iVtObjectmacroChangeMaskAbout,
 &iVtObjectmacroChangeMaskTecu,
 &iVtObjectmacroChangeMaskTimePos,
 &iVtObjectosWsDesc,
 &iVtObjectdmTimePos,
 &iVtObjectdmTecu,
 &iVtObjectdmAbout,
 &iVtObjectctnMaxPower,
 &iVtObjectctnLat,
 &iVtObjectctnLon,
 &iVtObjectctnKeySwitch,
 &iVtObjectctnIsoAgLib,
 &iVtObjectctnTime,
 &iVtObjectctnPtoFront,
 &iVtObjectctnPtoRear,
 &iVtObjectctnSpeedReal,
 &iVtObjectctnDistReal,
 &iVtObjectctnTimeValue,
 &iVtObjectctnIsoaglibVersion,
 &iVtObjectctnTutorialVersion,
 &iVtObjectctnBuildDate,
 &iVtObjectctnAbout,
 &iVtObjectctnSpeedDisplay,
 &iVtObjectctnPto,
 &iVtObjectctnDirectionDisplay,
 &iVtObjectctrHitchSetCurTrgt,
 &iVtObjectctrHitchGraphDisplay,
 &iVtObjectctrHitchTrgtStrDisplay,
 &iVtObjectctrHitch,
 &iVtObjectctrSpeed,
 &iVtObjectbtnHitchSetCurTrgt,
 &iVtObjectfta6x8,
 &iVtObjectopnHitchTargetAngle,
 &iVtObjectrctHitch,
 &iVtObjectrctSpeed,
 &iVtObjectrctIsoAgLibVersion,
 &iVtObjectrctTutorialVersion,
 &iVtObjectrctPto,
 &iVtObjectrctMaxPower,
 &iVtObjectrctKeySwitch,
 &iVtObjectrctDistReal,
 &iVtObjectrctBuildDate,
 &iVtObjectrctTime,
 &iVtObjectmtrDirection,
 &iVtObjectmtrHitch,
 &iVtObjectabgSpeed,
 &iVtObjectabgHitch,
 &iVtObjectpicWindrose,
 &iVtObjectpicIsoAgLib,
 &iVtObjectpicHitch,
 &iVtObjectpicSpeed,
 &iVtObjectpicKeyNavTecu,
 &iVtObjectpicKeyNavTimePos,
 &iVtObjectpicKeyNavAbout,
 &iVtObjectnvHitchAngle,
 &iVtObjectnvHitchAngleTarget,
 &iVtObjectfta8x12_SK,
 &iVtObjectfta8x8,
 &iVtObjectflaContentBg,
 &iVtObjectopsHitchTargetAngle,
 &iVtObjectopsHItchDegree,
 &iVtObjectopsHitchPlus45Deg,
 &iVtObjectopsHitchMinus45Deg,
 &iVtObjectopsHitch0Deg,
 &iVtObjectopsHitchSetTrgtBtnLabel,
 &iVtObjectopsSpeed0,
 &iVtObjectopsSpeed150,
 &iVtObjectopsSpeed300,
 &iVtObjectosRpm,
 &iVtObjectopPtoRearEngaged,
 &iVtObjectopPtoFrontEngaged,
 &iVtObjectosBuildDate,
 &iVtObjectosTutorialVersion,
 &iVtObjectosIsoaglibVersion,
 &iVtObjectosColon,
 &iVtObjectonTimeS,
 &iVtObjectelStateGreen,
 &iVtObjectlbPtoRear,
 &iVtObjectlbPtoFront,
 &iVtObjectnvSpeedTheor,
 &iVtObjectnvDistTheor,
 &iVtObjectnvMaxPowerTime,
 &iVtObjectnvDistReal,
 &iVtObjectonDistReal,
 &iVtObjectosDistReal,
 &iVtObjectnvSpeedReal,
 &iVtObjectonSpeedReal,
 &iVtObjectosSpeedReal,
 &iVtObjectnvPtoRear,
 &iVtObjectonPtoRear,
 &iVtObjectosPtoRear,
 &iVtObjectnvPtoFront,
 &iVtObjectonPtoFront,
 &iVtObjectosAboutTitle,
 &iVtObjectosM,
 &iVtObjectosMin,
 &iVtObjectelStateRed,
 &iVtObjectflaFalse,
 &iVtObjectosPtoFront,
 &iVtObjectosCmS,
 &iVtObjectflaOk,
 &iVtObjectonMaxPowerTime,
 &iVtObjectopKeySwitch,
 &iVtObjectosKeySwitch,
 &iVtObjectonTimeM,
 &iVtObjectosMaskTecu,
 &iVtObjectnvSec,
 &iVtObjectnvMin,
 &iVtObjectosNavTECU,
 &iVtObjectosNavTimePos,
 &iVtObjectosNavAbout,
 &iVtObjectkeyNavTECU,
 &iVtObjectnvHr,
 &iVtObjectkeyNavTimePos,
 &iVtObjectskmDisplay,
 &iVtObjectosMaskTimePos,
 &iVtObjectrecLogoFrame,
 &iVtObjectflaLogo,
 &iVtObjectmtrSpeed,
 &iVtObjectkeyNavAbout,
 &iVtObjectonTimeH,
 &iVtObjectnvLon,
 &iVtObjectnvLat,
 &iVtObjectonLon,
 &iVtObjectosLon,
 &iVtObjectonLat,
 &iVtObjectosLat,
 &iVtObjectosMaxPower,
 &iVtObjectlnSolidBlack
};

IsoAgLib::iVtObject_c* HUGE_MEM * all_iVtObjectLists [] = {
  all_iVtObjects,
  all_iVtObjects0,
  all_iVtObjects1,
  NULL // indicate end of list
};
