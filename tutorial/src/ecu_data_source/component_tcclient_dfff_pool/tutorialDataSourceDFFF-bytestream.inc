const HUGE_MEM uint8_t deviceDescription_de [] = {0x61, 
'D', 'V', 'C', 0, 0, 0x7, 'D', 'e', 'v', 'i', 'c', 'e', '1', 0x3, '0', '.', '1', 0x1b, 0, 0xe0, 0xff, 0, 0x19, 0xa, 0xa0, 0x7, 'W', 'X', 'Y', 'Z', '9', '9', '9', 'S', 'T', 'R', 'U', 'C', 'T', '4', 'd', 'e', 0x50, 0x1, 0x5a, 0x56, 0xff, 
'D', 'E', 'T', 0xfe, 0xff, 0x1, 0x14, 'D', 'e', 'v', 'i', 'c', 'e', 'E', 'l', 'e', 'm', 'e', 'n', 't', 'G', 'e', 'n', 'e', 'r', 'a', 'l', 0, 0, 0, 0, 0x2, 0, 0xf9, 0xff, 0xf8, 0xff, 
'D', 'P', 'D', 0xf9, 0xff, 0x8d, 0, 0x1, 0x1, 0x6, 'O', 'n', ' ', 'O', 'f', 'f', 0xff, 0xff, 
'D', 'P', 'D', 0xf8, 0xff, 0xff, 0xdf, 0x1, 0x1, 0x18, 'd', 'e', 'f', 'a', 'u', 'l', 't', ' ', 'd', 'a', 't', 'a', ' ', 'l', 'o', 'g', 'g', 'i', 'n', 'g', ' ', 'D', 'D', 'I', 0xff, 0xff, 
'D', 'E', 'T', 0xfd, 0xff, 0x4, 0x14, 'D', 'e', 'v', 'i', 'c', 'e', 'E', 'l', 'e', 'm', 'e', 'n', 't', 'S', 'e', 'n', 's', 'o', 'r', 'A', 0x1, 0, 0xfe, 0xff, 0x1, 0, 0xf6, 0xff, 
'D', 'P', 'D', 0xf6, 0xff, 0x2, 0, 0x1, 0x1, 0x10, 'A', 'p', 'p', 'l', 'i', 'c', 'a', 't', 'i', 'o', 'n', ' ', 'R', 'a', 't', 'e', 0xff, 0xff, 
'D', 'E', 'T', 0xfc, 0xff, 0x4, 0x14, 'D', 'e', 'v', 'i', 'c', 'e', 'E', 'l', 'e', 'm', 'e', 'n', 't', 'S', 'e', 'n', 's', 'o', 'r', 'B', 0x2, 0, 0xfe, 0xff, 0x1, 0, 0xf5, 0xff, 
'D', 'P', 'D', 0xf5, 0xff, 0x2, 0, 0x1, 0x1, 0x10, 'A', 'p', 'p', 'l', 'i', 'c', 'a', 't', 'i', 'o', 'n', ' ', 'R', 'a', 't', 'e', 0xff, 0xff};

static const uint32_t ui32_arrayLength_de = 265;
