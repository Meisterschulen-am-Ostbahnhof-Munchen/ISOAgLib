const HUGE_MEM uint8_t deviceDescription_en [] = {0x61, 
'D', 'V', 'C', 0, 0, 0x7, 'D', 'e', 'v', 'i', 'c', 'e', '1', 0x3, '0', '.', '1', 0x1b, 0, 0xa0, 0x2c, 0, 0x80, 0xc, 0xa0, 0x7, 'W', 'X', 'Y', 'Z', '0', '1', '7', 'T', 'C', '0', '0', '0', '1', '7', 'e', 'n', 0x50, 0x1, 0x5a, 0x56, 0xff, 
'D', 'E', 'T', 0xfe, 0xff, 0x1, 0x11, 'S', 'p', 'r', 'a', 'y', 'e', 'r', ' ', 'I', 'n', 't', 'e', 'r', 'f', 'a', 'c', 'e', 0, 0, 0, 0, 0xa, 0, 0xf0, 0xff, 0xef, 0xff, 0xee, 0xff, 0xed, 0xff, 0xec, 0xff, 0xe6, 0xff, 0xe5, 0xff, 0xe4, 0xff, 0xe3, 0xff, 0xe2, 0xff, 
'D', 'P', 'T', 0xf0, 0xff, 0x86, 0, 0xc, 0xfe, 0xff, 0xff, 0x8, 'X', ' ', 'O', 'f', 'f', 's', 'e', 't', 0xff, 0xff, 
'D', 'P', 'T', 0xef, 0xff, 0x87, 0, 0, 0, 0, 0, 0x8, 'Y', ' ', 'O', 'f', 'f', 's', 'e', 't', 0xff, 0xff, 
'D', 'P', 'T', 0xee, 0xff, 0x88, 0, 0, 0, 0, 0, 0x8, 'Z', ' ', 'O', 'f', 'f', 's', 'e', 't', 0xff, 0xff, 
'D', 'P', 'T', 0xed, 0xff, 0x43, 0, 0x10, 0x27, 0, 0, 0xc, 'A', 'c', 't', 'u', 'a', 'l', ' ', 'W', 'i', 'd', 't', 'h', 0xff, 0xff, 
'D', 'P', 'T', 0xec, 0xff, 0x46, 0, 0x10, 0x27, 0, 0, 0x9, 'M', 'a', 'x', ' ', 'W', 'i', 'd', 't', 'h', 0xff, 0xff, 
'D', 'P', 'D', 0xe6, 0xff, 0x1, 0, 0x3, 0x9, 0x14, 'S', 'e', 't', 'p', 'o', 'i', 'n', 't', ' ', 'V', 'o', 'l', 'u', 'm', 'e', ' ', 'R', 'a', 't', 'e', 0xff, 0xff, 
'D', 'P', 'D', 0xe5, 0xff, 0x2, 0, 0x1, 0x9, 0x12, 'A', 'c', 't', 'u', 'a', 'l', ' ', 'V', 'o', 'l', 'u', 'm', 'e', ' ', 'R', 'a', 't', 'e', 0xff, 0xff, 
'D', 'P', 'D', 0xe4, 0xff, 0x8d, 0, 0, 0x8, 0xa, 'W', 'o', 'r', 'k', ' ', 'S', 't', 'a', 't', 'e', 0xff, 0xff, 
'D', 'P', 'D', 0xe3, 0xff, 0xa0, 0, 0x2, 0x9, 0x15, 'S', 'e', 'c', 't', 'i', 'o', 'n', ' ', 'C', 'o', 'n', 't', 'r', 'o', 'l', ' ', 'S', 't', 'a', 't', 'e', 0xff, 0xff, 
'D', 'P', 'D', 0xe2, 0xff, 0xff, 0xdf, 0x1, 0x1f, 0x18, 'd', 'e', 'f', 'a', 'u', 'l', 't', ' ', 'd', 'a', 't', 'a', ' ', 'l', 'o', 'g', 'g', 'i', 'n', 'g', ' ', 'D', 'D', 'I', 0xff, 0xff, 
'D', 'E', 'T', 0xfd, 0xff, 0x4, 0xa, 'S', 'e', 'c', 't', 'i', 'o', 'n', ' ', '0', '1', 0x1, 0, 0xfe, 0xff, 0x6, 0, 0xe1, 0xff, 0xe0, 0xff, 0xdf, 0xff, 0xde, 0xff, 0xdd, 0xff, 0xdb, 0xff, 
'D', 'P', 'T', 0xe1, 0xff, 0x86, 0, 0x88, 0x13, 0, 0, 0xb, 'X', ' ', 'O', 'f', 'f', 's', 'e', 't', ' ', '0', '1', 0xff, 0xff, 
'D', 'P', 'T', 0xe0, 0xff, 0x87, 0, 0x78, 0xec, 0xff, 0xff, 0xb, 'Y', ' ', 'O', 'f', 'f', 's', 'e', 't', ' ', '0', '1', 0xff, 0xff, 
'D', 'P', 'T', 0xdf, 0xff, 0x88, 0, 0, 0, 0, 0, 0xb, 'Z', ' ', 'O', 'f', 'f', 's', 'e', 't', ' ', '0', '1', 0xff, 0xff, 
'D', 'P', 'T', 0xde, 0xff, 0x43, 0, 0xe8, 0x3, 0, 0, 0xf, 'A', 'c', 't', 'u', 'a', 'l', ' ', 'W', 'i', 'd', 't', 'h', ' ', '0', '1', 0xff, 0xff, 
'D', 'P', 'T', 0xdd, 0xff, 0x46, 0, 0xe8, 0x3, 0, 0, 0xc, 'M', 'a', 'x', ' ', 'W', 'i', 'd', 't', 'h', ' ', '0', '1', 0xff, 0xff, 
'D', 'P', 'D', 0xdb, 0xff, 0x8d, 0, 0x3, 0x9, 0xd, 'W', 'S', ' ', 'S', 'e', 'c', 't', 'i', 'o', 'n', ' ', '0', '1', 0xff, 0xff, 
'D', 'E', 'T', 0xfc, 0xff, 0x4, 0xa, 'S', 'e', 'c', 't', 'i', 'o', 'n', ' ', '0', '2', 0x2, 0, 0xfe, 0xff, 0x6, 0, 0xda, 0xff, 0xd9, 0xff, 0xd8, 0xff, 0xd7, 0xff, 0xd6, 0xff, 0xd4, 0xff, 
'D', 'P', 'T', 0xda, 0xff, 0x86, 0, 0x88, 0x13, 0, 0, 0xb, 'X', ' ', 'O', 'f', 'f', 's', 'e', 't', ' ', '0', '2', 0xff, 0xff, 
'D', 'P', 'T', 0xd9, 0xff, 0x87, 0, 0x60, 0xf0, 0xff, 0xff, 0xb, 'Y', ' ', 'O', 'f', 'f', 's', 'e', 't', ' ', '0', '2', 0xff, 0xff, 
'D', 'P', 'T', 0xd8, 0xff, 0x88, 0, 0, 0, 0, 0, 0xb, 'Z', ' ', 'O', 'f', 'f', 's', 'e', 't', ' ', '0', '2', 0xff, 0xff, 
'D', 'P', 'T', 0xd7, 0xff, 0x43, 0, 0xe8, 0x3, 0, 0, 0xf, 'A', 'c', 't', 'u', 'a', 'l', ' ', 'W', 'i', 'd', 't', 'h', ' ', '0', '2', 0xff, 0xff, 
'D', 'P', 'T', 0xd6, 0xff, 0x46, 0, 0xe8, 0x3, 0, 0, 0xc, 'M', 'a', 'x', ' ', 'W', 'i', 'd', 't', 'h', ' ', '0', '2', 0xff, 0xff, 
'D', 'P', 'D', 0xd4, 0xff, 0x8d, 0, 0x3, 0x9, 0xd, 'W', 'S', ' ', 'S', 'e', 'c', 't', 'i', 'o', 'n', ' ', '0', '2', 0xff, 0xff, 
'D', 'E', 'T', 0xfb, 0xff, 0x4, 0xa, 'S', 'e', 'c', 't', 'i', 'o', 'n', ' ', '0', '3', 0x3, 0, 0xfe, 0xff, 0x6, 0, 0xd3, 0xff, 0xd2, 0xff, 0xd1, 0xff, 0xd0, 0xff, 0xcf, 0xff, 0xcd, 0xff, 
'D', 'P', 'T', 0xd3, 0xff, 0x86, 0, 0x88, 0x13, 0, 0, 0xb, 'X', ' ', 'O', 'f', 'f', 's', 'e', 't', ' ', '0', '3', 0xff, 0xff, 
'D', 'P', 'T', 0xd2, 0xff, 0x87, 0, 0x48, 0xf4, 0xff, 0xff, 0xb, 'Y', ' ', 'O', 'f', 'f', 's', 'e', 't', ' ', '0', '3', 0xff, 0xff, 
'D', 'P', 'T', 0xd1, 0xff, 0x88, 0, 0, 0, 0, 0, 0xb, 'Z', ' ', 'O', 'f', 'f', 's', 'e', 't', ' ', '0', '3', 0xff, 0xff, 
'D', 'P', 'T', 0xd0, 0xff, 0x43, 0, 0xe8, 0x3, 0, 0, 0xf, 'A', 'c', 't', 'u', 'a', 'l', ' ', 'W', 'i', 'd', 't', 'h', ' ', '0', '3', 0xff, 0xff, 
'D', 'P', 'T', 0xcf, 0xff, 0x46, 0, 0xe8, 0x3, 0, 0, 0xc, 'M', 'a', 'x', ' ', 'W', 'i', 'd', 't', 'h', ' ', '0', '3', 0xff, 0xff, 
'D', 'P', 'D', 0xcd, 0xff, 0x8d, 0, 0x3, 0x9, 0xd, 'W', 'S', ' ', 'S', 'e', 'c', 't', 'i', 'o', 'n', ' ', '0', '3', 0xff, 0xff, 
'D', 'E', 'T', 0xfa, 0xff, 0x4, 0xa, 'S', 'e', 'c', 't', 'i', 'o', 'n', ' ', '0', '4', 0x4, 0, 0xfe, 0xff, 0x6, 0, 0xcc, 0xff, 0xcb, 0xff, 0xca, 0xff, 0xc9, 0xff, 0xc8, 0xff, 0xc6, 0xff, 
'D', 'P', 'T', 0xcc, 0xff, 0x86, 0, 0x88, 0x13, 0, 0, 0xb, 'X', ' ', 'O', 'f', 'f', 's', 'e', 't', ' ', '0', '4', 0xff, 0xff, 
'D', 'P', 'T', 0xcb, 0xff, 0x87, 0, 0x30, 0xf8, 0xff, 0xff, 0xb, 'Y', ' ', 'O', 'f', 'f', 's', 'e', 't', ' ', '0', '4', 0xff, 0xff, 
'D', 'P', 'T', 0xca, 0xff, 0x88, 0, 0, 0, 0, 0, 0xb, 'Z', ' ', 'O', 'f', 'f', 's', 'e', 't', ' ', '0', '4', 0xff, 0xff, 
'D', 'P', 'T', 0xc9, 0xff, 0x43, 0, 0xe8, 0x3, 0, 0, 0xf, 'A', 'c', 't', 'u', 'a', 'l', ' ', 'W', 'i', 'd', 't', 'h', ' ', '0', '4', 0xff, 0xff, 
'D', 'P', 'T', 0xc8, 0xff, 0x46, 0, 0xe8, 0x3, 0, 0, 0xc, 'M', 'a', 'x', ' ', 'W', 'i', 'd', 't', 'h', ' ', '0', '4', 0xff, 0xff, 
'D', 'P', 'D', 0xc6, 0xff, 0x8d, 0, 0x3, 0x9, 0xd, 'W', 'S', ' ', 'S', 'e', 'c', 't', 'i', 'o', 'n', ' ', '0', '4', 0xff, 0xff, 
'D', 'E', 'T', 0xf9, 0xff, 0x4, 0xa, 'S', 'e', 'c', 't', 'i', 'o', 'n', ' ', '0', '5', 0x5, 0, 0xfe, 0xff, 0x6, 0, 0xc5, 0xff, 0xc4, 0xff, 0xc3, 0xff, 0xc2, 0xff, 0xc1, 0xff, 0xbf, 0xff, 
'D', 'P', 'T', 0xc5, 0xff, 0x86, 0, 0xc, 0xfe, 0xff, 0xff, 0xb, 'X', ' ', 'O', 'f', 'f', 's', 'e', 't', ' ', '0', '5', 0xff, 0xff, 
'D', 'P', 'T', 0xc4, 0xff, 0x87, 0, 0x18, 0xfc, 0xff, 0xff, 0xb, 'Y', ' ', 'O', 'f', 'f', 's', 'e', 't', ' ', '0', '5', 0xff, 0xff, 
'D', 'P', 'T', 0xc3, 0xff, 0x88, 0, 0, 0, 0, 0, 0xb, 'Z', ' ', 'O', 'f', 'f', 's', 'e', 't', ' ', '0', '5', 0xff, 0xff, 
'D', 'P', 'T', 0xc2, 0xff, 0x43, 0, 0xe8, 0x3, 0, 0, 0xf, 'A', 'c', 't', 'u', 'a', 'l', ' ', 'W', 'i', 'd', 't', 'h', ' ', '0', '5', 0xff, 0xff, 
'D', 'P', 'T', 0xc1, 0xff, 0x46, 0, 0xe8, 0x3, 0, 0, 0xc, 'M', 'a', 'x', ' ', 'W', 'i', 'd', 't', 'h', ' ', '0', '5', 0xff, 0xff, 
'D', 'P', 'D', 0xbf, 0xff, 0x8d, 0, 0x3, 0x9, 0xd, 'W', 'S', ' ', 'S', 'e', 'c', 't', 'i', 'o', 'n', ' ', '0', '5', 0xff, 0xff, 
'D', 'E', 'T', 0xf8, 0xff, 0x4, 0xa, 'S', 'e', 'c', 't', 'i', 'o', 'n', ' ', '0', '6', 0x6, 0, 0xfe, 0xff, 0x6, 0, 0xbe, 0xff, 0xbd, 0xff, 0xbc, 0xff, 0xbb, 0xff, 0xba, 0xff, 0xb8, 0xff, 
'D', 'P', 'T', 0xbe, 0xff, 0x86, 0, 0xc, 0xfe, 0xff, 0xff, 0xb, 'X', ' ', 'O', 'f', 'f', 's', 'e', 't', ' ', '0', '6', 0xff, 0xff, 
'D', 'P', 'T', 0xbd, 0xff, 0x87, 0, 0, 0, 0, 0, 0xb, 'Y', ' ', 'O', 'f', 'f', 's', 'e', 't', ' ', '0', '6', 0xff, 0xff, 
'D', 'P', 'T', 0xbc, 0xff, 0x88, 0, 0, 0, 0, 0, 0xb, 'Z', ' ', 'O', 'f', 'f', 's', 'e', 't', ' ', '0', '6', 0xff, 0xff, 
'D', 'P', 'T', 0xbb, 0xff, 0x43, 0, 0xe8, 0x3, 0, 0, 0xf, 'A', 'c', 't', 'u', 'a', 'l', ' ', 'W', 'i', 'd', 't', 'h', ' ', '0', '6', 0xff, 0xff, 
'D', 'P', 'T', 0xba, 0xff, 0x46, 0, 0xe8, 0x3, 0, 0, 0xc, 'M', 'a', 'x', ' ', 'W', 'i', 'd', 't', 'h', ' ', '0', '6', 0xff, 0xff, 
'D', 'P', 'D', 0xb8, 0xff, 0x8d, 0, 0x3, 0x9, 0xd, 'W', 'S', ' ', 'S', 'e', 'c', 't', 'i', 'o', 'n', ' ', '0', '6', 0xff, 0xff, 
'D', 'E', 'T', 0xf7, 0xff, 0x4, 0xa, 'S', 'e', 'c', 't', 'i', 'o', 'n', ' ', '0', '7', 0x7, 0, 0xfe, 0xff, 0x6, 0, 0xb7, 0xff, 0xb6, 0xff, 0xb5, 0xff, 0xb4, 0xff, 0xb3, 0xff, 0xb1, 0xff, 
'D', 'P', 'T', 0xb7, 0xff, 0x86, 0, 0xc, 0xfe, 0xff, 0xff, 0xb, 'X', ' ', 'O', 'f', 'f', 's', 'e', 't', ' ', '0', '7', 0xff, 0xff, 
'D', 'P', 'T', 0xb6, 0xff, 0x87, 0, 0xe8, 0x3, 0, 0, 0xb, 'Y', ' ', 'O', 'f', 'f', 's', 'e', 't', ' ', '0', '7', 0xff, 0xff, 
'D', 'P', 'T', 0xb5, 0xff, 0x88, 0, 0, 0, 0, 0, 0xb, 'Z', ' ', 'O', 'f', 'f', 's', 'e', 't', ' ', '0', '7', 0xff, 0xff, 
'D', 'P', 'T', 0xb4, 0xff, 0x43, 0, 0xe8, 0x3, 0, 0, 0xf, 'A', 'c', 't', 'u', 'a', 'l', ' ', 'W', 'i', 'd', 't', 'h', ' ', '0', '7', 0xff, 0xff, 
'D', 'P', 'T', 0xb3, 0xff, 0x46, 0, 0xe8, 0x3, 0, 0, 0xc, 'M', 'a', 'x', ' ', 'W', 'i', 'd', 't', 'h', ' ', '0', '7', 0xff, 0xff, 
'D', 'P', 'D', 0xb1, 0xff, 0x8d, 0, 0x3, 0x9, 0xd, 'W', 'S', ' ', 'S', 'e', 'c', 't', 'i', 'o', 'n', ' ', '0', '7', 0xff, 0xff, 
'D', 'E', 'T', 0xf6, 0xff, 0x4, 0xa, 'S', 'e', 'c', 't', 'i', 'o', 'n', ' ', '0', '8', 0x8, 0, 0xfe, 0xff, 0x6, 0, 0xb0, 0xff, 0xaf, 0xff, 0xae, 0xff, 0xad, 0xff, 0xac, 0xff, 0xaa, 0xff, 
'D', 'P', 'T', 0xb0, 0xff, 0x86, 0, 0xc, 0xfe, 0xff, 0xff, 0xb, 'X', ' ', 'O', 'f', 'f', 's', 'e', 't', ' ', '0', '8', 0xff, 0xff, 
'D', 'P', 'T', 0xaf, 0xff, 0x87, 0, 0xd0, 0x7, 0, 0, 0xb, 'Y', ' ', 'O', 'f', 'f', 's', 'e', 't', ' ', '0', '8', 0xff, 0xff, 
'D', 'P', 'T', 0xae, 0xff, 0x88, 0, 0, 0, 0, 0, 0xb, 'Z', ' ', 'O', 'f', 'f', 's', 'e', 't', ' ', '0', '8', 0xff, 0xff, 
'D', 'P', 'T', 0xad, 0xff, 0x43, 0, 0xe8, 0x3, 0, 0, 0xf, 'A', 'c', 't', 'u', 'a', 'l', ' ', 'W', 'i', 'd', 't', 'h', ' ', '0', '8', 0xff, 0xff, 
'D', 'P', 'T', 0xac, 0xff, 0x46, 0, 0xe8, 0x3, 0, 0, 0xc, 'M', 'a', 'x', ' ', 'W', 'i', 'd', 't', 'h', ' ', '0', '8', 0xff, 0xff, 
'D', 'P', 'D', 0xaa, 0xff, 0x8d, 0, 0x3, 0x9, 0xd, 'W', 'S', ' ', 'S', 'e', 'c', 't', 'i', 'o', 'n', ' ', '0', '8', 0xff, 0xff, 
'D', 'E', 'T', 0xf5, 0xff, 0x4, 0xa, 'S', 'e', 'c', 't', 'i', 'o', 'n', ' ', '0', '9', 0x9, 0, 0xfe, 0xff, 0x6, 0, 0xa9, 0xff, 0xa8, 0xff, 0xa7, 0xff, 0xa6, 0xff, 0xa5, 0xff, 0xa3, 0xff, 
'D', 'P', 'T', 0xa9, 0xff, 0x86, 0, 0xc, 0xfe, 0xff, 0xff, 0xb, 'X', ' ', 'O', 'f', 'f', 's', 'e', 't', ' ', '0', '9', 0xff, 0xff, 
'D', 'P', 'T', 0xa8, 0xff, 0x87, 0, 0xb8, 0xb, 0, 0, 0xb, 'Y', ' ', 'O', 'f', 'f', 's', 'e', 't', ' ', '0', '9', 0xff, 0xff, 
'D', 'P', 'T', 0xa7, 0xff, 0x88, 0, 0, 0, 0, 0, 0xb, 'Z', ' ', 'O', 'f', 'f', 's', 'e', 't', ' ', '0', '9', 0xff, 0xff, 
'D', 'P', 'T', 0xa6, 0xff, 0x43, 0, 0xe8, 0x3, 0, 0, 0xf, 'A', 'c', 't', 'u', 'a', 'l', ' ', 'W', 'i', 'd', 't', 'h', ' ', '0', '9', 0xff, 0xff, 
'D', 'P', 'T', 0xa5, 0xff, 0x46, 0, 0xe8, 0x3, 0, 0, 0xc, 'M', 'a', 'x', ' ', 'W', 'i', 'd', 't', 'h', ' ', '0', '9', 0xff, 0xff, 
'D', 'P', 'D', 0xa3, 0xff, 0x8d, 0, 0x3, 0x9, 0xd, 'W', 'S', ' ', 'S', 'e', 'c', 't', 'i', 'o', 'n', ' ', '0', '9', 0xff, 0xff, 
'D', 'E', 'T', 0xf4, 0xff, 0x4, 0xa, 'S', 'e', 'c', 't', 'i', 'o', 'n', ' ', '1', '0', 0xa, 0, 0xfe, 0xff, 0x6, 0, 0xa2, 0xff, 0xa1, 0xff, 0xa0, 0xff, 0x9f, 0xff, 0x9e, 0xff, 0x9c, 0xff, 
'D', 'P', 'T', 0xa2, 0xff, 0x86, 0, 0xc, 0xfe, 0xff, 0xff, 0xb, 'X', ' ', 'O', 'f', 'f', 's', 'e', 't', ' ', '1', '0', 0xff, 0xff, 
'D', 'P', 'T', 0xa1, 0xff, 0x87, 0, 0xa0, 0xf, 0, 0, 0xb, 'Y', ' ', 'O', 'f', 'f', 's', 'e', 't', ' ', '1', '0', 0xff, 0xff, 
'D', 'P', 'T', 0xa0, 0xff, 0x88, 0, 0, 0, 0, 0, 0xb, 'Z', ' ', 'O', 'f', 'f', 's', 'e', 't', ' ', '1', '0', 0xff, 0xff, 
'D', 'P', 'T', 0x9f, 0xff, 0x43, 0, 0xe8, 0x3, 0, 0, 0xf, 'A', 'c', 't', 'u', 'a', 'l', ' ', 'W', 'i', 'd', 't', 'h', ' ', '1', '0', 0xff, 0xff, 
'D', 'P', 'T', 0x9e, 0xff, 0x46, 0, 0xe8, 0x3, 0, 0, 0xc, 'M', 'a', 'x', ' ', 'W', 'i', 'd', 't', 'h', ' ', '1', '0', 0xff, 0xff, 
'D', 'P', 'D', 0x9c, 0xff, 0x8d, 0, 0x3, 0x9, 0xd, 'W', 'S', ' ', 'S', 'e', 'c', 't', 'i', 'o', 'n', ' ', '1', '0', 0xff, 0xff, 
'D', 'E', 'T', 0xf3, 0xff, 0x4, 0xa, 'S', 'e', 'c', 't', 'i', 'o', 'n', ' ', '1', '1', 0xb, 0, 0xfe, 0xff, 0x6, 0, 0x9b, 0xff, 0x9a, 0xff, 0x99, 0xff, 0x98, 0xff, 0x97, 0xff, 0x95, 0xff, 
'D', 'P', 'T', 0x9b, 0xff, 0x86, 0, 0xf4, 0x1, 0, 0, 0xb, 'X', ' ', 'O', 'f', 'f', 's', 'e', 't', ' ', '1', '1', 0xff, 0xff, 
'D', 'P', 'T', 0x9a, 0xff, 0x87, 0, 0xac, 0xd, 0, 0, 0xb, 'Y', ' ', 'O', 'f', 'f', 's', 'e', 't', ' ', '1', '1', 0xff, 0xff, 
'D', 'P', 'T', 0x99, 0xff, 0x88, 0, 0, 0, 0, 0, 0xb, 'Z', ' ', 'O', 'f', 'f', 's', 'e', 't', ' ', '1', '1', 0xff, 0xff, 
'D', 'P', 'T', 0x98, 0xff, 0x43, 0, 0xe8, 0x3, 0, 0, 0xf, 'A', 'c', 't', 'u', 'a', 'l', ' ', 'W', 'i', 'd', 't', 'h', ' ', '1', '1', 0xff, 0xff, 
'D', 'P', 'T', 0x97, 0xff, 0x46, 0, 0xe8, 0x3, 0, 0, 0xc, 'M', 'a', 'x', ' ', 'W', 'i', 'd', 't', 'h', ' ', '1', '1', 0xff, 0xff, 
'D', 'P', 'D', 0x95, 0xff, 0x8d, 0, 0x3, 0x9, 0x15, 'W', 'o', 'r', 'k', ' ', 'S', 't', 'a', 't', 'e', ' ', 'S', 'e', 'c', 't', 'i', 'o', 'n', ' ', '1', '1', 0xff, 0xff, 
'D', 'E', 'T', 0xf2, 0xff, 0x4, 0xa, 'S', 'e', 'c', 't', 'i', 'o', 'n', ' ', '1', '2', 0xc, 0, 0xfe, 0xff, 0x6, 0, 0x94, 0xff, 0x93, 0xff, 0x92, 0xff, 0x91, 0xff, 0x90, 0xff, 0x8e, 0xff, 
'D', 'P', 'T', 0x94, 0xff, 0x86, 0, 0xf4, 0x1, 0, 0, 0xb, 'X', ' ', 'O', 'f', 'f', 's', 'e', 't', ' ', '1', '2', 0xff, 0xff, 
'D', 'P', 'T', 0x93, 0xff, 0x87, 0, 0x94, 0x11, 0, 0, 0xb, 'Y', ' ', 'O', 'f', 'f', 's', 'e', 't', ' ', '1', '2', 0xff, 0xff, 
'D', 'P', 'T', 0x92, 0xff, 0x88, 0, 0, 0, 0, 0, 0xb, 'Z', ' ', 'O', 'f', 'f', 's', 'e', 't', ' ', '1', '2', 0xff, 0xff, 
'D', 'P', 'T', 0x91, 0xff, 0x43, 0, 0xe8, 0x3, 0, 0, 0xf, 'A', 'c', 't', 'u', 'a', 'l', ' ', 'W', 'i', 'd', 't', 'h', ' ', '1', '2', 0xff, 0xff, 
'D', 'P', 'T', 0x90, 0xff, 0x46, 0, 0xe8, 0x3, 0, 0, 0xc, 'M', 'a', 'x', ' ', 'W', 'i', 'd', 't', 'h', ' ', '1', '2', 0xff, 0xff, 
'D', 'P', 'D', 0x8e, 0xff, 0x8d, 0, 0x3, 0x9, 0x15, 'W', 'o', 'r', 'k', ' ', 'S', 't', 'a', 't', 'e', ' ', 'S', 'e', 'c', 't', 'i', 'o', 'n', ' ', '1', '2', 0xff, 0xff, 
'D', 'E', 'T', 0xf1, 0xff, 0x4, 0xa, 'S', 'e', 'c', 't', 'i', 'o', 'n', ' ', '1', '3', 0xd, 0, 0xfe, 0xff, 0x6, 0, 0x8d, 0xff, 0x8c, 0xff, 0x8b, 0xff, 0x8a, 0xff, 0x89, 0xff, 0x87, 0xff, 
'D', 'P', 'T', 0x8d, 0xff, 0x86, 0, 0xf4, 0x1, 0, 0, 0xb, 'X', ' ', 'O', 'f', 'f', 's', 'e', 't', ' ', '1', '3', 0xff, 0xff, 
'D', 'P', 'T', 0x8c, 0xff, 0x87, 0, 0x7c, 0x15, 0, 0, 0xb, 'Y', ' ', 'O', 'f', 'f', 's', 'e', 't', ' ', '1', '3', 0xff, 0xff, 
'D', 'P', 'T', 0x8b, 0xff, 0x88, 0, 0, 0, 0, 0, 0xb, 'Z', ' ', 'O', 'f', 'f', 's', 'e', 't', ' ', '1', '3', 0xff, 0xff, 
'D', 'P', 'T', 0x8a, 0xff, 0x43, 0, 0xe8, 0x3, 0, 0, 0xf, 'A', 'c', 't', 'u', 'a', 'l', ' ', 'W', 'i', 'd', 't', 'h', ' ', '1', '3', 0xff, 0xff, 
'D', 'P', 'T', 0x89, 0xff, 0x46, 0, 0xe8, 0x3, 0, 0, 0xc, 'M', 'a', 'x', ' ', 'W', 'i', 'd', 't', 'h', ' ', '1', '3', 0xff, 0xff, 
'D', 'P', 'D', 0x87, 0xff, 0x8d, 0, 0x3, 0x9, 0x15, 'W', 'o', 'r', 'k', ' ', 'S', 't', 'a', 't', 'e', ' ', 'S', 'e', 'c', 't', 'i', 'o', 'n', ' ', '1', '3', 0xff, 0xff};

static const uint32_t ui32_arrayLength_en = 2860;
