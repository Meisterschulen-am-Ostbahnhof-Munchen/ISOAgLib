const HUGE_MEM uint8_t deviceDescription_en [] = {0x61, 
'D', 'V', 'C', 0, 0, 0xa, 'T', 'e', 's', 't', 'P', 'a', 'r', 't', '1', '0', 0x3, '0', '.', '1', 0x1b, 0, 0xa0, 0x2c, 0, 0x80, 0xc, 0xa0, 0x7, 'W', 'X', 'Y', 'Z', '0', '1', '7', 'T', 'E', 'S', 'T', '0', '0', '1', 'e', 'n', 0x50, 0x1, 0x5a, 0x56, 0xff, 
'D', 'E', 'T', 0xfe, 0xff, 0x1, 0xe, 'T', 'e', 's', 't', ' ', 'I', 'n', 't', 'e', 'r', 'f', 'a', 'c', 'e', 0, 0, 0, 0, 0xa, 0, 0xfb, 0xff, 0xfa, 0xff, 0xf9, 0xff, 0xf8, 0xff, 0xf7, 0xff, 0xf6, 0xff, 0xf5, 0xff, 0xf4, 0xff, 0xf3, 0xff, 0xf2, 0xff, 
'D', 'P', 'T', 0xfb, 0xff, 0x86, 0, 0xc, 0xfe, 0xff, 0xff, 0x8, 'X', ' ', 'O', 'f', 'f', 's', 'e', 't', 0xff, 0xff, 
'D', 'P', 'T', 0xfa, 0xff, 0x87, 0, 0, 0, 0, 0, 0x8, 'Y', ' ', 'O', 'f', 'f', 's', 'e', 't', 0xff, 0xff, 
'D', 'P', 'T', 0xf9, 0xff, 0x88, 0, 0, 0, 0, 0, 0x8, 'Z', ' ', 'O', 'f', 'f', 's', 'e', 't', 0xff, 0xff, 
'D', 'P', 'T', 0xf8, 0xff, 0x43, 0, 0x10, 0x27, 0, 0, 0xc, 'A', 'c', 't', 'u', 'a', 'l', ' ', 'W', 'i', 'd', 't', 'h', 0xff, 0xff, 
'D', 'P', 'T', 0xf7, 0xff, 0x46, 0, 0x10, 0x27, 0, 0, 0x9, 'M', 'a', 'x', ' ', 'W', 'i', 'd', 't', 'h', 0xff, 0xff, 
'D', 'P', 'D', 0xf6, 0xff, 0x1, 0, 0x3, 0x9, 0x14, 'S', 'e', 't', 'p', 'o', 'i', 'n', 't', ' ', 'V', 'o', 'l', 'u', 'm', 'e', ' ', 'R', 'a', 't', 'e', 0xff, 0xff, 
'D', 'P', 'D', 0xf5, 0xff, 0x2, 0, 0x1, 0x9, 0x12, 'A', 'c', 't', 'u', 'a', 'l', ' ', 'V', 'o', 'l', 'u', 'm', 'e', ' ', 'R', 'a', 't', 'e', 0xff, 0xff, 
'D', 'P', 'D', 0xf4, 0xff, 0x8d, 0, 0, 0x8, 0xa, 'W', 'o', 'r', 'k', ' ', 'S', 't', 'a', 't', 'e', 0xff, 0xff, 
'D', 'P', 'D', 0xf3, 0xff, 0xa0, 0, 0x2, 0x9, 0x15, 'S', 'e', 'c', 't', 'i', 'o', 'n', ' ', 'C', 'o', 'n', 't', 'r', 'o', 'l', ' ', 'S', 't', 'a', 't', 'e', 0xff, 0xff, 
'D', 'P', 'D', 0xf2, 0xff, 0xff, 0xdf, 0x1, 0x1f, 0x18, 'd', 'e', 'f', 'a', 'u', 'l', 't', ' ', 'd', 'a', 't', 'a', ' ', 'l', 'o', 'g', 'g', 'i', 'n', 'g', ' ', 'D', 'D', 'I', 0xff, 0xff, 
'D', 'E', 'T', 0xfd, 0xff, 0x4, 0xa, 'S', 'e', 'c', 't', 'i', 'o', 'n', ' ', '0', '1', 0x1, 0, 0, 0, 0x6, 0, 0xf1, 0xff, 0xf0, 0xff, 0xef, 0xff, 0xee, 0xff, 0xed, 0xff, 0xec, 0xff, 
'D', 'P', 'T', 0xf1, 0xff, 0x86, 0, 0x88, 0x13, 0, 0, 0xb, 'X', ' ', 'O', 'f', 'f', 's', 'e', 't', ' ', '0', '1', 0xff, 0xff, 
'D', 'P', 'T', 0xf0, 0xff, 0x87, 0, 0x78, 0xec, 0xff, 0xff, 0xb, 'Y', ' ', 'O', 'f', 'f', 's', 'e', 't', ' ', '0', '1', 0xff, 0xff, 
'D', 'P', 'T', 0xef, 0xff, 0x88, 0, 0, 0, 0, 0, 0xb, 'Z', ' ', 'O', 'f', 'f', 's', 'e', 't', ' ', '0', '1', 0xff, 0xff, 
'D', 'P', 'T', 0xee, 0xff, 0x43, 0, 0x10, 0x27, 0, 0, 0xf, 'A', 'c', 't', 'u', 'a', 'l', ' ', 'W', 'i', 'd', 't', 'h', ' ', '0', '1', 0xff, 0xff, 
'D', 'P', 'T', 0xed, 0xff, 0x46, 0, 0x10, 0x27, 0, 0, 0xc, 'M', 'a', 'x', ' ', 'W', 'i', 'd', 't', 'h', ' ', '0', '1', 0xff, 0xff, 
'D', 'P', 'D', 0xec, 0xff, 0x8d, 0, 0x3, 0x9, 0xd, 'W', 'S', ' ', 'S', 'e', 'c', 't', 'i', 'o', 'n', ' ', '0', '1', 0xff, 0xff, 
'D', 'E', 'T', 0xfc, 0xff, 0x4, 0xa, 'S', 'e', 'c', 't', 'i', 'o', 'n', ' ', '0', '2', 0x2, 0, 0, 0, 0x6, 0, 0xeb, 0xff, 0xea, 0xff, 0xe9, 0xff, 0xe8, 0xff, 0xe7, 0xff, 0xe6, 0xff, 
'D', 'P', 'T', 0xeb, 0xff, 0x86, 0, 0x88, 0x13, 0, 0, 0xb, 'X', ' ', 'O', 'f', 'f', 's', 'e', 't', ' ', '0', '2', 0xff, 0xff, 
'D', 'P', 'T', 0xea, 0xff, 0x87, 0, 0x88, 0x13, 0, 0, 0xb, 'Y', ' ', 'O', 'f', 'f', 's', 'e', 't', ' ', '0', '2', 0xff, 0xff, 
'D', 'P', 'T', 0xe9, 0xff, 0x88, 0, 0, 0, 0, 0, 0xb, 'Z', ' ', 'O', 'f', 'f', 's', 'e', 't', ' ', '0', '2', 0xff, 0xff, 
'D', 'P', 'T', 0xe8, 0xff, 0x43, 0, 0x10, 0x27, 0, 0, 0xf, 'A', 'c', 't', 'u', 'a', 'l', ' ', 'W', 'i', 'd', 't', 'h', ' ', '0', '2', 0xff, 0xff, 
'D', 'P', 'T', 0xe7, 0xff, 0x46, 0, 0x10, 0x27, 0, 0, 0xc, 'M', 'a', 'x', ' ', 'W', 'i', 'd', 't', 'h', ' ', '0', '2', 0xff, 0xff, 
'D', 'P', 'D', 0xe6, 0xff, 0x8d, 0, 0x3, 0x9, 0xd, 'W', 'S', ' ', 'S', 'e', 'c', 't', 'i', 'o', 'n', ' ', '0', '2', 0xff, 0xff};

static const uint32_t ui32_arrayLength_en = 746;
