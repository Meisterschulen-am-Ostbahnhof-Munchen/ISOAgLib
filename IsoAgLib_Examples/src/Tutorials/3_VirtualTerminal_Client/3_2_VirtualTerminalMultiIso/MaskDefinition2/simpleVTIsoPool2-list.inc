IsoAgLib::iVtObject_c* all_iVtObjects_2 [] = {
  &iVtObjectimiIsoMaskupload_2,
  &iVtObjectopsWS1,
  &iVtObjectopsWS2,
  &iVtObjectcontainerInAllMasks_2,
  &iVtObjectrect1,
  &iVtObjectBigLogo_2,
  &iVtObjectleine_2,
  &iVtObjectVarOutNumVal,
  &iVtObjectOutNumVal,
  &iVtObjectInpString,
  &iVtObjectInpNumVal,
  &iVtObjectfrstLstElem,
  &iVtObjectscndLstElem,
  &iVtObjectthrdLstElem,
  &iVtObjectfrthLstElem,
  &iVtObjectInputNumList,
  &iVtObjectBtn1,
  &iVtObjectbtn1,
  &iVtObjectBtn2,
  &iVtObjectbtn2,
  &iVtObjectBtn3,
  &iVtObjectbtn3,
  &iVtObjectKeyReset_2,
  &iVtObjectKeyMove_2,
  &iVtObjectops1,
  &iVtObjectKeyLogo_2,
  &iVtObjectops2,
  &iVtObjectKeyChangeLang_2,
  &iVtObjectops3,
  &iVtObjectKeyChangeCol_2,
  &iVtObjectops4,
  &iVtObjectops5,
  &iVtObjectKeyForbidden_2,
  &iVtObjectops6,
  &iVtObjectKeyChangeMask_2,
  &iVtObjectops7,
  &iVtObjectKeyBackMask,
  &iVtObjectops8,
  &iVtObjectKeyNextMask,
  &iVtObjectops9,
  &iVtObjectdEllipse_2,
  &iVtObjectdPolygon_2,
  &iVtObjectMainMask_2,
  &iVtObjectmask1contentscontainer_2,
  &iVtObjectops10,
  &iVtObjectops11,
  &iVtObjectops12,
  &iVtObjectops13,
  &iVtObjectops14,
  &iVtObjectops15,
  &iVtObjectOutNumPtr,
  &iVtObjectInputListptr,
  &iVtObjectAccelArchedBarGraph_2,
  &iVtObjectOpsFakeMileage_2,
  &iVtObjectChangeAwayPointer_2,
  &iVtObjectrect2,
  &iVtObjectInputLikeage_2,
  &iVtObjectLikeageOP_2,
  &iVtObjectsoftkeys1_2,
  &iVtObjectAnotherMask_2,
  &iVtObjectops16,
  &iVtObjectops17,
  &iVtObjectops18,
  &iVtObjectops19,
  &iVtObjectops20,
  &iVtObjectops21,
  &iVtObjectops22,
  &iVtObjectsoftkeys2_2,
  &iVtObjectLastMask,
  &iVtObjectsoftkeys3,
  &iVtObjectForbiddenAlarmMask_2,
  &iVtObjectalarm1contentscontainer_2,
  &iVtObjectops23,
  &iVtObjectops24,
  &iVtObjectops25,
  &iVtObjectFontAttributesNormal6x8_2,
  &iVtObjectFillAttrib,
  &iVtObjectFillAttributes_2,
  &iVtObjectFontAttributesNormal8x12_2,
  &iVtObjectFontAttributesNormal6x8R_2,
  &iVtObjectFontAttributesNormal6x8B_2,
  &iVtObjectFontAttributesNormal8x8_2,
  &iVtObjectFontAttributesNormal12x16_2,
  &iVtObjectFontAttributesNormal16x16_2,
  &iVtObjectFontAttributesNormal16x24_2,
  &iVtObjectFontAttributesNormal24x32_2,
  &iVtObjectLineAttributes_Normal_2,
  &iVtObjectLineAttributesNormal_2,
  &iVtObjectLineAttributesDotted_2,
  &iVtObjectFontAttributesSKM6x8_2,
  &iVtObjectFontAttributesSKM8x8_2,
  &iVtObjectFontAttributesSKM12x16_2,
  &iVtObjectLineAttributesSKM_2,
  &iVtObjectFontAttributesNormal6x8_Button60x30_2
};

IsoAgLib::iVtObject_c** all_iVtObjectLists_2 [] = {
  all_iVtObjects_2,
  all_iVtObjects0_2,
  all_iVtObjects1_2,
  all_iVtObjects2_2,
  NULL // indicate end of list
};

iObjectPool_simpleVTIsoPool2_c::iObjectPool_simpleVTIsoPool2_c () : iIsoTerminalObjectPool_c (all_iVtObjectLists_2, 94, 3, 200, 60, 32) {};
