const HUGE_MEM uint8_t deviceDescription_de [] = {0x61, 
'D', 'V', 'C', 0, 0, 0x7, 'D', 'e', 'v', 'i', 'c', 'e', '1', 0x3, '0', '.', '1', 0x1b, 0, 0xe0, 0xff, 0, 0x19, 0xa, 0xa0, 0x7, 'W', 'X', 'Y', 'Z', '9', '9', '9', 'S', 'T', 'R', 'U', 'C', 'T', '4', 'd', 'e', 0x50, 0x1, 0x5a, 0x56, 0xff, 
'D', 'E', 'T', 0xfe, 0xff, 0x1, 0xe, 'D', 'e', 'v', 'i', 'c', 'e', 'E', 'l', 'e', 'm', 'e', 'n', 't', '1', 0, 0, 0, 0, 0x2, 0, 0xfc, 0xff, 0xfb, 0xff, 
'D', 'P', 'D', 0xfb, 0xff, 0x8d, 0, 0x1, 0x1, 0x18, 'W', 'o', 'r', 'k', 'S', 't', 'a', 't', 'e', ' ', 'S', 'e', 't', 'p', 'o', 'i', 'n', 't', ' ', 'e', 'x', 'a', 'c', 't', 0xff, 0xff, 
'D', 'P', 'D', 0, 0, 0x43, 0, 0x1, 0x1, 0x1c, 'W', 'o', 'r', 'k', 'i', 'n', 'g', ' ', 'w', 'i', 'd', 't', 'h', ' ', 'S', 'e', 't', 'p', 'o', 'i', 'n', 't', ' ', 'e', 'x', 'a', 'c', 't', 0xff, 0xff, 
'D', 'E', 'T', 0xfd, 0xff, 0x1, 0x7, 'D', 'e', 'v', 'i', 'c', 'e', '2', 0x2, 0, 0, 0, 0x4, 0, 0xf6, 0xff, 0xf5, 0xff, 0xf4, 0xff, 0xf3, 0xff, 
'D', 'P', 'D', 0xf3, 0xff, 0x1, 0, 0x1, 0x1, 0x1f, 'A', 'p', 'p', 'l', 'i', 'c', 'a', 't', 'i', 'o', 'n', ' ', 'R', 'a', 't', 'e', ' ', 'S', 'e', 't', 'p', 'o', 'i', 'n', 't', ' ', 'e', 'x', 'a', 'c', 't', 0xff, 0xff, 
'D', 'P', 'D', 0xf4, 0xff, 0x2, 0, 0x1, 0x1, 0x1e, 'A', 'p', 'p', 'l', 'i', 'c', 'a', 't', 'i', 'o', 'n', ' ', 'R', 'a', 't', 'e', ' ', 'M', 'e', 'a', 's', 'u', 'r', 'e', ' ', 'e', 'x', 'a', 'c', 't', 0xff, 0xff, 
'D', 'P', 'D', 0xf5, 0xff, 0x3, 0, 0x1, 0x1, 0x21, 'A', 'p', 'p', 'l', 'i', 'c', 'a', 't', 'i', 'o', 'n', ' ', 'R', 'a', 't', 'e', ' ', 'S', 'e', 't', 'p', 'o', 'i', 'n', 't', ' ', 'd', 'e', 'f', 'a', 'u', 'l', 't', 0xff, 0xff, 
'D', 'P', 'D', 0xf6, 0xff, 0x4, 0, 0x1, 0x1, 0x1d, 'A', 'p', 'p', 'l', 'i', 'c', 'a', 't', 'i', 'o', 'n', ' ', 'R', 'a', 't', 'e', ' ', 'S', 'e', 't', 'p', 'o', 'i', 'n', 't', ' ', 'm', 'i', 'n', 0xff, 0xff};

static const uint32_t ui32_arrayLength_de = 354;
