const HUGE_MEM uint8_t deviceDescription_de [] = {0x61, 
'D', 'V', 'C', 0, 0, 0x7, 'D', 'e', 'v', 'i', 'c', 'e', '1', 0x3, '0', '.', '1', 0x1b, 0, 0xe0, 0xff, 0, 0x19, 0xa, 0xa0, 0x7, 'W', 'X', 'Y', 'Z', '9', '9', '9', 'S', 'T', 'R', 'U', 'C', 'T', '4', 'd', 'e', 0x50, 0x1, 0x5a, 0x56, 0xff, 
'D', 'E', 'T', 0xfe, 0xff, 0x1, 0xe, 'D', 'e', 'v', 'i', 'c', 'e', 'E', 'l', 'e', 'm', 'e', 'n', 't', '1', 0, 0, 0, 0, 0x3, 0, 0xfb, 0xff, 0xfa, 0xff, 0xf9, 0xff, 
'D', 'P', 'D', 0xfb, 0xff, 0x8d, 0, 0x1, 0x1, 0x8, 'O', 'n', ' ', 'O', 'f', 'f', '_', '0', 0xff, 0xff, 
'D', 'P', 'D', 0xfa, 0xff, 0x1, 0, 0x1, 0x1, 0x12, 'A', 'p', 'p', 'l', 'i', 'c', 'a', 't', 'i', 'o', 'n', ' ', 'R', 'a', 't', 'e', '_', '0', 0xff, 0xff, 
'D', 'P', 'D', 0xf9, 0xff, 0x2, 0, 0x1, 0x1, 0x12, 'A', 'p', 'p', 'l', 'i', 'c', 'a', 't', 'i', 'o', 'n', ' ', 'R', 'a', 't', 'e', '_', '4', 0xff, 0xff};

static const uint32_t ui32_arrayLength_de = 161;
