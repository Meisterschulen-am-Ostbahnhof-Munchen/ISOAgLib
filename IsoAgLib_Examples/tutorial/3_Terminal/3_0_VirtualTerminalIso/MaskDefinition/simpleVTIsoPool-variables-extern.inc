extern IsoAgLib::iVtObjectWorkingSet_c iVtObjectimiIsoMaskupload;
extern IsoAgLib::iVtObjectOutputString_c iVtObjectUnnamed1;
extern IsoAgLib::iVtObjectOutputString_c iVtObjectUnnamed2;
extern IsoAgLib::iVtObjectFontAttributes_c iVtObjectFontAttributesNormal6x8;
extern IsoAgLib::iVtObjectFontAttributes_c iVtObjectFontAttributesNormal6x8LangDep;
extern IsoAgLib::iVtObjectFontAttributes_c iVtObjectFontAttributesNormal6x8LangDep_1;
extern IsoAgLib::iVtObjectFontAttributes_c iVtObjectFontAttributesNormal6x8LangDep_2;
extern IsoAgLib::iVtObjectFontAttributes_c iVtObjectFontAttributesNormal8x12;
extern IsoAgLib::iVtObjectFontAttributes_c iVtObjectFontAttributesNormal6x8R;
extern IsoAgLib::iVtObjectFontAttributes_c iVtObjectFontAttributesNormal6x8B;
extern IsoAgLib::iVtObjectFontAttributes_c iVtObjectFontAttributesNormal8x8;
extern IsoAgLib::iVtObjectFontAttributes_c iVtObjectFontAttributesNormal12x16;
extern IsoAgLib::iVtObjectFontAttributes_c iVtObjectFontAttributesNormal16x16;
extern IsoAgLib::iVtObjectFontAttributes_c iVtObjectFontAttributesNormal16x24;
extern IsoAgLib::iVtObjectFontAttributes_c iVtObjectFontAttributesNormal24x32;
extern IsoAgLib::iVtObjectLineAttributes_c iVtObjectLineAttributesNormal;
extern IsoAgLib::iVtObjectLineAttributes_c iVtObjectLineAttributesDotted;
extern IsoAgLib::iVtObjectFontAttributes_c iVtObjectFontAttributesSKM6x8;
extern IsoAgLib::iVtObjectFontAttributes_c iVtObjectFontAttributesSKM8x8;
extern IsoAgLib::iVtObjectFontAttributes_c iVtObjectFontAttributesSKM12x16;
extern IsoAgLib::iVtObjectLineAttributes_c iVtObjectLineAttributesSKM;
extern IsoAgLib::iVtObjectFontAttributes_c iVtObjectFontAttributesNormal6x8_Button60x30;
extern IsoAgLib::iVtObjectNumberVariable_c iVtObjectValSpeed;
extern IsoAgLib::iVtObjectNumberVariable_c iVtObjectValAccel;
extern IsoAgLib::iVtObjectNumberVariable_c iVtObjectValMiles;
extern IsoAgLib::iVtObjectStringVariable_c iVtObjectStrNone;
extern IsoAgLib::iVtObjectStringVariable_c iVtObjectStrNone_1;
extern IsoAgLib::iVtObjectStringVariable_c iVtObjectStrNone_2;
extern IsoAgLib::iVtObjectStringVariable_c iVtObjectStrRed;
extern IsoAgLib::iVtObjectStringVariable_c iVtObjectStrRed_1;
extern IsoAgLib::iVtObjectStringVariable_c iVtObjectStrRed_2;
extern IsoAgLib::iVtObjectStringVariable_c iVtObjectStrGreen;
extern IsoAgLib::iVtObjectStringVariable_c iVtObjectStrGreen_1;
extern IsoAgLib::iVtObjectStringVariable_c iVtObjectStrGreen_2;
extern IsoAgLib::iVtObjectStringVariable_c iVtObjectStrBlue;
extern IsoAgLib::iVtObjectStringVariable_c iVtObjectStrBlue_1;
extern IsoAgLib::iVtObjectStringVariable_c iVtObjectStrBlue_2;
extern IsoAgLib::iVtObjectStringVariable_c iVtObjectStrYellow;
extern IsoAgLib::iVtObjectStringVariable_c iVtObjectStrCyan;
extern IsoAgLib::iVtObjectStringVariable_c iVtObjectStrMagenta;
extern IsoAgLib::iVtObjectStringVariable_c iVtObjectStrBlack;
extern IsoAgLib::iVtObjectStringVariable_c iVtObjectStrWhite;
extern IsoAgLib::iVtObjectOutputString_c iVtObjectLikeIt;
extern IsoAgLib::iVtObjectOutputString_c iVtObjectLikeItNot;
extern IsoAgLib::iVtObjectContainer_c iVtObjectcontainerInAllMasks;
extern IsoAgLib::iVtObjectRectangle_c iVtObjectUnnamed3;
extern IsoAgLib::iVtObjectPictureGraphic_c iVtObjectBigLogo;
extern IsoAgLib::iVtObjectLine_c iVtObjectleine;
extern IsoAgLib::iVtObjectKey_c iVtObjectKeyReset;
extern IsoAgLib::iVtObjectOutputString_c iVtObjectresetTextOS;
extern IsoAgLib::iVtObjectOutputString_c iVtObjectresetTextOS_1;
extern IsoAgLib::iVtObjectOutputString_c iVtObjectresetTextOS_2;
extern IsoAgLib::iVtObjectInputNumber_c iVtObjectInputMiles;
extern IsoAgLib::iVtObjectDataMask_c iVtObjectMainMask;
extern IsoAgLib::iVtObjectContainer_c iVtObjectmask1contentscontainer;
extern IsoAgLib::iVtObjectOutputString_c iVtObjectUnnamed4;
extern IsoAgLib::iVtObjectOutputString_c iVtObjectspeedLabel;
extern IsoAgLib::iVtObjectOutputString_c iVtObjectUnnamed5;
extern IsoAgLib::iVtObjectOutputNumber_c iVtObjectUnnamed6;
extern IsoAgLib::iVtObjectOutputNumber_c iVtObjectUnnamed7;
extern IsoAgLib::iVtObjectOutputNumber_c iVtObjectUnnamed8;
extern IsoAgLib::iVtObjectLinearBarGraph_c iVtObjectUnnamed9;
extern IsoAgLib::iVtObjectOutputString_c iVtObjectColLabel;
extern IsoAgLib::iVtObjectOutputString_c iVtObjectColOS;
extern IsoAgLib::iVtObjectArchedBarGraph_c iVtObjectAccelArchedBarGraph;
extern IsoAgLib::iVtObjectOutputString_c iVtObjectOpsFakeMileage;
extern IsoAgLib::iVtObjectObjectPointer_c iVtObjectChangeAwayPointer;
extern IsoAgLib::iVtObjectInputList_c iVtObjectInputListTypFakeMiles;
extern IsoAgLib::iVtObjectOutputNumber_c iVtObjectUnnamed12;
extern IsoAgLib::iVtObjectOutputNumber_c iVtObjectUnnamed13;
extern IsoAgLib::iVtObjectOutputNumber_c iVtObjectUnnamed14;
extern IsoAgLib::iVtObjectOutputNumber_c iVtObjectUnnamed15;
extern IsoAgLib::iVtObjectOutputString_c iVtObjectUnnamed10;
extern IsoAgLib::iVtObjectRectangle_c iVtObjectUnnamed11;
extern IsoAgLib::iVtObjectInputBoolean_c iVtObjectInputLikeage;
extern IsoAgLib::iVtObjectObjectPointer_c iVtObjectLikeageOP;
