void iObjectPool_simpleVTIsoPool_c::initAllObjectsOnce ()
{
  if (b_initAllObjects) return;   // so the pointer to the ROM structures are only getting set once on initialization!
  iVtObjectimiIsoMaskupload.init (&iVtObjectimiIsoMaskupload_sROM);
  iVtObjectUnnamed1.init (&iVtObjectUnnamed1_sROM);
  iVtObjectUnnamed2.init (&iVtObjectUnnamed2_sROM);
  iVtObjectFontAttributesNormal6x8.init (&iVtObjectFontAttributesNormal6x8_sROM);
  iVtObjectFontAttributesNormal6x8R.init (&iVtObjectFontAttributesNormal6x8R_sROM);
  iVtObjectFontAttributesNormal6x8B.init (&iVtObjectFontAttributesNormal6x8B_sROM);
  iVtObjectFontAttributesNormal8x8.init (&iVtObjectFontAttributesNormal8x8_sROM);
  iVtObjectFontAttributesNormal12x16.init (&iVtObjectFontAttributesNormal12x16_sROM);
  iVtObjectLineAttributesNormal.init (&iVtObjectLineAttributesNormal_sROM);
  iVtObjectLineAttributesDotted.init (&iVtObjectLineAttributesDotted_sROM);
  iVtObjectFontAttributesSKM6x8.init (&iVtObjectFontAttributesSKM6x8_sROM);
  iVtObjectFontAttributesSKM8x8.init (&iVtObjectFontAttributesSKM8x8_sROM);
  iVtObjectFontAttributesSKM12x16.init (&iVtObjectFontAttributesSKM12x16_sROM);
  iVtObjectLineAttributesSKM.init (&iVtObjectLineAttributesSKM_sROM);
  iVtObjectValSpeed.init (&iVtObjectValSpeed_sROM);
  iVtObjectValAccel.init (&iVtObjectValAccel_sROM);
  iVtObjectValMiles.init (&iVtObjectValMiles_sROM);
  iVtObjectStrNone.init (&iVtObjectStrNone_sROM);
  iVtObjectStrRed.init (&iVtObjectStrRed_sROM);
  iVtObjectStrGreen.init (&iVtObjectStrGreen_sROM);
  iVtObjectStrBlue.init (&iVtObjectStrBlue_sROM);
  iVtObjectStrYellow.init (&iVtObjectStrYellow_sROM);
  iVtObjectStrCyan.init (&iVtObjectStrCyan_sROM);
  iVtObjectStrMagenta.init (&iVtObjectStrMagenta_sROM);
  iVtObjectStrBlack.init (&iVtObjectStrBlack_sROM);
  iVtObjectStrWhite.init (&iVtObjectStrWhite_sROM);
  iVtObjectLikeIt.init (&iVtObjectLikeIt_sROM);
  iVtObjectLikeItNot.init (&iVtObjectLikeItNot_sROM);
  iVtObjectcontainerInAllMasks.init (&iVtObjectcontainerInAllMasks_sROM);
  iVtObjectUnnamed3.init (&iVtObjectUnnamed3_sROM);
  iVtObjectBigLogo.init (&iVtObjectBigLogo_sROM);
  iVtObjectleine.init (&iVtObjectleine_sROM);
  iVtObjectKeyReset.init (&iVtObjectKeyReset_sROM);
  iVtObjectresetTextOS.init (&iVtObjectresetTextOS_sROM);
  iVtObjectMainMask.init (&iVtObjectMainMask_sROM);
  iVtObjectmask1contentscontainer.init (&iVtObjectmask1contentscontainer_sROM);
  iVtObjectUnnamed4.init (&iVtObjectUnnamed4_sROM);
  iVtObjectspeedLabel.init (&iVtObjectspeedLabel_sROM);
  iVtObjectUnnamed5.init (&iVtObjectUnnamed5_sROM);
  iVtObjectUnnamed6.init (&iVtObjectUnnamed6_sROM);
  iVtObjectUnnamed7.init (&iVtObjectUnnamed7_sROM);
  iVtObjectUnnamed8.init (&iVtObjectUnnamed8_sROM);
  iVtObjectUnnamed9.init (&iVtObjectUnnamed9_sROM);
  iVtObjectColLabel.init (&iVtObjectColLabel_sROM);
  iVtObjectColOS.init (&iVtObjectColOS_sROM);
  iVtObjectAccelArchedBarGraph.init (&iVtObjectAccelArchedBarGraph_sROM);
  iVtObjectInputListTypFakeMiles.init (&iVtObjectInputListTypFakeMiles_sROM);
  iVtObjectUnnamed12.init (&iVtObjectUnnamed12_sROM);
  iVtObjectUnnamed13.init (&iVtObjectUnnamed13_sROM);
  iVtObjectUnnamed14.init (&iVtObjectUnnamed14_sROM);
  iVtObjectUnnamed15.init (&iVtObjectUnnamed15_sROM);
  iVtObjectUnnamed10.init (&iVtObjectUnnamed10_sROM);
  iVtObjectInputMiles.init (&iVtObjectInputMiles_sROM);
  iVtObjectUnnamed11.init (&iVtObjectUnnamed11_sROM);
  iVtObjectInputLikeage.init (&iVtObjectInputLikeage_sROM);
  iVtObjectLikeageOP.init (&iVtObjectLikeageOP_sROM);
  iVtObjectKeyMoreAccel.init (&iVtObjectKeyMoreAccel_sROM);
  iVtObjectUnnamed16.init (&iVtObjectUnnamed16_sROM);
  iVtObjectKeyLessAccel.init (&iVtObjectKeyLessAccel_sROM);
  iVtObjectUnnamed17.init (&iVtObjectUnnamed17_sROM);
  iVtObjectsoftkeys1.init (&iVtObjectsoftkeys1_sROM);
  iVtObjectKeyMove.init (&iVtObjectKeyMove_sROM);
  iVtObjectUnnamed18.init (&iVtObjectUnnamed18_sROM);
  iVtObjectKeyLogo.init (&iVtObjectKeyLogo_sROM);
  iVtObjectUnnamed19.init (&iVtObjectUnnamed19_sROM);
  iVtObjectKeyChangeLang.init (&iVtObjectKeyChangeLang_sROM);
  iVtObjectUnnamed20.init (&iVtObjectUnnamed20_sROM);
  iVtObjectKeyChangeCol.init (&iVtObjectKeyChangeCol_sROM);
  iVtObjectUnnamed21.init (&iVtObjectUnnamed21_sROM);
  iVtObjectUnnamed22.init (&iVtObjectUnnamed22_sROM);
  iVtObjectKeyForbidden.init (&iVtObjectKeyForbidden_sROM);
  iVtObjectUnnamed23.init (&iVtObjectUnnamed23_sROM);
  iVtObjectLineAttributes_Normal.init (&iVtObjectLineAttributes_Normal_sROM);
  iVtObjectFillAttributes.init (&iVtObjectFillAttributes_sROM);
  iVtObjectdEllipse.init (&iVtObjectdEllipse_sROM);
  iVtObjectdPolygon.init (&iVtObjectdPolygon_sROM);
  iVtObjectdMeter.init (&iVtObjectdMeter_sROM);
  iVtObjectMacro_1.init (&iVtObjectMacro_1_sROM);
  iVtObjectMacro_2.init (&iVtObjectMacro_2_sROM);
  iVtObjectForbiddenAlarmMask.init (&iVtObjectForbiddenAlarmMask_sROM);
  iVtObjectalarm1contentscontainer.init (&iVtObjectalarm1contentscontainer_sROM);
  iVtObjectUnnamed24.init (&iVtObjectUnnamed24_sROM);
  iVtObjectUnnamed25.init (&iVtObjectUnnamed25_sROM);
  iVtObjectUnnamed26.init (&iVtObjectUnnamed26_sROM);
  iVtObjectsoftkeysAlarm.init (&iVtObjectsoftkeysAlarm_sROM);

  for (int i=0;i<numObjects; i++) {
    iVtObjects [i]->setOriginSKM (false);
  }
  b_initAllObjects = true;
}
