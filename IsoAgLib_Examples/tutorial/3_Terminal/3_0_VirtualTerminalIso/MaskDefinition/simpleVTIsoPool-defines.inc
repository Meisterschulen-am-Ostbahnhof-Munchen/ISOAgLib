#define iVtObjectIDimiIsoMaskupload 65534
#define iVtObjectIDUnnamed1 65533
#define iVtObjectIDUnnamed2 65532
#define iVtObjectIDFontAttributesNormal6x8 65531
#define iVtObjectIDFontAttributesNormal6x8LangDep 65530
#define iVtObjectIDFontAttributesNormal6x8LangDep_1 65530
#define iVtObjectIDFontAttributesNormal6x8LangDep_2 65530
#define iVtObjectIDFontAttributesNormal8x12 65529
#define iVtObjectIDFontAttributesNormal6x8R 65528
#define iVtObjectIDFontAttributesNormal6x8B 65527
#define iVtObjectIDFontAttributesNormal8x8 65526
#define iVtObjectIDFontAttributesNormal12x16 65525
#define iVtObjectIDFontAttributesNormal16x16 65524
#define iVtObjectIDFontAttributesNormal16x24 65523
#define iVtObjectIDFontAttributesNormal24x32 65522
#define iVtObjectIDLineAttributesNormal 65521
#define iVtObjectIDLineAttributesDotted 65520
#define iVtObjectIDFontAttributesSKM6x8 65519
#define iVtObjectIDFontAttributesSKM8x8 65518
#define iVtObjectIDFontAttributesSKM12x16 65517
#define iVtObjectIDLineAttributesSKM 65516
#define iVtObjectIDFontAttributesNormal6x8_Button60x30 65515
#define iVtObjectIDValSpeed 65514
#define iVtObjectIDValAccel 65513
#define iVtObjectIDValMiles 1234
#define iVtObjectIDStrNone 65512
#define iVtObjectIDStrNone_1 65512
#define iVtObjectIDStrNone_2 65512
#define iVtObjectIDStrRed 65511
#define iVtObjectIDStrRed_1 65511
#define iVtObjectIDStrRed_2 65511
#define iVtObjectIDStrGreen 65510
#define iVtObjectIDStrGreen_1 65510
#define iVtObjectIDStrGreen_2 65510
#define iVtObjectIDStrBlue 65509
#define iVtObjectIDStrBlue_1 65509
#define iVtObjectIDStrBlue_2 65509
#define iVtObjectIDStrYellow 65508
#define iVtObjectIDStrCyan 65507
#define iVtObjectIDStrMagenta 65506
#define iVtObjectIDStrBlack 65505
#define iVtObjectIDStrWhite 65504
#define iVtObjectIDLikeIt 65503
#define iVtObjectIDLikeItNot 65502
#define iVtObjectIDcontainerInAllMasks 65501
#define iVtObjectIDUnnamed3 65500
#define iVtObjectIDBigLogo 65499
#define iVtObjectIDleine 65498
#define iVtObjectIDKeyReset 65497
#define vtKeyCodeKeyReset 254
#define iVtObjectIDresetTextOS 65496
#define iVtObjectIDresetTextOS_1 65496
#define iVtObjectIDresetTextOS_2 65496
#define iVtObjectIDInputMiles 65495
#define iVtObjectIDMainMask 1101
#define iVtObjectIDmask1contentscontainer 65494
#define iVtObjectIDUnnamed4 65493
#define iVtObjectIDspeedLabel 65492
#define iVtObjectIDUnnamed5 65491
#define iVtObjectIDUnnamed6 65490
#define iVtObjectIDUnnamed7 65489
#define iVtObjectIDUnnamed8 65488
#define iVtObjectIDUnnamed9 65487
#define iVtObjectIDColLabel 65486
#define iVtObjectIDColOS 65485
#define iVtObjectIDAccelArchedBarGraph 65481
#define iVtObjectIDOpsFakeMileage 65480
#define iVtObjectIDChangeAwayPointer 65479
#define iVtObjectIDInputListTypFakeMiles 65478
#define iVtObjectIDUnnamed12 65465
#define iVtObjectIDUnnamed13 65464
#define iVtObjectIDUnnamed14 65463
#define iVtObjectIDUnnamed15 65462
#define iVtObjectIDUnnamed10 65477
#define iVtObjectIDUnnamed11 65476
#define iVtObjectIDInputLikeage 65475
#define iVtObjectIDLikeageOP 65474

#define vtKeyCodeACK 0
