IsoAgLib::iVtObjectWorkingSet_c iVtObjectimiIsoMaskupload;
IsoAgLib::iVtObjectOutputString_c iVtObjectUnnamed1;
IsoAgLib::iVtObjectOutputString_c iVtObjectUnnamed2;
IsoAgLib::iVtObjectFontAttributes_c iVtObjectFontAttributesNormal6x8;
IsoAgLib::iVtObjectFontAttributes_c iVtObjectFontAttributesNormal6x8LangDep;
IsoAgLib::iVtObjectFontAttributes_c iVtObjectFontAttributesNormal6x8LangDep_1;
IsoAgLib::iVtObjectFontAttributes_c iVtObjectFontAttributesNormal6x8LangDep_2;
IsoAgLib::iVtObjectFontAttributes_c iVtObjectFontAttributesNormal8x12;
IsoAgLib::iVtObjectFontAttributes_c iVtObjectFontAttributesNormal6x8R;
IsoAgLib::iVtObjectFontAttributes_c iVtObjectFontAttributesNormal6x8B;
IsoAgLib::iVtObjectFontAttributes_c iVtObjectFontAttributesNormal8x8;
IsoAgLib::iVtObjectFontAttributes_c iVtObjectFontAttributesNormal12x16;
IsoAgLib::iVtObjectFontAttributes_c iVtObjectFontAttributesNormal16x16;
IsoAgLib::iVtObjectFontAttributes_c iVtObjectFontAttributesNormal16x24;
IsoAgLib::iVtObjectFontAttributes_c iVtObjectFontAttributesNormal24x32;
IsoAgLib::iVtObjectLineAttributes_c iVtObjectLineAttributesNormal;
IsoAgLib::iVtObjectLineAttributes_c iVtObjectLineAttributesDotted;
IsoAgLib::iVtObjectFontAttributes_c iVtObjectFontAttributesSKM6x8;
IsoAgLib::iVtObjectFontAttributes_c iVtObjectFontAttributesSKM8x8;
IsoAgLib::iVtObjectFontAttributes_c iVtObjectFontAttributesSKM12x16;
IsoAgLib::iVtObjectLineAttributes_c iVtObjectLineAttributesSKM;
IsoAgLib::iVtObjectFontAttributes_c iVtObjectFontAttributesNormal6x8_Button60x30;
IsoAgLib::iVtObjectNumberVariable_c iVtObjectValSpeed;
IsoAgLib::iVtObjectNumberVariable_c iVtObjectValAccel;
IsoAgLib::iVtObjectNumberVariable_c iVtObjectValMiles;
IsoAgLib::iVtObjectStringVariable_c iVtObjectStrNone;
IsoAgLib::iVtObjectStringVariable_c iVtObjectStrNone_1;
IsoAgLib::iVtObjectStringVariable_c iVtObjectStrNone_2;
IsoAgLib::iVtObjectStringVariable_c iVtObjectStrRed;
IsoAgLib::iVtObjectStringVariable_c iVtObjectStrRed_1;
IsoAgLib::iVtObjectStringVariable_c iVtObjectStrRed_2;
IsoAgLib::iVtObjectStringVariable_c iVtObjectStrGreen;
IsoAgLib::iVtObjectStringVariable_c iVtObjectStrGreen_1;
IsoAgLib::iVtObjectStringVariable_c iVtObjectStrGreen_2;
IsoAgLib::iVtObjectStringVariable_c iVtObjectStrBlue;
IsoAgLib::iVtObjectStringVariable_c iVtObjectStrBlue_1;
IsoAgLib::iVtObjectStringVariable_c iVtObjectStrBlue_2;
IsoAgLib::iVtObjectStringVariable_c iVtObjectStrYellow;
IsoAgLib::iVtObjectStringVariable_c iVtObjectStrCyan;
IsoAgLib::iVtObjectStringVariable_c iVtObjectStrMagenta;
IsoAgLib::iVtObjectStringVariable_c iVtObjectStrBlack;
IsoAgLib::iVtObjectStringVariable_c iVtObjectStrWhite;
IsoAgLib::iVtObjectOutputString_c iVtObjectLikeIt;
IsoAgLib::iVtObjectOutputString_c iVtObjectLikeItNot;
IsoAgLib::iVtObjectContainer_c iVtObjectcontainerInAllMasks;
IsoAgLib::iVtObjectRectangle_c iVtObjectUnnamed3;
IsoAgLib::iVtObjectPictureGraphic_c iVtObjectBigLogo;
IsoAgLib::iVtObjectLine_c iVtObjectleine;
IsoAgLib::iVtObjectKey_c iVtObjectKeyReset;
IsoAgLib::iVtObjectOutputString_c iVtObjectresetTextOS;
IsoAgLib::iVtObjectOutputString_c iVtObjectresetTextOS_1;
IsoAgLib::iVtObjectOutputString_c iVtObjectresetTextOS_2;
IsoAgLib::iVtObjectInputNumber_c iVtObjectInputMiles;
IsoAgLib::iVtObjectDataMask_c iVtObjectMainMask;
IsoAgLib::iVtObjectContainer_c iVtObjectmask1contentscontainer;
IsoAgLib::iVtObjectOutputString_c iVtObjectUnnamed4;
IsoAgLib::iVtObjectOutputString_c iVtObjectspeedLabel;
IsoAgLib::iVtObjectOutputString_c iVtObjectUnnamed5;
IsoAgLib::iVtObjectOutputNumber_c iVtObjectUnnamed6;
IsoAgLib::iVtObjectOutputNumber_c iVtObjectUnnamed7;
IsoAgLib::iVtObjectOutputNumber_c iVtObjectUnnamed8;
IsoAgLib::iVtObjectLinearBarGraph_c iVtObjectUnnamed9;
IsoAgLib::iVtObjectOutputString_c iVtObjectColLabel;
IsoAgLib::iVtObjectOutputString_c iVtObjectColOS;
IsoAgLib::iVtObjectArchedBarGraph_c iVtObjectAccelArchedBarGraph;
IsoAgLib::iVtObjectOutputString_c iVtObjectOpsFakeMileage;
IsoAgLib::iVtObjectObjectPointer_c iVtObjectChangeAwayPointer;
IsoAgLib::iVtObjectInputList_c iVtObjectInputListTypFakeMiles;
IsoAgLib::iVtObjectOutputNumber_c iVtObjectUnnamed12;
IsoAgLib::iVtObjectOutputNumber_c iVtObjectUnnamed13;
IsoAgLib::iVtObjectOutputNumber_c iVtObjectUnnamed14;
IsoAgLib::iVtObjectOutputNumber_c iVtObjectUnnamed15;
IsoAgLib::iVtObjectOutputString_c iVtObjectUnnamed10;
IsoAgLib::iVtObjectRectangle_c iVtObjectUnnamed11;
IsoAgLib::iVtObjectInputBoolean_c iVtObjectInputLikeage;
IsoAgLib::iVtObjectObjectPointer_c iVtObjectLikeageOP;
