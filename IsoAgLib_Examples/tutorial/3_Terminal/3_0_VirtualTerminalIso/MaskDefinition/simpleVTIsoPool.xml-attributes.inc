const IsoAgLib::repeat_vtLanguage_s ivtObjectimiIsoMaskupload_aLanguage [] = {{'r', 'o'}};
const IsoAgLib::repeat_iVtObject_x_y_iVtObjectFontAttributes_row_col_s iVtObjectimiIsoMaskupload_aObject_x_y_font_row_col [] = {{&iVtObjectUnnamed1, 0, 0, NULL ,0, 0}, {&iVtObjectUnnamed2, 0, 8, NULL ,0, 0}};
const IsoAgLib::iVtObject_c::iVtObjectWorkingSet_s iVtObjectimiIsoMaskupload_sROM = {65534, 1, 1, &iVtObjectMainMask, 2,iVtObjectimiIsoMaskupload_aObject_x_y_font_row_col, 0,NULL, 1,ivtObjectimiIsoMaskupload_aLanguage};
const IsoAgLib::iVtObject_c::iVtObjectOutputString_s iVtObjectUnnamed1_sROM = {65533, 60, 8, 1, &iVtObjectFontAttributesSKM6x8, 2, NULL, 0, 7, "LBS Lib", 0,NULL};
const IsoAgLib::iVtObject_c::iVtObjectOutputString_s iVtObjectUnnamed2_sROM = {65532, 60, 8, 1, &iVtObjectFontAttributesSKM6x8, 2, NULL, 0, 10, "WorkingSet", 0,NULL};
const IsoAgLib::iVtObject_c::iVtObjectFontAttributes_s iVtObjectFontAttributesNormal6x8_sROM = {65531, 0, 0, 0 /* ISO_LATIN_1 */, 0, 0,NULL};
const IsoAgLib::iVtObject_c::iVtObjectFontAttributes_s iVtObjectFontAttributesNormal6x8R_sROM = {65530, 12, 0, 0 /* ISO_LATIN_1 */, 0, 0,NULL};
const IsoAgLib::iVtObject_c::iVtObjectFontAttributes_s iVtObjectFontAttributesNormal6x8B_sROM = {65529, 9, 0, 0 /* ISO_LATIN_1 */, 13, 0,NULL};
const IsoAgLib::iVtObject_c::iVtObjectFontAttributes_s iVtObjectFontAttributesNormal8x8_sROM = {65528, 0, 1, 0 /* ISO_LATIN_1 */, 0, 0,NULL};
const IsoAgLib::iVtObject_c::iVtObjectFontAttributes_s iVtObjectFontAttributesNormal12x16_sROM = {65527, 0, 3, 0 /* ISO_LATIN_1 */, 0, 0,NULL};
const IsoAgLib::iVtObject_c::iVtObjectLineAttributes_s iVtObjectLineAttributesNormal_sROM = {65526, 0, 1, 0xffff, 0,NULL};
const IsoAgLib::iVtObject_c::iVtObjectLineAttributes_s iVtObjectLineAttributesDotted_sROM = {65525, 0, 1, 0x9999, 0,NULL};
const IsoAgLib::iVtObject_c::iVtObjectFontAttributes_s iVtObjectFontAttributesSKM6x8_sROM = {65524, 0, 0, 0 /* ISO_LATIN_1 */, 0, 0,NULL};
const IsoAgLib::iVtObject_c::iVtObjectFontAttributes_s iVtObjectFontAttributesSKM8x8_sROM = {65523, 0, 1, 0 /* ISO_LATIN_1 */, 0, 0,NULL};
const IsoAgLib::iVtObject_c::iVtObjectFontAttributes_s iVtObjectFontAttributesSKM12x16_sROM = {65522, 0, 3, 0 /* ISO_LATIN_1 */, 0, 0,NULL};
const IsoAgLib::iVtObject_c::iVtObjectLineAttributes_s iVtObjectLineAttributesSKM_sROM = {65521, 0, 1, 0xffff, 0,NULL};
const IsoAgLib::iVtObject_c::iVtObjectNumberVariable_s iVtObjectValSpeed_sROM = {65520, 0};
const IsoAgLib::iVtObject_c::iVtObjectNumberVariable_s iVtObjectValAccel_sROM = {65519, 10};
const IsoAgLib::iVtObject_c::iVtObjectNumberVariable_s iVtObjectValMiles_sROM = {1234, 0};
const IsoAgLib::iVtObject_c::iVtObjectStringVariable_s iVtObjectStrNone_sROM = {65518, 14, "none selected!"};
const IsoAgLib::iVtObject_c::iVtObjectStringVariable_s iVtObjectStrRed_sROM = {65517, 3, "red"};
const IsoAgLib::iVtObject_c::iVtObjectStringVariable_s iVtObjectStrGreen_sROM = {65516, 5, "green"};
const IsoAgLib::iVtObject_c::iVtObjectStringVariable_s iVtObjectStrBlue_sROM = {65515, 4, "blue"};
const IsoAgLib::iVtObject_c::iVtObjectStringVariable_s iVtObjectStrYellow_sROM = {65514, 6, "yellow"};
const IsoAgLib::iVtObject_c::iVtObjectStringVariable_s iVtObjectStrCyan_sROM = {65513, 4, "cyan"};
const IsoAgLib::iVtObject_c::iVtObjectStringVariable_s iVtObjectStrMagenta_sROM = {65512, 7, "magenta"};
const IsoAgLib::iVtObject_c::iVtObjectStringVariable_s iVtObjectStrBlack_sROM = {65511, 5, "black"};
const IsoAgLib::iVtObject_c::iVtObjectStringVariable_s iVtObjectStrWhite_sROM = {65510, 5, "white"};
const IsoAgLib::iVtObject_c::iVtObjectOutputString_s iVtObjectLikeIt_sROM = {65509, 200, 8, 1, &iVtObjectFontAttributesNormal6x8, 0, NULL, 0, 20, "That makes me happy.", 0,NULL};
const IsoAgLib::iVtObject_c::iVtObjectOutputString_s iVtObjectLikeItNot_sROM = {65508, 200, 8, 1, &iVtObjectFontAttributesNormal6x8, 0, NULL, 0, 20, "What did I do wrong?", 0,NULL};
const IsoAgLib::repeat_iVtObject_x_y_iVtObjectFontAttributes_row_col_s iVtObjectcontainerInAllMasks_aObject_x_y_font_row_col [] = {{&iVtObjectUnnamed3, 5, 5, NULL ,0, 0}, {&iVtObjectBigLogo, 0, 0, NULL ,0, 0}, {&iVtObjectleine, 0, 27, NULL ,0, 0}};
const IsoAgLib::iVtObject_c::iVtObjectContainer_s iVtObjectcontainerInAllMasks_sROM = {65507, 200, 30, 0, 3,iVtObjectcontainerInAllMasks_aObject_x_y_font_row_col, 0,NULL};
const IsoAgLib::iVtObject_c::iVtObjectRectangle_s iVtObjectUnnamed3_sROM = {65506, &iVtObjectLineAttributesDotted, 190, 15, 0, NULL, 0,NULL};
const HUGE_MEM uint8_t iVtObjectBigLogo_aRawBitmap0 [] = { /* Raw-Bitmap Data */ 255, 255, 255, 255, 255, 255, 255, 255, 255, 255, 255, 255, 240, 255, 255, 255, 255, 255, 255, 255, 255, 255, 255, 255, 255, 240, 255, 255, 255, 255, 255, 248, 127, 255, 255, 255, 255, 255, 240, 255, 255, 255, 255, 255, 240, 63, 255, 255, 255, 255, 255, 240, 224, 119, 231, 255, 255, 227, 159, 255, 255, 255, 255, 255, 240, 224, 103, 231, 255, 255, 247, 159, 255, 255, 255, 255, 255, 240, 249, 228, 230, 31, 255, 252, 31, 255, 255, 255, 255, 255, 240, 249, 224, 100, 95, 255, 241, 159, 255, 255, 255, 255, 255, 240, 249, 230, 100, 63, 255, 227, 159, 255, 255, 255, 255, 255, 240, 249, 230, 102, 31, 255, 231, 159, 255, 255, 255, 255, 255, 240, 249, 230, 103, 207, 255, 231, 31, 247, 255, 255, 255, 255, 240, 249, 230, 100, 31, 255, 224, 15, 195, 31, 255, 255, 255, 240, 253, 246, 239, 63, 63, 251, 15, 137, 31, 255, 255, 255, 240, 255, 255, 255, 255, 63, 255, 3, 137, 15, 24, 248, 252, 112, 255, 255, 255, 255, 253, 255, 0, 193, 6, 0, 96, 112, 48, 255, 255, 255, 254, 48, 63, 0, 195, 4, 0, 32, 48, 16, 255, 255, 255, 255, 51, 191, 24, 99, 28, 102, 2, 3, 144, 255, 255, 255, 255, 48, 127, 24, 99, 60, 102, 7, 3, 0, 255, 255, 255, 255, 60, 63, 0, 99, 28, 34, 0, 0, 16, 255, 255, 255, 255, 55, 159, 0, 227, 132, 0, 32, 0, 16, 255, 255, 255, 255, 48, 63, 1, 227, 196, 0, 48, 0, 48, 255, 255, 255, 254, 28, 255, 247, 231, 246, 102, 123, 32, 240, 255, 255, 255, 255, 255, 255, 255, 255, 255, 255, 255, 225, 240, 255, 255, 255, 255, 255, 255, 255, 255, 255, 255, 255, 225, 240, 255, 255, 255, 255, 255, 255, 255, 255, 255, 255, 255, 243, 240};
const HUGE_MEM uint8_t iVtObjectBigLogo_aRawBitmap2 [] = { /* RLE-Encoded Raw-Bitmap Data */ 245, 231,1, 145,3, 102,1, 188,93, 231,1, 188,2, 59,2, 145,1, 59,1, 16,1, 188,51, 231,1, 188,6, 102,1, 188,2, 231,1, 145,6, 231,1, 59,1, 102,22, 231,1, 102,1, 16,1, 145,2, 231,1, 188,1, 16,1, 102,51, 231,1, 188,2, 145,1, 59,1, 16,2, 145,1, 188,1, 231,1, 102,1, 16,6, 231,1, 102,1, 145,22, 231,1, 188,1, 145,1, 188,3, 231,1, 16,1, 102,54, 231,1, 102,1, 16,4, 231,1, 102,1, 16,1, 188,2, 102,3, 231,1, 16,1, 102,2, 231,1, 102,2, 16,1, 59,1, 188,18, 231,1, 145,2, 102,1, 16,1, 102,54, 231,1, 102,1, 16,4, 231,1, 102,1, 16,1, 102,1, 145,1, 16,1, 102,2, 231,1, 16,1, 102,1, 231,1, 145,1, 16,1, 145,1, 231,1, 145,17, 231,1, 102,1, 16,1, 102,1, 188,1, 231,1, 16,1, 102,54, 231,1, 102,1, 16,4, 231,1, 102,1, 16,1, 188,1, 231,1, 16,1, 102,2, 231,1, 16,1, 102,1, 231,1, 145,1, 16,1, 59,1, 102,1, 188,16, 231,1, 102,1, 16,1, 145,3, 231,1, 16,1, 102,54, 231,1, 102,1, 16,4, 231,1, 102,1, 16,2, 231,1, 16,1, 102,2, 231,1, 16,1, 102,2, 231,1, 145,1, 59,2, 16,1, 188,15, 231,2, 16,4, 231,1, 16,1, 102,54, 231,1, 102,1, 16,4, 231,1, 102,1, 16,2, 231,1, 16,1, 102,2, 231,1, 16,1, 102,4, 231,1, 188,1, 16,1, 102,15, 231,1, 59,1, 16,1, 188,2, 231,1, 102,1, 16,1, 59,1, 188,7, 231,1, 188,1, 145,44, 231,1, 102,1, 16,4, 231,1, 102,1, 16,2, 231,1, 16,1, 102,2, 231,1, 16,1, 102,1, 231,1, 145,1, 59,1, 102,1, 59,1, 16,1, 188,15, 231,1, 145,2, 16,1, 102,2, 59,2, 16,1, 102,6, 231,1, 102,1, 16,1, 102,1, 59,1, 188,1, 231,3, 102,38, 231,1, 188,1, 145,4, 231,1, 188,1, 145,2, 231,1, 145,1, 188,2, 231,1, 145,1, 188,2, 231,1, 188,2, 145,6, 231,2, 145,10, 231,1, 188,1, 145,1, 188,1, 231,1, 102,2, 16,1, 102,5, 231,1, 145,1, 102,1, 145,1, 188,2, 102,1, 231,3, 16,65, 231,1, 102,1, 59,14, 231,1, 102,2, 16,1, 145,2, 102,1, 188,2, 231,1, 145,1, 59,1, 145,1, 231,1, 102,1, 59,1, 231,3, 16,1, 102,1, 188,2, 231,1, 188,2, 102,1, 145,1, 231,1, 188,2, 102,1, 145,4, 231,1, 188,2, 102,1, 145,1, 188,4, 231,1, 188,2, 102,1, 145,1, 188,34, 231,2, 188,3, 231,1, 188,1, 145,1, 188,8, 231,1, 102,2, 16,1, 59,3, 16,1, 145,1, 231,1, 188,1, 16,1, 145,3, 102,1, 231,4, 16,1, 145,1, 231,1, 188,1, 59,3, 16,1, 59,4, 16,1, 102,2, 231,1, 145,4, 16,1, 59,1, 188,2, 231,1, 145,1, 16,1, 59,2, 16,1, 59,1, 188,32, 231,1, 145,1, 59,1, 102,2, 231,1, 145,1, 59,2, 145,1, 59,1, 145,6, 231,1, 102,2, 16,1, 102,4, 16,1, 188,1, 231,1, 145,1, 59,1, 16,1, 102,2, 231,3, 16,2, 145,1, 231,1, 102,2, 16,1, 102,1, 16,1, 59,1, 16,1, 102,1, 16,1, 59,1, 16,1, 145,1, 188,3, 16,1, 59,1, 102,1, 16,1, 59,1, 231,1, 188,2, 16,1, 145,4, 59,33, 231,2, 102,2, 231,1, 16,1, 145,2, 231,1, 188,1, 102,6, 231,1, 102,2, 16,2, 188,1, 145,2, 16,1, 145,2, 231,2, 16,1, 102,2, 231,2, 16,1, 59,1, 231,1, 188,1, 231,1, 102,1, 16,1, 59,2, 188,1, 102,1, 59,2, 188,1, 145,1, 16,1, 102,1, 145,1, 16,1, 59,1, 145,1, 188,1, 102,2, 16,1, 145,1, 102,1, 16,1, 59,3, 188,2, 16,1, 188,32, 231,2, 102,2, 231,1, 102,1, 16,1, 59,1, 102,1, 145,1, 188,6, 231,1, 102,1, 16,1, 145,1, 188,1, 231,1, 145,2, 16,1, 145,2, 231,2, 16,1, 102,2, 231,1, 16,1, 59,1, 188,3, 231,1, 102,1, 59,1, 145,2, 231,1, 102,1, 145,2, 231,1, 102,1, 16,2, 102,2, 16,1, 188,1, 231,1, 188,1, 102,1, 16,1, 145,1, 102,1, 59,1, 145,2, 231,1, 102,2, 16,1, 145,32, 231,2, 102,1, 231,2, 188,1, 231,1, 145,1, 102,1, 59,1, 16,1, 188,5, 231,1, 102,2, 16,1, 145,2, 102,1, 59,1, 16,1, 145,2, 231,2, 16,1, 102,2, 231,1, 59,2, 16,2, 188,1, 231,1, 102,2, 16,1, 145,1, 188,1, 102,1, 16,1, 145,1, 188,1, 102,1, 16,1, 102,1, 145,1, 16,1, 59,1, 102,1, 145,1, 102,2, 16,1, 145,1, 102,2, 16,1, 145,1, 102,1, 145,1, 59,1, 16,1, 188,32, 231,2, 102,2, 231,1, 102,4, 231,1, 16,1, 145,5, 231,1, 102,2, 16,1, 59,3, 16,1, 59,3, 231,2, 16,1, 102,2, 231,1, 188,2, 16,1, 102,1, 59,1, 231,1, 102,2, 16,2, 145,2, 16,2, 145,2, 16,1, 102,1, 188,1, 59,6, 16,1, 145,1, 102,6, 16,1, 59,33, 231,2, 59,2, 231,1, 59,1, 102,2, 145,1, 59,1, 102,6, 231,2, 102,1, 59,3, 16,1, 59,1, 188,3, 231,2, 16,1, 102,3, 231,1, 188,1, 59,2, 16,1, 188,1, 102,2, 16,2, 145,2, 16,2, 145,2, 16,1, 102,1, 231,1, 188,1, 59,2, 16,1, 59,2, 16,1, 145,1, 102,2, 16,1, 59,2, 16,1, 59,1, 188,32, 231,4, 145,3, 231,2, 145,1, 188,10, 231,1, 188,1, 145,1, 188,5, 231,2, 145,1, 188,5, 231,1, 188,1, 145,1, 231,1, 188,2, 145,2, 188,2, 145,2, 188,2, 145,1, 188,3, 231,1, 145,2, 188,2, 145,1, 188,1, 102,2, 16,2, 145,1, 188,94, 231,1, 102,2, 16,1, 145,96, 231,1, 102,2, 16,1, 145,96, 231,1, 188,2, 145,1, 188,5, 231};
const HUGE_MEM uint8_t iVtObjectBigLogo_aRawBitmap1Fixed0 [] = { /* RLE-Encoded Raw-Bitmap Data */ 255, 17,12, 17,1, 24,1, 136,1, 135,12, 17,1, 28,2, 204,1, 193,40, 17,1, 23,1, 0,1, 136,1, 12,1, 193,8, 17,1, 193,2, 17,1, 28,1, 193,1, 17,1, 193,1, 17,1, 28,18, 17,1, 120,2, 136,1, 135,1, 17,1, 129,2, 17,1, 16,1, 129,10, 17,1, 24,1, 8,1, 17,1, 124,1, 193,8, 17,1, 193,2, 17,1, 28,2, 17,1, 193,1, 17,1, 204,2, 17,1, 28,1, 204,14, 17,1, 120,1, 128,1, 8,1, 135,1, 24,1, 1,2, 17,1, 24,1, 129,10, 17,1, 23,1, 135,1, 17,1, 16,1, 129,8, 17,1, 193,5, 17,1, 193,1, 17,1, 193,2, 17,2, 28,15, 17,1, 24,1, 1,1, 17,1, 24,1, 7,1, 136,1, 17,1, 16,1, 129,1, 24,1, 0,1, 7,9, 17,1, 136,1, 128,1, 129,8, 17,1, 193,4, 17,1, 28,1, 193,1, 17,1, 193,2, 17,1, 193,1, 28,15, 17,1, 24,1, 1,1, 17,1, 24,1, 8,1, 128,1, 129,1, 16,1, 129,1, 128,2, 129,8, 17,1, 128,1, 135,1, 16,1, 129,1, 17,1, 28,1, 204,1, 193,3, 17,1, 28,1, 193,4, 17,1, 204,2, 17,1, 193,1, 28,1, 17,1, 193,1, 28,15, 17,1, 24,1, 1,1, 17,1, 24,1, 204,1, 192,1, 129,1, 16,1, 129,1, 128,1, 8,1, 113,7, 17,1, 24,1, 8,1, 17,1, 16,1, 193,1, 17,2, 28,1, 193,3, 17,1, 28,4, 17,1, 28,1, 193,2, 17,2, 204,1, 17,1, 193,1, 17,1, 193,14, 17,1, 24,1, 1,1, 17,1, 24,1, 193,1, 204,1, 129,1, 16,1, 129,1, 24,1, 0,1, 7,7, 17,1, 16,1, 1,1, 17,1, 16,1, 193,1, 17,2, 28,1, 193,3, 17,1, 28,3, 17,1, 28,1, 193,3, 17,1, 28,1, 204,2, 193,1, 28,1, 193,14, 17,1, 24,1, 1,1, 17,1, 24,1, 193,1, 28,1, 129,1, 16,1, 129,1, 17,1, 23,1, 8,6, 17,1, 204,1, 192,1, 7,1, 17,1, 128,1, 199,1, 17,1, 204,1, 28,1, 199,1, 129,2, 17,1, 28,3, 17,1, 28,5, 17,1, 193,1, 17,1, 193,1, 28,15, 17,1, 24,1, 1,1, 17,1, 24,1, 193,1, 28,1, 129,1, 16,1, 129,2, 128,1, 7,6, 17,1, 193,1, 24,1, 0,1, 128,1, 0,1, 200,1, 17,1, 193,1, 28,1, 192,1, 128,1, 113,1, 136,1, 193,3, 17,1, 28,2, 204,1, 193,2, 17,1, 193,1, 28,1, 17,1, 204,15, 17,1, 23,1, 129,1, 17,1, 23,1, 193,1, 24,1, 113,1, 24,2, 204,1, 136,1, 17,1, 28,2, 204,2, 17,1, 28,2, 17,1, 120,1, 113,1, 128,1, 200,1, 17,1, 193,1, 28,1, 200,1, 120,1, 129,1, 0,1, 193,8, 17,1, 28,1, 193,1, 28,1, 17,1, 193,19, 17,1, 193,2, 17,1, 28,1, 17,1, 28,2, 17,1, 204,1, 17,1, 140,1, 193,1, 17,1, 28,4, 17,1, 128,1, 200,1, 136,1, 193,1, 28,1, 200,1, 24,1, 1,1, 12,1, 200,1, 113,1, 23,1, 136,1, 129,1, 120,1, 136,2, 17,1, 124,1, 136,1, 124,1, 17,1, 199,1, 136,1, 135,17, 17,1, 193,1, 17,2, 28,1, 17,1, 28,2, 17,1, 193,1, 17,1, 119,1, 193,1, 23,1, 199,3, 17,1, 193,1, 128,1, 204,1, 0,1, 200,1, 28,1, 204,1, 200,1, 129,1, 204,1, 0,1, 129,1, 112,4, 0,1, 129,1, 24,1, 204,1, 0,1, 12,1, 204,1, 192,2, 0,1, 113,16, 17,1, 204,2, 17,1, 204,1, 17,1, 28,1, 17,1, 28,3, 204,1, 193,1, 128,1, 200,1, 8,1, 17,1, 28,1, 193,1, 128,1, 12,1, 0,1, 192,1, 193,1, 128,1, 8,1, 17,2, 204,1, 193,1, 128,1, 8,1, 0,1, 8,1, 0,1, 8,1, 112,1, 0,1, 8,1, 0,1, 23,1, 0,1, 128,1, 0,1, 1,14, 17,1, 193,2, 17,1, 204,1, 17,1, 204,1, 17,1, 28,2, 17,1, 193,1, 17,1, 136,1, 17,1, 8,2, 204,1, 17,1, 204,1, 17,1, 128,1, 12,1, 120,1, 204,1, 193,1, 16,1, 8,1, 17,1, 0,1, 1,1, 113,1, 128,1, 7,1, 120,1, 7,1, 120,1, 8,1, 128,1, 8,1, 120,1, 0,1, 136,1, 0,1, 119,1, 112,1, 7,14, 17,1, 204,2, 17,1, 28,1, 17,1, 204,1, 17,1, 204,2, 17,3, 204,1, 17,1, 128,1, 8,1, 140,1, 204,2, 17,1, 128,1, 135,1, 24,1, 0,1, 129,1, 16,1, 8,1, 17,1, 0,1, 113,1, 17,1, 128,1, 129,1, 24,1, 129,1, 24,1, 8,1, 128,1, 7,1, 23,1, 128,1, 136,1, 8,1, 17,1, 128,1, 8,14, 17,1, 28,2, 17,1, 204,1, 17,2, 204,1, 193,4, 17,1, 136,1, 23,1, 113,1, 136,1, 0,1, 113,2, 17,1, 128,1, 8,1, 136,1, 0,1, 129,1, 16,1, 8,1, 17,1, 0,1, 7,1, 113,1, 128,1, 8,1, 120,1, 8,1, 120,1, 8,1, 128,1, 8,1, 136,1, 0,1, 136,1, 0,1, 136,1, 128,1, 7,14, 17,1, 28,2, 204,1, 193,1, 17,1, 28,6, 17,1, 136,1, 17,1, 129,1, 17,1, 16,1, 129,2, 17,1, 128,3, 0,1, 17,1, 16,1, 8,1, 17,1, 112,1, 8,1, 1,1, 128,1, 8,1, 128,1, 8,1, 128,1, 8,1, 112,3, 0,1, 136,3, 0,1, 1,19, 17,1, 28,6, 17,1, 0,1, 17,1, 8,1, 136,1, 8,3, 17,1, 136,2, 0,1, 7,1, 17,1, 16,1, 8,1, 17,1, 23,1, 0,1, 7,1, 128,1, 8,1, 128,1, 8,1, 128,1, 8,1, 23,3, 0,1, 136,3, 0,1, 113,19, 17,1, 28,1, 193,4, 17,1, 24,1, 136,1, 129,1, 17,1, 136,1, 113,4, 17,1, 23,1, 135,2, 17,1, 24,1, 135,2, 17,1, 23,1, 129,1, 120,1, 135,1, 120,1, 135,1, 120,1, 135,1, 17,1, 24,1, 119,1, 136,1, 120,1, 0,1, 136,1, 113,20, 17,1, 28,1, 193,34, 17,1, 24,1, 0,1, 129,22, 17,1, 193,34, 17,1, 24,1, 0,1, 129,22, 17,1, 193,34, 17,1, 23,1, 136,1, 113,187, 17};
const IsoAgLib::repeat_rawData_rawBytes_actWidth_actHeight_formatoptions_s iVtObjectBigLogo_aFixedBitmaps [] = {{iVtObjectBigLogo_aRawBitmap1Fixed0, 1328, 120, 30, (1 << 6) | 7}};
const IsoAgLib::iVtObject_c::iVtObjectPictureGraphic_s iVtObjectBigLogo_sROM = {65505, 100, 100,25, 2, 27, 1, 325,iVtObjectBigLogo_aRawBitmap0, 0,NULL, 1274,iVtObjectBigLogo_aRawBitmap2, 1,iVtObjectBigLogo_aFixedBitmaps, 0,NULL};
const IsoAgLib::iVtObject_c::iVtObjectLine_s iVtObjectleine_sROM = {65504, &iVtObjectLineAttributesNormal, 200, 1, 0, 0,NULL};
const IsoAgLib::repeat_iVtObject_x_y_iVtObjectFontAttributes_row_col_s iVtObjectKeyReset_aObject_x_y_font_row_col [] = {{&iVtObjectresetTextOS, 0, 12, NULL ,0, 0}};
const IsoAgLib::iVtObject_c::iVtObjectKey_s iVtObjectKeyReset_sROM = {65503, 1, 254, 1,iVtObjectKeyReset_aObject_x_y_font_row_col, 0,NULL};
const IsoAgLib::iVtObject_c::iVtObjectOutputString_s iVtObjectresetTextOS_sROM = {65502, 60, 8, 1, &iVtObjectFontAttributesSKM6x8, 0, NULL, 1, 5, "Reset", 0,NULL};
const IsoAgLib::repeat_iVtObject_x_y_iVtObjectFontAttributes_row_col_s iVtObjectMainMask_aObject_x_y_font_row_col [] = {{&iVtObjectcontainerInAllMasks, 0, 0, NULL ,0, 0}, {&iVtObjectmask1contentscontainer, 0, 30, NULL ,0, 0}};
const IsoAgLib::iVtObject_c::iVtObjectDataMask_s iVtObjectMainMask_sROM = {1101, 1, &iVtObjectsoftkeys1, 2,iVtObjectMainMask_aObject_x_y_font_row_col, 0,NULL};
const IsoAgLib::repeat_iVtObject_x_y_iVtObjectFontAttributes_row_col_s iVtObjectmask1contentscontainer_aObject_x_y_font_row_col [] = {{&iVtObjectUnnamed4, 4, 14, NULL ,0, 0}, {&iVtObjectspeedLabel, 4, 27, NULL ,0, 0}, {&iVtObjectUnnamed5, 4, 55, NULL ,0, 0}, {&iVtObjectUnnamed6, 4, 10, &iVtObjectFontAttributesNormal6x8 ,0, 9}, {&iVtObjectUnnamed7, 4, 27, &iVtObjectFontAttributesNormal6x8 ,0, 9}, {&iVtObjectUnnamed8, 4, 55, &iVtObjectFontAttributesNormal6x8 ,0, 9}, {&iVtObjectUnnamed9, 4, 36, NULL ,0, 0}, {&iVtObjectColLabel, 4, 100, NULL ,0, 0}, {&iVtObjectColOS, 4, 100, &iVtObjectFontAttributesNormal6x8 ,0, 9}, {&iVtObjectdEllipse, 10, 120, NULL ,0, 0}, {&iVtObjectdPolygon, 100, 120, NULL ,0, 0}, {&iVtObjectdMeter, 128, 10, NULL ,0, 0}, {&iVtObjectAccelArchedBarGraph, 4, 50, &iVtObjectFontAttributesNormal6x8 ,0, 12}, {&iVtObjectInputListTypFakeMiles, 4, 74, &iVtObjectFontAttributesNormal6x8 ,1, 13}, {&iVtObjectUnnamed10, 4, 70, NULL ,0, 0}, {&iVtObjectInputMiles, 4, 70, &iVtObjectFontAttributesNormal6x8 ,0, 13}, {&iVtObjectUnnamed11, 4, 2, NULL ,0, 0}, {&iVtObjectInputLikeage, 4, 4, &iVtObjectFontAttributesNormal6x8 ,0, 18}, {&iVtObjectLikeageOP, 4, 160, NULL ,0, 0}, {&iVtObjectKeyMoreAccel, 120, 55, NULL ,0, 0}, {&iVtObjectKeyLessAccel, 120, 90, NULL ,0, 0}};
const IsoAgLib::iVtObject_c::iVtObjectContainer_s iVtObjectmask1contentscontainer_sROM = {65501, 200, 170, 0, 21,iVtObjectmask1contentscontainer_aObject_x_y_font_row_col, 0,NULL};
const IsoAgLib::iVtObject_c::iVtObjectOutputString_s iVtObjectUnnamed4_sROM = {65500, 66, 8, 1, &iVtObjectFontAttributesNormal6x8, 0, NULL, 0, 6, "Miles:", 0,NULL};
const IsoAgLib::iVtObject_c::iVtObjectOutputString_s iVtObjectspeedLabel_sROM = {65499, 66, 8, 1, &iVtObjectFontAttributesNormal6x8, 0, NULL, 0, 8, "Speed is", 0,NULL};
const IsoAgLib::iVtObject_c::iVtObjectOutputString_s iVtObjectUnnamed5_sROM = {65498, 66, 8, 1, &iVtObjectFontAttributesNormal6x8, 0, NULL, 0, 7, "Accel':", 0,NULL};
const IsoAgLib::iVtObject_c::iVtObjectOutputNumber_s iVtObjectUnnamed6_sROM = {65497, 60, 16, 1, &iVtObjectFontAttributesNormal12x16, 0, &iVtObjectValMiles, 0, 0, 1, 0, 0, 0, 0,NULL};
const IsoAgLib::iVtObject_c::iVtObjectOutputNumber_s iVtObjectUnnamed7_sROM = {65496, 18, 8, 1, &iVtObjectFontAttributesNormal6x8, 0, &iVtObjectValSpeed, 0, 0, 1, 0, 0, 0, 0,NULL};
const IsoAgLib::iVtObject_c::iVtObjectOutputNumber_s iVtObjectUnnamed8_sROM = {65495, 24, 8, 1, &iVtObjectFontAttributesNormal8x8, 0, &iVtObjectValAccel, 0, 0, 1, 0, 0, 0, 0,NULL};
const IsoAgLib::iVtObject_c::iVtObjectLinearBarGraph_s iVtObjectUnnamed9_sROM = {65494, 120, 8, 0, 0, 53, 4, 0, 100, &iVtObjectValSpeed, 0, NULL, 0, 0,NULL};
const IsoAgLib::iVtObject_c::iVtObjectOutputString_s iVtObjectColLabel_sROM = {65493, 42, 8, 1, &iVtObjectFontAttributesNormal6x8, 0, NULL, 0, 7, "Color: ", 0,NULL};
const IsoAgLib::iVtObject_c::iVtObjectOutputString_s iVtObjectColOS_sROM = {65492, 100, 8, 1, &iVtObjectFontAttributesNormal6x8, 0, &iVtObjectStrNone, 0, 0, NULL, 0,NULL};
const IsoAgLib::iVtObject_c::iVtObjectArchedBarGraph_s iVtObjectAccelArchedBarGraph_sROM = {65488, 40, 40, 6, 5, 19, 10, 80, 5, 0, 30, NULL, 25, NULL, 15, 0,NULL};
const IsoAgLib::repeat_iVtObject_s iVtObjectInputListTypFakeMiles_aObject [] = {{&iVtObjectUnnamed12}, {&iVtObjectUnnamed13}, {&iVtObjectUnnamed14}, {&iVtObjectUnnamed15}};
const IsoAgLib::iVtObject_c::iVtObjectInputList_s iVtObjectInputListTypFakeMiles_sROM = {65487, 24, 8, NULL, 0, 1, 4,iVtObjectInputListTypFakeMiles_aObject, 0,NULL};
const IsoAgLib::iVtObject_c::iVtObjectOutputNumber_s iVtObjectUnnamed12_sROM = {65479, 24, 8, 1, &iVtObjectFontAttributesNormal6x8, 0, NULL, 6398, 0, 1.0, 0, 0, 0, 0,NULL};
const IsoAgLib::iVtObject_c::iVtObjectOutputNumber_s iVtObjectUnnamed13_sROM = {65478, 24, 8, 1, &iVtObjectFontAttributesNormal6x8, 0, NULL, 8743, 0, 1.0, 0, 0, 0, 0,NULL};
const IsoAgLib::iVtObject_c::iVtObjectOutputNumber_s iVtObjectUnnamed14_sROM = {65477, 24, 8, 1, &iVtObjectFontAttributesNormal6x8, 0, NULL, 3948, 0, 1.0, 0, 0, 0, 0,NULL};
const IsoAgLib::iVtObject_c::iVtObjectOutputNumber_s iVtObjectUnnamed15_sROM = {65476, 24, 8, 1, &iVtObjectFontAttributesNormal6x8, 0, NULL, 9467, 0, 1.0, 0, 0, 0, 0,NULL};
const IsoAgLib::iVtObject_c::iVtObjectOutputString_s iVtObjectUnnamed10_sROM = {65486, 72, 8, 1, &iVtObjectFontAttributesNormal6x8R, 0, NULL, 0, 12, "Fake Mileage", 0,NULL};
const IsoAgLib::iVtObject_c::iVtObjectInputNumber_s iVtObjectInputMiles_sROM = {65485, 36, 8, 1, &iVtObjectFontAttributesNormal6x8R, 0, NULL, 0, 0, 999999, 0, 1, 0, 0, 0, 1, 0,NULL};
const IsoAgLib::iVtObject_c::iVtObjectOutputString_s iVtObjectUnnamed11_sROM = {65484, 102, 8, 1, &iVtObjectFontAttributesNormal6x8B, 0, NULL, 0, 17, "Do you like this?", 0,NULL};
const IsoAgLib::iVtObject_c::iVtObjectInputBoolean_s iVtObjectInputLikeage_sROM = {65483, 1, 8, &iVtObjectFontAttributesNormal6x8, NULL, 0, 1, 0,NULL};
const IsoAgLib::iVtObject_c::iVtObjectObjectPointer_s iVtObjectLikeageOP_sROM = {65482, NULL};
const IsoAgLib::repeat_iVtObject_x_y_iVtObjectFontAttributes_row_col_s iVtObjectKeyMoreAccel_aObject_x_y_font_row_col [] = {{&iVtObjectUnnamed16, 0, 7, NULL ,0, 0}};
const IsoAgLib::iVtObject_c::iVtObjectButton_s iVtObjectKeyMoreAccel_sROM = {65481, 60, 30, 1, 0, 253, 0, 1,iVtObjectKeyMoreAccel_aObject_x_y_font_row_col, 0,NULL};
const IsoAgLib::iVtObject_c::iVtObjectOutputString_s iVtObjectUnnamed16_sROM = {65475, 60, 8, 1, &iVtObjectFontAttributesNormal6x8, 0, NULL, 1, 7, "SpeedUp", 0,NULL};
const IsoAgLib::repeat_iVtObject_x_y_iVtObjectFontAttributes_row_col_s iVtObjectKeyLessAccel_aObject_x_y_font_row_col [] = {{&iVtObjectUnnamed17, 0, 7, NULL ,0, 0}};
const IsoAgLib::iVtObject_c::iVtObjectButton_s iVtObjectKeyLessAccel_sROM = {65480, 60, 30, 1, 0, 252, 0, 1,iVtObjectKeyLessAccel_aObject_x_y_font_row_col, 0,NULL};
const IsoAgLib::iVtObject_c::iVtObjectOutputString_s iVtObjectUnnamed17_sROM = {65474, 60, 8, 1, &iVtObjectFontAttributesNormal6x8, 0, NULL, 1, 5, "Brake", 0,NULL};
const IsoAgLib::repeat_iVtObject_s iVtObjectsoftkeys1_aObject [] = {{&iVtObjectKeyReset}, {&iVtObjectKeyMove}, {&iVtObjectKeyLogo}, {&iVtObjectKeyChangeLang}, {&iVtObjectKeyChangeCol}, {&iVtObjectKeyForbidden}};
const IsoAgLib::iVtObject_c::iVtObjectSoftKeyMask_s iVtObjectsoftkeys1_sROM = {65473, 1, 6,iVtObjectsoftkeys1_aObject, 0,NULL};
const IsoAgLib::repeat_iVtObject_x_y_iVtObjectFontAttributes_row_col_s iVtObjectKeyMove_aObject_x_y_font_row_col [] = {{&iVtObjectUnnamed18, 0, 12, NULL ,0, 0}};
const IsoAgLib::iVtObject_c::iVtObjectKey_s iVtObjectKeyMove_sROM = {65472, 1, 251, 1,iVtObjectKeyMove_aObject_x_y_font_row_col, 0,NULL};
const IsoAgLib::iVtObject_c::iVtObjectOutputString_s iVtObjectUnnamed18_sROM = {65467, 60, 8, 1, &iVtObjectFontAttributesSKM6x8, 0, NULL, 1, 4, "Move", 0,NULL};
const IsoAgLib::repeat_iVtObject_x_y_iVtObjectFontAttributes_row_col_s iVtObjectKeyLogo_aObject_x_y_font_row_col [] = {{&iVtObjectUnnamed19, 0, 12, NULL ,0, 0}};
const IsoAgLib::iVtObject_c::iVtObjectKey_s iVtObjectKeyLogo_sROM = {65471, 1, 250, 1,iVtObjectKeyLogo_aObject_x_y_font_row_col, 0,NULL};
const IsoAgLib::iVtObject_c::iVtObjectOutputString_s iVtObjectUnnamed19_sROM = {65466, 60, 8, 1, &iVtObjectFontAttributesSKM6x8, 0, NULL, 1, 4, "Logo", 0,NULL};
const IsoAgLib::repeat_iVtObject_x_y_iVtObjectFontAttributes_row_col_s iVtObjectKeyChangeLang_aObject_x_y_font_row_col [] = {{&iVtObjectUnnamed20, 0, 12, NULL ,0, 0}};
const IsoAgLib::iVtObject_c::iVtObjectKey_s iVtObjectKeyChangeLang_sROM = {65470, 1, 249, 1,iVtObjectKeyChangeLang_aObject_x_y_font_row_col, 0,NULL};
const IsoAgLib::iVtObject_c::iVtObjectOutputString_s iVtObjectUnnamed20_sROM = {65465, 60, 8, 1, &iVtObjectFontAttributesSKM6x8, 0, NULL, 1, 8, "AE -> BE", 0,NULL};
const IsoAgLib::repeat_iVtObject_x_y_iVtObjectFontAttributes_row_col_s iVtObjectKeyChangeCol_aObject_x_y_font_row_col [] = {{&iVtObjectUnnamed21, 0, 8, NULL ,0, 0}, {&iVtObjectUnnamed22, 0, 16, NULL ,0, 0}};
const IsoAgLib::iVtObject_c::iVtObjectKey_s iVtObjectKeyChangeCol_sROM = {65469, 1, 248, 2,iVtObjectKeyChangeCol_aObject_x_y_font_row_col, 0,NULL};
const IsoAgLib::iVtObject_c::iVtObjectOutputString_s iVtObjectUnnamed21_sROM = {65464, 60, 8, 1, &iVtObjectFontAttributesSKM6x8, 0, NULL, 1, 6, "Change", 0,NULL};
const IsoAgLib::iVtObject_c::iVtObjectOutputString_s iVtObjectUnnamed22_sROM = {65463, 60, 8, 1, &iVtObjectFontAttributesSKM6x8, 0, NULL, 1, 6, "Colour", 0,NULL};
const IsoAgLib::repeat_iVtObject_x_y_iVtObjectFontAttributes_row_col_s iVtObjectKeyForbidden_aObject_x_y_font_row_col [] = {{&iVtObjectUnnamed23, 0, 12, NULL ,0, 0}};
const IsoAgLib::iVtObject_c::iVtObjectKey_s iVtObjectKeyForbidden_sROM = {65468, 1, 247, 1,iVtObjectKeyForbidden_aObject_x_y_font_row_col, 0,NULL};
const IsoAgLib::iVtObject_c::iVtObjectOutputString_s iVtObjectUnnamed23_sROM = {65462, 60, 8, 1, &iVtObjectFontAttributesSKM6x8, 0, NULL, 1, 10, "Forbidden!", 0,NULL};
const IsoAgLib::iVtObject_c::iVtObjectLineAttributes_s iVtObjectLineAttributes_Normal_sROM = {65461, 0, 1, 0xffff, 0,NULL};
const IsoAgLib::iVtObject_c::iVtObjectFillAttributes_s iVtObjectFillAttributes_sROM = {65460,2, 2, NULL, 0,NULL};
const IsoAgLib::iVtObject_c::iVtObjectEllipse_s iVtObjectdEllipse_sROM = {65491, &iVtObjectLineAttributes_Normal, 64, 32, 2, 0, 1, &iVtObjectFillAttributes, 0,NULL};
const IsoAgLib::repeat_x_y_s iVtObjectdPolygon_aPoints [] = {{0, 20}, {10, 10}, {10, 20}, {0, 10}, {10, 10}, {5, 0}, {0, 10}, {0, 20}, {10, 20}};
const IsoAgLib::iVtObject_c::iVtObjectPolygon_s iVtObjectdPolygon_sROM = {65490, 41, 35, &iVtObjectLineAttributes_Normal, NULL, 0, 9,iVtObjectdPolygon_aPoints, 0,NULL};
const IsoAgLib::iVtObject_c::iVtObjectMeter_s iVtObjectdMeter_sROM = {65489, 40, 161, 0, 15, 13, 31, 157, 112, 0, 100, &iVtObjectValSpeed, 0, 0,NULL};
const uint8_t iVtObjectMacro_1_aMacro_Commands [] = {0xA0, 184, 11, 1, 0xFF, 0xFF, 0xFF, 0xFF};
const IsoAgLib::iVtObject_c::iVtObjectMacro_s iVtObjectMacro_1_sROM = {1, 8, iVtObjectMacro_1_aMacro_Commands};
const uint8_t iVtObjectMacro_2_aMacro_Commands [] = {0xA0, 184, 11, 0, 0xFF, 0xFF, 0xFF, 0xFF};
const IsoAgLib::iVtObject_c::iVtObjectMacro_s iVtObjectMacro_2_sROM = {2, 8, iVtObjectMacro_2_aMacro_Commands};
const IsoAgLib::repeat_iVtObject_x_y_iVtObjectFontAttributes_row_col_s iVtObjectForbiddenAlarmMask_aObject_x_y_font_row_col [] = {{&iVtObjectcontainerInAllMasks, 0, 0, NULL ,0, 0}, {&iVtObjectalarm1contentscontainer, 0, 30, NULL ,0, 0}};
const IsoAgLib::iVtObject_c::iVtObjectAlarmMask_s iVtObjectForbiddenAlarmMask_sROM = {65459, 1, &iVtObjectsoftkeysAlarm, 2, 1, 2,iVtObjectForbiddenAlarmMask_aObject_x_y_font_row_col, 0,NULL};
const IsoAgLib::repeat_iVtObject_x_y_iVtObjectFontAttributes_row_col_s iVtObjectalarm1contentscontainer_aObject_x_y_font_row_col [] = {{&iVtObjectUnnamed24, 0, 12, NULL ,0, 0}, {&iVtObjectUnnamed25, 0, 40, NULL ,0, 0}, {&iVtObjectUnnamed26, 0, 55, NULL ,0, 0}};
const IsoAgLib::iVtObject_c::iVtObjectContainer_s iVtObjectalarm1contentscontainer_sROM = {65458, 200, 170, 0, 3,iVtObjectalarm1contentscontainer_aObject_x_y_font_row_col, 0,NULL};
const IsoAgLib::iVtObject_c::iVtObjectOutputString_s iVtObjectUnnamed24_sROM = {65457, 200, 16, 1, &iVtObjectFontAttributesNormal12x16, 0, NULL, 1, 5, "ALARM", 0,NULL};
const IsoAgLib::iVtObject_c::iVtObjectOutputString_s iVtObjectUnnamed25_sROM = {65456, 200, 8, 1, &iVtObjectFontAttributesNormal6x8, 0, NULL, 0, 27, "I told you it is forbidden!", 0,NULL};
const IsoAgLib::iVtObject_c::iVtObjectOutputString_s iVtObjectUnnamed26_sROM = {65455, 200, 8, 1, &iVtObjectFontAttributesNormal6x8, 0, NULL, 2, 25, "(Press ESC to go back...)", 0,NULL};
const IsoAgLib::iVtObject_c::iVtObjectSoftKeyMask_s iVtObjectsoftkeysAlarm_sROM = {65454, 1, 0,NULL, 0,NULL};
