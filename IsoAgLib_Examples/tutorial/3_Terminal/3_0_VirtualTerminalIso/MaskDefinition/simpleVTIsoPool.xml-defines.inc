#define iVtObjectIDimiIsoMaskupload 65534
#define iVtObjectIDUnnamed1 65533
#define iVtObjectIDUnnamed2 65532
#define iVtObjectIDFontAttributesNormal6x8 65531
#define iVtObjectIDFontAttributesNormal6x8R 65530
#define iVtObjectIDFontAttributesNormal6x8B 65529
#define iVtObjectIDFontAttributesNormal8x8 65528
#define iVtObjectIDFontAttributesNormal12x16 65527
#define iVtObjectIDLineAttributesNormal 65526
#define iVtObjectIDLineAttributesDotted 65525
#define iVtObjectIDFontAttributesSKM6x8 65524
#define iVtObjectIDFontAttributesSKM8x8 65523
#define iVtObjectIDFontAttributesSKM12x16 65522
#define iVtObjectIDLineAttributesSKM 65521
#define iVtObjectIDValSpeed 65520
#define iVtObjectIDValAccel 65519
#define iVtObjectIDValMiles 1234
#define iVtObjectIDStrNone 65518
#define iVtObjectIDStrRed 65517
#define iVtObjectIDStrGreen 65516
#define iVtObjectIDStrBlue 65515
#define iVtObjectIDStrYellow 65514
#define iVtObjectIDStrCyan 65513
#define iVtObjectIDStrMagenta 65512
#define iVtObjectIDStrBlack 65511
#define iVtObjectIDStrWhite 65510
#define iVtObjectIDLikeIt 65509
#define iVtObjectIDLikeItNot 65508
#define iVtObjectIDcontainerInAllMasks 65507
#define iVtObjectIDUnnamed3 65506
#define iVtObjectIDBigLogo 65505
#define iVtObjectIDleine 65504
#define iVtObjectIDKeyReset 65503
#define vtKeyCodeKeyReset 254
#define iVtObjectIDresetTextOS 65502
#define iVtObjectIDMainMask 1101
#define iVtObjectIDmask1contentscontainer 65501
#define iVtObjectIDUnnamed4 65500
#define iVtObjectIDspeedLabel 65499
#define iVtObjectIDUnnamed5 65498
#define iVtObjectIDUnnamed6 65497
#define iVtObjectIDUnnamed7 65496
#define iVtObjectIDUnnamed8 65495
#define iVtObjectIDUnnamed9 65494
#define iVtObjectIDColLabel 65493
#define iVtObjectIDColOS 65492
#define iVtObjectIDAccelArchedBarGraph 65488
#define iVtObjectIDInputListTypFakeMiles 65487
#define iVtObjectIDUnnamed12 65474
#define iVtObjectIDUnnamed13 65473
#define iVtObjectIDUnnamed14 65472
#define iVtObjectIDUnnamed15 65471
#define iVtObjectIDUnnamed10 65486
#define iVtObjectIDInputMiles 65485
#define iVtObjectIDUnnamed11 65484
#define iVtObjectIDInputLikeage 65483
#define iVtObjectIDLikeageOP 65482
#define iVtObjectIDKeyMoreAccel 65481
#define vtKeyCodeKeyMoreAccel 253
#define iVtObjectIDUnnamed16 65470
#define iVtObjectIDKeyLessAccel 65480
#define vtKeyCodeKeyLessAccel 252
#define iVtObjectIDUnnamed17 65469
#define iVtObjectIDISinitial 65479
#define iVtObjectIDdriver 65478
#define iVtObjectIDresonible 65477
#define iVtObjectIDISdriver 65476
#define iVtObjectIDOSresonible 65475
#define iVtObjectIDsoftkeys1 65468
#define iVtObjectIDKeyMove 65467
#define vtKeyCodeKeyMove 251
#define iVtObjectIDUnnamed18 65462
#define iVtObjectIDKeyLogo 65466
#define vtKeyCodeKeyLogo 250
#define iVtObjectIDUnnamed19 65461
#define iVtObjectIDKeyChangeLang 65465
#define vtKeyCodeKeyChangeLang 249
#define iVtObjectIDUnnamed20 65460
#define iVtObjectIDKeyChangeCol 65464
#define vtKeyCodeKeyChangeCol 248
#define iVtObjectIDUnnamed21 65459
#define iVtObjectIDUnnamed22 65458
#define iVtObjectIDKeyForbidden 65463
#define vtKeyCodeKeyForbidden 247
#define iVtObjectIDUnnamed23 65457
#define iVtObjectIDLineAttributes_Normal 65456
#define iVtObjectIDFillAttributes 65455
#define iVtObjectIDdEllipse 65491
#define iVtObjectIDdPolygon 65490
#define iVtObjectIDdMeter 65489
#define iVtObjectIDMacro_1 1
#define iVtObjectIDMacro_2 2
#define iVtObjectIDForbiddenAlarmMask 65454
#define iVtObjectIDalarm1contentscontainer 65453
#define iVtObjectIDUnnamed24 65452
#define iVtObjectIDUnnamed25 65451
#define iVtObjectIDUnnamed26 65450
#define iVtObjectIDsoftkeysAlarm 65449
#define vtObjectPoolDimension 200
#define vtObjectPoolSoftKeyWidth 60
#define vtObjectPoolSoftKeyHeight 32

#define vtKeyCodeACK 0
