const IsoAgLib::repeat_vtLanguage_s ivtObjectimiIsoMaskupload_2_aLanguage [] = {{'e', 'n'}, {'d', 'e'}, {'i', 't'}};
const IsoAgLib::repeat_iVtObject_x_y_iVtObjectFontAttributes_row_col_s iVtObjectimiIsoMaskupload_2_aObject_x_y_font_row_col [] = {{&iVtObjectopsWS1, 0, 0, NULL ,0, 0}, {&iVtObjectopsWS2, 0, 8, NULL ,0, 0}};
const IsoAgLib::iVtObject_c::iVtObjectWorkingSet_s iVtObjectimiIsoMaskupload_2_sROM = {65534, 1, 1, &iVtObjectMainMask_2, 2,iVtObjectimiIsoMaskupload_2_aObject_x_y_font_row_col, 0,NULL, 3,ivtObjectimiIsoMaskupload_2_aLanguage};
const IsoAgLib::iVtObject_c::iVtObjectOutputString_s iVtObjectopsWS1_sROM = {65533, 60, 8, 1, &iVtObjectFontAttributesSKM6x8_2, 2, NULL, 0, 8, "IsoAgLib", 0,NULL};
const IsoAgLib::iVtObject_c::iVtObjectOutputString_s iVtObjectopsWS2_sROM = {65532, 60, 16, 1, &iVtObjectFontAttributesSKM6x8_2, 2, NULL, 0, 12, "Tutorial 3.2", 0,NULL};
const IsoAgLib::repeat_iVtObject_x_y_iVtObjectFontAttributes_row_col_s iVtObjectcontainerInAllMasks_2_aObject_x_y_font_row_col [] = {{&iVtObjectrect1, 5, 5, NULL ,0, 0}, {&iVtObjectBigLogo_2, 0, 0, NULL ,0, 0}, {&iVtObjectleine_2, 0, 27, NULL ,0, 0}};
const IsoAgLib::iVtObject_c::iVtObjectContainer_s iVtObjectcontainerInAllMasks_2_sROM = {65531, 200, 30, 0, 3,iVtObjectcontainerInAllMasks_2_aObject_x_y_font_row_col, 0,NULL};
const IsoAgLib::iVtObject_c::iVtObjectRectangle_s iVtObjectrect1_sROM = {65530, &iVtObjectLineAttributesDotted_2, 190, 15, 0, NULL, 0,NULL};
const HUGE_MEM uint8_t iVtObjectBigLogo_2_aRawBitmap0 [] = { /* Raw-Bitmap Data */ 255, 255, 255, 255, 255, 255, 255, 255, 255, 255, 255, 255, 240, 255, 255, 255, 255, 255, 255, 255, 255, 255, 255, 255, 255, 240, 255, 255, 255, 255, 255, 248, 127, 255, 255, 255, 255, 255, 240, 255, 255, 255, 255, 255, 240, 63, 255, 255, 255, 255, 255, 240, 224, 119, 231, 255, 255, 227, 159, 255, 255, 255, 255, 255, 240, 224, 103, 231, 255, 255, 247, 159, 255, 255, 255, 255, 255, 240, 249, 228, 230, 31, 255, 252, 31, 255, 255, 255, 255, 255, 240, 249, 224, 100, 95, 255, 241, 159, 255, 255, 255, 255, 255, 240, 249, 230, 100, 63, 255, 227, 159, 255, 255, 255, 255, 255, 240, 249, 230, 102, 31, 255, 231, 159, 255, 255, 255, 255, 255, 240, 249, 230, 103, 207, 255, 231, 31, 247, 255, 255, 255, 255, 240, 249, 230, 100, 31, 255, 224, 15, 195, 31, 255, 255, 255, 240, 253, 246, 239, 63, 63, 251, 15, 137, 31, 255, 255, 255, 240, 255, 255, 255, 255, 63, 255, 3, 137, 15, 24, 248, 252, 112, 255, 255, 255, 255, 253, 255, 0, 193, 6, 0, 96, 112, 48, 255, 255, 255, 254, 48, 63, 0, 195, 4, 0, 32, 48, 16, 255, 255, 255, 255, 51, 191, 24, 99, 28, 102, 2, 3, 144, 255, 255, 255, 255, 48, 127, 24, 99, 60, 102, 7, 3, 0, 255, 255, 255, 255, 60, 63, 0, 99, 28, 34, 0, 0, 16, 255, 255, 255, 255, 55, 159, 0, 227, 132, 0, 32, 0, 16, 255, 255, 255, 255, 48, 63, 1, 227, 196, 0, 48, 0, 48, 255, 255, 255, 254, 28, 255, 247, 231, 246, 102, 123, 32, 240, 255, 255, 255, 255, 255, 255, 255, 255, 255, 255, 255, 225, 240, 255, 255, 255, 255, 255, 255, 255, 255, 255, 255, 255, 225, 240, 255, 255, 255, 255, 255, 255, 255, 255, 255, 255, 255, 243, 240};
const HUGE_MEM uint8_t iVtObjectBigLogo_2_aRawBitmap2 [] = { /* RLE-Encoded Raw-Bitmap Data */ 245, 231,1, 145,3, 102,1, 188,93, 231,1, 188,2, 59,2, 145,1, 59,1, 16,1, 188,51, 231,1, 188,6, 102,1, 188,2, 231,1, 145,6, 231,1, 59,1, 102,22, 231,1, 102,1, 16,1, 145,2, 231,1, 188,1, 16,1, 102,51, 231,1, 188,2, 145,1, 59,1, 16,2, 145,1, 188,1, 231,1, 102,1, 16,6, 231,1, 102,1, 145,22, 231,1, 188,1, 145,1, 188,3, 231,1, 16,1, 102,54, 231,1, 102,1, 16,4, 231,1, 102,1, 16,1, 188,2, 102,3, 231,1, 16,1, 102,2, 231,1, 102,2, 16,1, 59,1, 188,18, 231,1, 145,2, 102,1, 16,1, 102,54, 231,1, 102,1, 16,4, 231,1, 102,1, 16,1, 102,1, 145,1, 16,1, 102,2, 231,1, 16,1, 102,1, 231,1, 145,1, 16,1, 145,1, 231,1, 145,17, 231,1, 102,1, 16,1, 102,1, 188,1, 231,1, 16,1, 102,54, 231,1, 102,1, 16,4, 231,1, 102,1, 16,1, 188,1, 231,1, 16,1, 102,2, 231,1, 16,1, 102,1, 231,1, 145,1, 16,1, 59,1, 102,1, 188,16, 231,1, 102,1, 16,1, 145,3, 231,1, 16,1, 102,54, 231,1, 102,1, 16,4, 231,1, 102,1, 16,2, 231,1, 16,1, 102,2, 231,1, 16,1, 102,2, 231,1, 145,1, 59,2, 16,1, 188,15, 231,2, 16,4, 231,1, 16,1, 102,54, 231,1, 102,1, 16,4, 231,1, 102,1, 16,2, 231,1, 16,1, 102,2, 231,1, 16,1, 102,4, 231,1, 188,1, 16,1, 102,15, 231,1, 59,1, 16,1, 188,2, 231,1, 102,1, 16,1, 59,1, 188,7, 231,1, 188,1, 145,44, 231,1, 102,1, 16,4, 231,1, 102,1, 16,2, 231,1, 16,1, 102,2, 231,1, 16,1, 102,1, 231,1, 145,1, 59,1, 102,1, 59,1, 16,1, 188,15, 231,1, 145,2, 16,1, 102,2, 59,2, 16,1, 102,6, 231,1, 102,1, 16,1, 102,1, 59,1, 188,1, 231,3, 102,38, 231,1, 188,1, 145,4, 231,1, 188,1, 145,2, 231,1, 145,1, 188,2, 231,1, 145,1, 188,2, 231,1, 188,2, 145,6, 231,2, 145,10, 231,1, 188,1, 145,1, 188,1, 231,1, 102,2, 16,1, 102,5, 231,1, 145,1, 102,1, 145,1, 188,2, 102,1, 231,3, 16,65, 231,1, 102,1, 59,14, 231,1, 102,2, 16,1, 145,2, 102,1, 188,2, 231,1, 145,1, 59,1, 145,1, 231,1, 102,1, 59,1, 231,3, 16,1, 102,1, 188,2, 231,1, 188,2, 102,1, 145,1, 231,1, 188,2, 102,1, 145,4, 231,1, 188,2, 102,1, 145,1, 188,4, 231,1, 188,2, 102,1, 145,1, 188,34, 231,2, 188,3, 231,1, 188,1, 145,1, 188,8, 231,1, 102,2, 16,1, 59,3, 16,1, 145,1, 231,1, 188,1, 16,1, 145,3, 102,1, 231,4, 16,1, 145,1, 231,1, 188,1, 59,3, 16,1, 59,4, 16,1, 102,2, 231,1, 145,4, 16,1, 59,1, 188,2, 231,1, 145,1, 16,1, 59,2, 16,1, 59,1, 188,32, 231,1, 145,1, 59,1, 102,2, 231,1, 145,1, 59,2, 145,1, 59,1, 145,6, 231,1, 102,2, 16,1, 102,4, 16,1, 188,1, 231,1, 145,1, 59,1, 16,1, 102,2, 231,3, 16,2, 145,1, 231,1, 102,2, 16,1, 102,1, 16,1, 59,1, 16,1, 102,1, 16,1, 59,1, 16,1, 145,1, 188,3, 16,1, 59,1, 102,1, 16,1, 59,1, 231,1, 188,2, 16,1, 145,4, 59,33, 231,2, 102,2, 231,1, 16,1, 145,2, 231,1, 188,1, 102,6, 231,1, 102,2, 16,2, 188,1, 145,2, 16,1, 145,2, 231,2, 16,1, 102,2, 231,2, 16,1, 59,1, 231,1, 188,1, 231,1, 102,1, 16,1, 59,2, 188,1, 102,1, 59,2, 188,1, 145,1, 16,1, 102,1, 145,1, 16,1, 59,1, 145,1, 188,1, 102,2, 16,1, 145,1, 102,1, 16,1, 59,3, 188,2, 16,1, 188,32, 231,2, 102,2, 231,1, 102,1, 16,1, 59,1, 102,1, 145,1, 188,6, 231,1, 102,1, 16,1, 145,1, 188,1, 231,1, 145,2, 16,1, 145,2, 231,2, 16,1, 102,2, 231,1, 16,1, 59,1, 188,3, 231,1, 102,1, 59,1, 145,2, 231,1, 102,1, 145,2, 231,1, 102,1, 16,2, 102,2, 16,1, 188,1, 231,1, 188,1, 102,1, 16,1, 145,1, 102,1, 59,1, 145,2, 231,1, 102,2, 16,1, 145,32, 231,2, 102,1, 231,2, 188,1, 231,1, 145,1, 102,1, 59,1, 16,1, 188,5, 231,1, 102,2, 16,1, 145,2, 102,1, 59,1, 16,1, 145,2, 231,2, 16,1, 102,2, 231,1, 59,2, 16,2, 188,1, 231,1, 102,2, 16,1, 145,1, 188,1, 102,1, 16,1, 145,1, 188,1, 102,1, 16,1, 102,1, 145,1, 16,1, 59,1, 102,1, 145,1, 102,2, 16,1, 145,1, 102,2, 16,1, 145,1, 102,1, 145,1, 59,1, 16,1, 188,32, 231,2, 102,2, 231,1, 102,4, 231,1, 16,1, 145,5, 231,1, 102,2, 16,1, 59,3, 16,1, 59,3, 231,2, 16,1, 102,2, 231,1, 188,2, 16,1, 102,1, 59,1, 231,1, 102,2, 16,2, 145,2, 16,2, 145,2, 16,1, 102,1, 188,1, 59,6, 16,1, 145,1, 102,6, 16,1, 59,33, 231,2, 59,2, 231,1, 59,1, 102,2, 145,1, 59,1, 102,6, 231,2, 102,1, 59,3, 16,1, 59,1, 188,3, 231,2, 16,1, 102,3, 231,1, 188,1, 59,2, 16,1, 188,1, 102,2, 16,2, 145,2, 16,2, 145,2, 16,1, 102,1, 231,1, 188,1, 59,2, 16,1, 59,2, 16,1, 145,1, 102,2, 16,1, 59,2, 16,1, 59,1, 188,32, 231,4, 145,3, 231,2, 145,1, 188,10, 231,1, 188,1, 145,1, 188,5, 231,2, 145,1, 188,5, 231,1, 188,1, 145,1, 231,1, 188,2, 145,2, 188,2, 145,2, 188,2, 145,1, 188,3, 231,1, 145,2, 188,2, 145,1, 188,1, 102,2, 16,2, 145,1, 188,94, 231,1, 102,2, 16,1, 145,96, 231,1, 102,2, 16,1, 145,96, 231,1, 188,2, 145,1, 188,5, 231};
const HUGE_MEM uint8_t iVtObjectBigLogo_2_aRawBitmap1Fixed0 [] = { /* RLE-Encoded Raw-Bitmap Data */ 255, 17,12, 17,1, 24,1, 136,1, 135,12, 17,1, 28,2, 204,1, 193,40, 17,1, 23,1, 0,1, 136,1, 12,1, 193,8, 17,1, 193,2, 17,1, 28,1, 193,1, 17,1, 193,1, 17,1, 28,18, 17,1, 120,2, 136,1, 135,1, 17,1, 129,2, 17,1, 16,1, 129,10, 17,1, 24,1, 8,1, 17,1, 124,1, 193,8, 17,1, 193,2, 17,1, 28,2, 17,1, 193,1, 17,1, 204,2, 17,1, 28,1, 204,14, 17,1, 120,1, 128,1, 8,1, 135,1, 24,1, 1,2, 17,1, 24,1, 129,10, 17,1, 23,1, 135,1, 17,1, 16,1, 129,8, 17,1, 193,5, 17,1, 193,1, 17,1, 193,2, 17,2, 28,15, 17,1, 24,1, 1,1, 17,1, 24,1, 7,1, 136,1, 17,1, 16,1, 129,1, 24,1, 0,1, 7,9, 17,1, 136,1, 128,1, 129,8, 17,1, 193,4, 17,1, 28,1, 193,1, 17,1, 193,2, 17,1, 193,1, 28,15, 17,1, 24,1, 1,1, 17,1, 24,1, 8,1, 128,1, 129,1, 16,1, 129,1, 128,2, 129,8, 17,1, 128,1, 135,1, 16,1, 129,1, 17,1, 28,1, 204,1, 193,3, 17,1, 28,1, 193,4, 17,1, 204,2, 17,1, 193,1, 28,1, 17,1, 193,1, 28,15, 17,1, 24,1, 1,1, 17,1, 24,1, 204,1, 192,1, 129,1, 16,1, 129,1, 128,1, 8,1, 113,7, 17,1, 24,1, 8,1, 17,1, 16,1, 193,1, 17,2, 28,1, 193,3, 17,1, 28,4, 17,1, 28,1, 193,2, 17,2, 204,1, 17,1, 193,1, 17,1, 193,14, 17,1, 24,1, 1,1, 17,1, 24,1, 193,1, 204,1, 129,1, 16,1, 129,1, 24,1, 0,1, 7,7, 17,1, 16,1, 1,1, 17,1, 16,1, 193,1, 17,2, 28,1, 193,3, 17,1, 28,3, 17,1, 28,1, 193,3, 17,1, 28,1, 204,2, 193,1, 28,1, 193,14, 17,1, 24,1, 1,1, 17,1, 24,1, 193,1, 28,1, 129,1, 16,1, 129,1, 17,1, 23,1, 8,6, 17,1, 204,1, 192,1, 7,1, 17,1, 128,1, 199,1, 17,1, 204,1, 28,1, 199,1, 129,2, 17,1, 28,3, 17,1, 28,5, 17,1, 193,1, 17,1, 193,1, 28,15, 17,1, 24,1, 1,1, 17,1, 24,1, 193,1, 28,1, 129,1, 16,1, 129,2, 128,1, 7,6, 17,1, 193,1, 24,1, 0,1, 128,1, 0,1, 200,1, 17,1, 193,1, 28,1, 192,1, 128,1, 113,1, 136,1, 193,3, 17,1, 28,2, 204,1, 193,2, 17,1, 193,1, 28,1, 17,1, 204,15, 17,1, 23,1, 129,1, 17,1, 23,1, 193,1, 24,1, 113,1, 24,2, 204,1, 136,1, 17,1, 28,2, 204,2, 17,1, 28,2, 17,1, 120,1, 113,1, 128,1, 200,1, 17,1, 193,1, 28,1, 200,1, 120,1, 129,1, 0,1, 193,8, 17,1, 28,1, 193,1, 28,1, 17,1, 193,19, 17,1, 193,2, 17,1, 28,1, 17,1, 28,2, 17,1, 204,1, 17,1, 140,1, 193,1, 17,1, 28,4, 17,1, 128,1, 200,1, 136,1, 193,1, 28,1, 200,1, 24,1, 1,1, 12,1, 200,1, 113,1, 23,1, 136,1, 129,1, 120,1, 136,2, 17,1, 124,1, 136,1, 124,1, 17,1, 199,1, 136,1, 135,17, 17,1, 193,1, 17,2, 28,1, 17,1, 28,2, 17,1, 193,1, 17,1, 119,1, 193,1, 23,1, 199,3, 17,1, 193,1, 128,1, 204,1, 0,1, 200,1, 28,1, 204,1, 200,1, 129,1, 204,1, 0,1, 129,1, 112,4, 0,1, 129,1, 24,1, 204,1, 0,1, 12,1, 204,1, 192,2, 0,1, 113,16, 17,1, 204,2, 17,1, 204,1, 17,1, 28,1, 17,1, 28,3, 204,1, 193,1, 128,1, 200,1, 8,1, 17,1, 28,1, 193,1, 128,1, 12,1, 0,1, 192,1, 193,1, 128,1, 8,1, 17,2, 204,1, 193,1, 128,1, 8,1, 0,1, 8,1, 0,1, 8,1, 112,1, 0,1, 8,1, 0,1, 23,1, 0,1, 128,1, 0,1, 1,14, 17,1, 193,2, 17,1, 204,1, 17,1, 204,1, 17,1, 28,2, 17,1, 193,1, 17,1, 136,1, 17,1, 8,2, 204,1, 17,1, 204,1, 17,1, 128,1, 12,1, 120,1, 204,1, 193,1, 16,1, 8,1, 17,1, 0,1, 1,1, 113,1, 128,1, 7,1, 120,1, 7,1, 120,1, 8,1, 128,1, 8,1, 120,1, 0,1, 136,1, 0,1, 119,1, 112,1, 7,14, 17,1, 204,2, 17,1, 28,1, 17,1, 204,1, 17,1, 204,2, 17,3, 204,1, 17,1, 128,1, 8,1, 140,1, 204,2, 17,1, 128,1, 135,1, 24,1, 0,1, 129,1, 16,1, 8,1, 17,1, 0,1, 113,1, 17,1, 128,1, 129,1, 24,1, 129,1, 24,1, 8,1, 128,1, 7,1, 23,1, 128,1, 136,1, 8,1, 17,1, 128,1, 8,14, 17,1, 28,2, 17,1, 204,1, 17,2, 204,1, 193,4, 17,1, 136,1, 23,1, 113,1, 136,1, 0,1, 113,2, 17,1, 128,1, 8,1, 136,1, 0,1, 129,1, 16,1, 8,1, 17,1, 0,1, 7,1, 113,1, 128,1, 8,1, 120,1, 8,1, 120,1, 8,1, 128,1, 8,1, 136,1, 0,1, 136,1, 0,1, 136,1, 128,1, 7,14, 17,1, 28,2, 204,1, 193,1, 17,1, 28,6, 17,1, 136,1, 17,1, 129,1, 17,1, 16,1, 129,2, 17,1, 128,3, 0,1, 17,1, 16,1, 8,1, 17,1, 112,1, 8,1, 1,1, 128,1, 8,1, 128,1, 8,1, 128,1, 8,1, 112,3, 0,1, 136,3, 0,1, 1,19, 17,1, 28,6, 17,1, 0,1, 17,1, 8,1, 136,1, 8,3, 17,1, 136,2, 0,1, 7,1, 17,1, 16,1, 8,1, 17,1, 23,1, 0,1, 7,1, 128,1, 8,1, 128,1, 8,1, 128,1, 8,1, 23,3, 0,1, 136,3, 0,1, 113,19, 17,1, 28,1, 193,4, 17,1, 24,1, 136,1, 129,1, 17,1, 136,1, 113,4, 17,1, 23,1, 135,2, 17,1, 24,1, 135,2, 17,1, 23,1, 129,1, 120,1, 135,1, 120,1, 135,1, 120,1, 135,1, 17,1, 24,1, 119,1, 136,1, 120,1, 0,1, 136,1, 113,20, 17,1, 28,1, 193,34, 17,1, 24,1, 0,1, 129,22, 17,1, 193,34, 17,1, 24,1, 0,1, 129,22, 17,1, 193,34, 17,1, 23,1, 136,1, 113,187, 17};
const IsoAgLib::repeat_rawData_rawBytes_actWidth_actHeight_formatoptions_s iVtObjectBigLogo_2_aFixedBitmaps [] = {{iVtObjectBigLogo_2_aRawBitmap1Fixed0, 1328, 120, 30, (1 << 6) | 7}};
const IsoAgLib::iVtObject_c::iVtObjectPictureGraphic_s iVtObjectBigLogo_2_sROM = {65529, 100, 100,25, 2, 27, 1, 325,iVtObjectBigLogo_2_aRawBitmap0, 0,NULL, 1274,iVtObjectBigLogo_2_aRawBitmap2, 1,iVtObjectBigLogo_2_aFixedBitmaps, 0,NULL};
const IsoAgLib::iVtObject_c::iVtObjectLine_s iVtObjectleine_2_sROM = {65528, &iVtObjectLineAttributesNormal_2, 200, 1, 0, 0,NULL};
const IsoAgLib::iVtObject_c::iVtObjectOutputString_s iVtObjectOutStrLang_sROM = {65527, 60, 8, 1, &iVtObjectFontAttributesNormal6x8_2, 0, NULL, 0, 14, "My Engl String", 0,NULL};
const IsoAgLib::iVtObject_c::iVtObjectOutputString_s iVtObjectOutStrLang_2_sROM = {65527, 60, 8, 1, &iVtObjectFontAttributesNormal6x8_2, 0, NULL, 0, 14, "Me Ital String", 0,NULL};
const IsoAgLib::iVtObject_c::iVtObjectOutputString_s iVtObjectOutStrLang_1_sROM = {65527, 60, 8, 1, &iVtObjectFontAttributesNormal6x8_2, 0, NULL, 0, 15, "Mein Deu String", 0,NULL};
const IsoAgLib::iVtObject_c::iVtObjectNumberVariable_s iVtObjectVarOutNumVal_sROM = {65526, 45UL};
const IsoAgLib::iVtObject_c::iVtObjectOutputNumber_s iVtObjectOutNumVal_sROM = {65525, 30, 8, 1, &iVtObjectFontAttributesNormal6x8_2, 0, NULL, 45UL, -10L, 1, 1, 0, 0, 0,NULL};
const IsoAgLib::iVtObject_c::iVtObjectInputString_s iVtObjectInpString_sROM = {65524, 90, 8, 1, &iVtObjectFontAttributesNormal6x8R_2, NULL, 2, NULL, 0, 20, "Klick to Input      ", 1, 0,NULL};
const IsoAgLib::iVtObject_c::iVtObjectInputNumber_s iVtObjectInpNumVal_sROM = {65523, 36, 8, 1, &iVtObjectFontAttributesNormal6x8R_2, 0, NULL, 0UL, 0UL, 999999UL, 0L, 1, 0, 0, 0, 1, 0,NULL};
const IsoAgLib::iVtObject_c::iVtObjectOutputNumber_s iVtObjectfrstLstElem_sROM = {65522, 24, 8, 1, &iVtObjectFontAttributesNormal6x8_2, 0, NULL, 6398UL, 0L, 1.0, 0, 0, 0, 0,NULL};
const IsoAgLib::iVtObject_c::iVtObjectOutputNumber_s iVtObjectscndLstElem_sROM = {65521, 24, 8, 1, &iVtObjectFontAttributesNormal6x8_2, 0, NULL, 8743UL, 0L, 1.0, 0, 0, 0, 0,NULL};
const IsoAgLib::iVtObject_c::iVtObjectOutputNumber_s iVtObjectthrdLstElem_sROM = {65520, 24, 8, 1, &iVtObjectFontAttributesNormal6x8_2, 0, NULL, 3948UL, 0L, 1.0, 0, 0, 0, 0,NULL};
const IsoAgLib::iVtObject_c::iVtObjectOutputNumber_s iVtObjectfrthLstElem_sROM = {65519, 24, 8, 1, &iVtObjectFontAttributesNormal6x8_2, 0, NULL, 9467UL, 0L, 1.0, 0, 0, 0, 0,NULL};
const IsoAgLib::repeat_iVtObject_s iVtObjectInputNumList_aObject [] = {{&iVtObjectfrstLstElem}, {&iVtObjectscndLstElem}, {&iVtObjectthrdLstElem}, {&iVtObjectfrthLstElem}};
const IsoAgLib::iVtObject_c::iVtObjectInputList_s iVtObjectInputNumList_sROM = {65518, 24, 8, NULL, 0, 1, 4,iVtObjectInputNumList_aObject, 0,NULL};
const IsoAgLib::repeat_iVtObject_x_y_iVtObjectFontAttributes_row_col_s iVtObjectBtn1_aObject_x_y_font_row_col [] = {{&iVtObjectbtn1, 0, 7, NULL ,0, 0}};
const IsoAgLib::iVtObject_c::iVtObjectButton_s iVtObjectBtn1_sROM = {65517, 60, 30, 1, 0, 1, 0, 1,iVtObjectBtn1_aObject_x_y_font_row_col, 0,NULL};
const IsoAgLib::iVtObject_c::iVtObjectOutputString_s iVtObjectbtn1_sROM = {65516, 52, 8, 1, &iVtObjectFontAttributesNormal6x8_Button60x30_2, 0, NULL, 1, 7, "Button1", 0,NULL};
const IsoAgLib::repeat_iVtObject_x_y_iVtObjectFontAttributes_row_col_s iVtObjectBtn2_aObject_x_y_font_row_col [] = {{&iVtObjectbtn2, 0, 7, NULL ,0, 0}};
const IsoAgLib::iVtObject_c::iVtObjectButton_s iVtObjectBtn2_sROM = {65515, 60, 30, 1, 0, 2, 0, 1,iVtObjectBtn2_aObject_x_y_font_row_col, 0,NULL};
const IsoAgLib::iVtObject_c::iVtObjectOutputString_s iVtObjectbtn2_sROM = {65514, 52, 8, 1, &iVtObjectFontAttributesNormal6x8_Button60x30_2, 0, NULL, 1, 7, "Button2", 0,NULL};
const IsoAgLib::repeat_iVtObject_x_y_iVtObjectFontAttributes_row_col_s iVtObjectBtn3_aObject_x_y_font_row_col [] = {{&iVtObjectbtn3, 0, 7, NULL ,0, 0}};
const IsoAgLib::iVtObject_c::iVtObjectButton_s iVtObjectBtn3_sROM = {65513, 60, 30, 1, 0, 3, 0, 1,iVtObjectBtn3_aObject_x_y_font_row_col, 0,NULL};
const IsoAgLib::iVtObject_c::iVtObjectOutputString_s iVtObjectbtn3_sROM = {65512, 52, 8, 1, &iVtObjectFontAttributesNormal6x8_Button60x30_2, 0, NULL, 1, 7, "Button3", 0,NULL};
const IsoAgLib::repeat_iVtObject_x_y_iVtObjectFontAttributes_row_col_s iVtObjectKeyReset_2_aObject_x_y_font_row_col [] = {{&iVtObjectOutStrSoftKey, 0, 12, NULL ,0, 0}};
const IsoAgLib::iVtObject_c::iVtObjectKey_s iVtObjectKeyReset_2_sROM = {65511, 1, 4, 1,iVtObjectKeyReset_2_aObject_x_y_font_row_col, 0,NULL};
const IsoAgLib::iVtObject_c::iVtObjectOutputString_s iVtObjectOutStrSoftKey_sROM = {65510, 60, 8, 1, &iVtObjectFontAttributesSKM6x8_2, 0, NULL, 1, 5, "Reset", 0,NULL};
const IsoAgLib::iVtObject_c::iVtObjectOutputString_s iVtObjectOutStrSoftKey_1_sROM = {65510, 60, 8, 1, &iVtObjectFontAttributesSKM6x8_2, 0, NULL, 1, 5, "Reset", 0,NULL};
const IsoAgLib::iVtObject_c::iVtObjectOutputString_s iVtObjectOutStrSoftKey_2_sROM = {65510, 60, 8, 1, &iVtObjectFontAttributesSKM6x8_2, 0, NULL, 1, 5, "Reset", 0,NULL};
const IsoAgLib::repeat_iVtObject_x_y_iVtObjectFontAttributes_row_col_s iVtObjectKeyMove_2_aObject_x_y_font_row_col [] = {{&iVtObjectops1, 0, 12, NULL ,0, 0}};
const IsoAgLib::iVtObject_c::iVtObjectKey_s iVtObjectKeyMove_2_sROM = {65509, 1, 5, 1,iVtObjectKeyMove_2_aObject_x_y_font_row_col, 0,NULL};
const IsoAgLib::iVtObject_c::iVtObjectOutputString_s iVtObjectops1_sROM = {65508, 60, 8, 1, &iVtObjectFontAttributesSKM6x8_2, 0, NULL, 1, 4, "Move", 0,NULL};
const IsoAgLib::repeat_iVtObject_x_y_iVtObjectFontAttributes_row_col_s iVtObjectKeyLogo_2_aObject_x_y_font_row_col [] = {{&iVtObjectops2, 0, 12, NULL ,0, 0}};
const IsoAgLib::iVtObject_c::iVtObjectKey_s iVtObjectKeyLogo_2_sROM = {65507, 1, 6, 1,iVtObjectKeyLogo_2_aObject_x_y_font_row_col, 0,NULL};
const IsoAgLib::iVtObject_c::iVtObjectOutputString_s iVtObjectops2_sROM = {65506, 60, 8, 1, &iVtObjectFontAttributesSKM6x8_2, 0, NULL, 1, 4, "Logo", 0,NULL};
const IsoAgLib::repeat_iVtObject_x_y_iVtObjectFontAttributes_row_col_s iVtObjectKeyChangeLang_2_aObject_x_y_font_row_col [] = {{&iVtObjectops3, 0, 12, NULL ,0, 0}};
const IsoAgLib::iVtObject_c::iVtObjectKey_s iVtObjectKeyChangeLang_2_sROM = {65505, 1, 7, 1,iVtObjectKeyChangeLang_2_aObject_x_y_font_row_col, 0,NULL};
const IsoAgLib::iVtObject_c::iVtObjectOutputString_s iVtObjectops3_sROM = {65504, 60, 8, 1, &iVtObjectFontAttributesSKM6x8_2, 0, NULL, 1, 8, "AE -> BE", 0,NULL};
const IsoAgLib::repeat_iVtObject_x_y_iVtObjectFontAttributes_row_col_s iVtObjectKeyChangeCol_2_aObject_x_y_font_row_col [] = {{&iVtObjectops4, 0, 8, NULL ,0, 0}, {&iVtObjectops5, 0, 16, NULL ,0, 0}};
const IsoAgLib::iVtObject_c::iVtObjectKey_s iVtObjectKeyChangeCol_2_sROM = {65503, 1, 8, 2,iVtObjectKeyChangeCol_2_aObject_x_y_font_row_col, 0,NULL};
const IsoAgLib::iVtObject_c::iVtObjectOutputString_s iVtObjectops4_sROM = {65502, 60, 8, 1, &iVtObjectFontAttributesSKM6x8_2, 0, NULL, 1, 6, "Change", 0,NULL};
const IsoAgLib::iVtObject_c::iVtObjectOutputString_s iVtObjectops5_sROM = {65501, 60, 8, 1, &iVtObjectFontAttributesSKM6x8_2, 0, NULL, 1, 6, "Colour", 0,NULL};
const IsoAgLib::repeat_iVtObject_x_y_iVtObjectFontAttributes_row_col_s iVtObjectKeyForbidden_2_aObject_x_y_font_row_col [] = {{&iVtObjectops6, 0, 12, NULL ,0, 0}};
const IsoAgLib::iVtObject_c::iVtObjectKey_s iVtObjectKeyForbidden_2_sROM = {65500, 1, 9, 1,iVtObjectKeyForbidden_2_aObject_x_y_font_row_col, 0,NULL};
const IsoAgLib::iVtObject_c::iVtObjectOutputString_s iVtObjectops6_sROM = {65499, 60, 8, 1, &iVtObjectFontAttributesSKM6x8_2, 0, NULL, 1, 10, "Forbidden!", 0,NULL};
const IsoAgLib::repeat_iVtObject_x_y_iVtObjectFontAttributes_row_col_s iVtObjectKeyChangeMask_2_aObject_x_y_font_row_col [] = {{&iVtObjectops7, 0, 0, NULL ,0, 0}};
const IsoAgLib::iVtObject_c::iVtObjectKey_s iVtObjectKeyChangeMask_2_sROM = {65498, 1, 10, 1,iVtObjectKeyChangeMask_2_aObject_x_y_font_row_col, 0,NULL};
const IsoAgLib::iVtObject_c::iVtObjectOutputString_s iVtObjectops7_sROM = {65497, 60, 32, 1, &iVtObjectFontAttributesSKM6x8_2, 2, NULL, 1, 20, "Change to other Mask", 0,NULL};
const IsoAgLib::repeat_iVtObject_x_y_iVtObjectFontAttributes_row_col_s iVtObjectKeyBackMask_aObject_x_y_font_row_col [] = {{&iVtObjectops8, 0, 7, NULL ,0, 0}};
const IsoAgLib::iVtObject_c::iVtObjectButton_s iVtObjectKeyBackMask_sROM = {65496, 60, 30, 1, 0, 11, 0, 1,iVtObjectKeyBackMask_aObject_x_y_font_row_col, 0,NULL};
const IsoAgLib::iVtObject_c::iVtObjectOutputString_s iVtObjectops8_sROM = {65495, 52, 8, 1, &iVtObjectFontAttributesNormal6x8_Button60x30_2, 0, NULL, 1, 4, "Back", 0,NULL};
const IsoAgLib::repeat_iVtObject_x_y_iVtObjectFontAttributes_row_col_s iVtObjectKeyNextMask_aObject_x_y_font_row_col [] = {{&iVtObjectops9, 0, 7, NULL ,0, 0}};
const IsoAgLib::iVtObject_c::iVtObjectButton_s iVtObjectKeyNextMask_sROM = {65494, 60, 30, 1, 0, 12, 0, 1,iVtObjectKeyNextMask_aObject_x_y_font_row_col, 0,NULL};
const IsoAgLib::iVtObject_c::iVtObjectOutputString_s iVtObjectops9_sROM = {65493, 52, 8, 1, &iVtObjectFontAttributesNormal6x8_Button60x30_2, 0, NULL, 1, 4, "Next", 0,NULL};
const IsoAgLib::iVtObject_c::iVtObjectEllipse_s iVtObjectdEllipse_2_sROM = {65492, &iVtObjectLineAttributes_Normal_2, 64, 32, 2, 0, 100, &iVtObjectFillAttributes_2, 0,NULL};
const IsoAgLib::repeat_x_y_s iVtObjectdPolygon_2_aPoints [] = {{0, 20}, {10, 10}, {10, 20}, {0, 10}, {10, 10}, {5, 0}, {0, 10}, {0, 20}, {10, 20}};
const IsoAgLib::iVtObject_c::iVtObjectPolygon_s iVtObjectdPolygon_2_sROM = {65491, 41, 35, &iVtObjectLineAttributes_Normal_2, NULL, 0, 9,iVtObjectdPolygon_2_aPoints, 0,NULL};
const IsoAgLib::repeat_iVtObject_x_y_iVtObjectFontAttributes_row_col_s iVtObjectMainMask_2_aObject_x_y_font_row_col [] = {{&iVtObjectcontainerInAllMasks_2, 0, 0, NULL ,0, 0}, {&iVtObjectmask1contentscontainer_2, 0, 30, NULL ,0, 0}};
const IsoAgLib::iVtObject_c::iVtObjectDataMask_s iVtObjectMainMask_2_sROM = {65490, 1, &iVtObjectsoftkeys1_2, 2,iVtObjectMainMask_2_aObject_x_y_font_row_col, 0,NULL};
const IsoAgLib::repeat_iVtObject_x_y_iVtObjectFontAttributes_row_col_s iVtObjectmask1contentscontainer_2_aObject_x_y_font_row_col [] = {{&iVtObjectops10, 4, 2, NULL ,0, 0}, {&iVtObjectops11, 4, 14, NULL ,0, 0}, {&iVtObjectops12, 4, 27, NULL ,0, 0}, {&iVtObjectops13, 4, 55, NULL ,0, 0}, {&iVtObjectops14, 4, 69, NULL ,0, 0}, {&iVtObjectops15, 4, 83, NULL ,0, 0}, {&iVtObjectOutStrLang, 74, 14, NULL ,0, 0}, {&iVtObjectOutNumPtr, 74, 27, NULL ,0, 0}, {&iVtObjectInpString, 74, 55, NULL ,0, 0}, {&iVtObjectInpNumVal, 74, 69, NULL ,0, 0}, {&iVtObjectInputListptr, 74, 83, NULL ,0, 0}, {&iVtObjectBtn1, 4, 110, NULL ,0, 0}, {&iVtObjectBtn2, 70, 110, NULL ,0, 0}, {&iVtObjectBtn3, 136, 110, NULL ,0, 0}, {&iVtObjectAccelArchedBarGraph_2, 4, 50, &iVtObjectFontAttributesNormal6x8_2 ,0, 13}, {&iVtObjectOpsFakeMileage_2, 4, 70, NULL ,0, 0}, {&iVtObjectChangeAwayPointer_2, 4, 70, &iVtObjectFontAttributesNormal6x8_2 ,0, 13}, {&iVtObjectOpsFakeMileage_2, 4, 74, &iVtObjectFontAttributesNormal6x8_2 ,1, 0}, {&iVtObjectrect2, 3, 1, &iVtObjectFontAttributesNormal6x8_2 ,0, 18}, {&iVtObjectInputLikeage_2, 4, 2, &iVtObjectFontAttributesNormal6x8_2 ,0, 18}, {&iVtObjectLikeageOP_2, 12, 2, &iVtObjectFontAttributesNormal6x8_2 ,0, 19}};
const IsoAgLib::iVtObject_c::iVtObjectContainer_s iVtObjectmask1contentscontainer_2_sROM = {65489, 200, 170, 0, 21,iVtObjectmask1contentscontainer_2_aObject_x_y_font_row_col, 0,NULL};
const IsoAgLib::iVtObject_c::iVtObjectOutputString_s iVtObjectops10_sROM = {65488, 102, 8, 1, &iVtObjectFontAttributesNormal6x8B_2, 0, NULL, 0, 17, "Do you like this?", 0,NULL};
const IsoAgLib::iVtObject_c::iVtObjectOutputString_s iVtObjectops11_sROM = {65487, 66, 8, 1, &iVtObjectFontAttributesNormal6x8_2, 0, NULL, 0, 10, "Output Str", 0,NULL};
const IsoAgLib::iVtObject_c::iVtObjectOutputString_s iVtObjectops12_sROM = {65486, 66, 8, 1, &iVtObjectFontAttributes_2_Normal6x8LangDep, 0, NULL, 0, 10, "Output Nr:", 0,NULL};
const IsoAgLib::iVtObject_c::iVtObjectOutputString_s iVtObjectops13_sROM = {65485, 66, 8, 1, &iVtObjectFontAttributesNormal6x8_2, 0, NULL, 0, 10, "Input Str:", 0,NULL};
const IsoAgLib::iVtObject_c::iVtObjectOutputString_s iVtObjectops14_sROM = {65484, 66, 8, 1, &iVtObjectFontAttributes_2_Normal6x8LangDep_2, 0, NULL, 0, 10, "Input Num:", 0,NULL};
const IsoAgLib::iVtObject_c::iVtObjectOutputString_s iVtObjectops15_sROM = {65483, 66, 8, 1, &iVtObjectFontAttributesNormal6x8_2, 0, NULL, 0, 10, "InputList:", 0,NULL};
const IsoAgLib::iVtObject_c::iVtObjectObjectPointer_s iVtObjectOutNumPtr_sROM = {65482, &iVtObjectOutNumVal};
const IsoAgLib::iVtObject_c::iVtObjectObjectPointer_s iVtObjectInputListptr_sROM = {65481, &iVtObjectInputNumList};
const IsoAgLib::iVtObject_c::iVtObjectArchedBarGraph_s iVtObjectAccelArchedBarGraph_2_sROM = {65480, 40, 40, 6, 5, 19, 10, 80, 5, +9985, 10015, NULL, +10000, NULL, +10000, 0,NULL};
const IsoAgLib::iVtObject_c::iVtObjectOutputString_s iVtObjectOpsFakeMileage_2_sROM = {65479, 72, 8, 1, &iVtObjectFontAttributesNormal6x8R_2, 0, NULL, 0, 12, "Fake Mileage", 0,NULL};
const IsoAgLib::iVtObject_c::iVtObjectObjectPointer_s iVtObjectChangeAwayPointer_2_sROM = {65478, &iVtObjectInputMiles};
const IsoAgLib::iVtObject_c::iVtObjectRectangle_s iVtObjectrect2_sROM = {65477, &iVtObjectLineAttributes_Normal_2, 10, 10, 0, NULL, 0,NULL};
const IsoAgLib::iVtObject_c::iVtObjectInputBoolean_s iVtObjectInputLikeage_2_sROM = {65476, 1, 8, &iVtObjectFontAttributesNormal6x8_2, NULL, 0, 1, 0,NULL};
const IsoAgLib::iVtObject_c::iVtObjectObjectPointer_s iVtObjectLikeageOP_2_sROM = {65475, NULL};
const IsoAgLib::repeat_iVtObject_s iVtObjectsoftkeys1_2_aObject [] = {{&iVtObjectKeyReset_2}, {&iVtObjectKeyMove_2}, {&iVtObjectKeyLogo_2}, {&iVtObjectKeyChangeLang_2}, {&iVtObjectKeyChangeCol_2}, {&iVtObjectKeyChangeMask_2}, {&iVtObjectKeyForbidden_2}};
const IsoAgLib::iVtObject_c::iVtObjectSoftKeyMask_s iVtObjectsoftkeys1_2_sROM = {65474, 1, 7,iVtObjectsoftkeys1_2_aObject, 0,NULL};
const IsoAgLib::repeat_iVtObject_x_y_iVtObjectFontAttributes_row_col_s iVtObjectAnotherMask_2_aObject_x_y_font_row_col [] = {{&iVtObjectcontainerInAllMasks_2, 0, 0, NULL ,0, 0}, {&iVtObjectops16, 0, 40, NULL ,0, 0}, {&iVtObjectops17, 0, 50, NULL ,0, 0}, {&iVtObjectops18, 0, 60, NULL ,0, 0}, {&iVtObjectops19, 0, 74, NULL ,0, 0}, {&iVtObjectops20, 0, 92, NULL ,0, 0}, {&iVtObjectops21, 0, 120, NULL ,0, 0}, {&iVtObjectops22, 0, 150, NULL ,0, 0}, {&iVtObjectKeyBackMask, 10, 120, NULL ,0, 0}, {&iVtObjectKeyNextMask, 70, 120, NULL ,0, 0}};
const IsoAgLib::iVtObject_c::iVtObjectDataMask_s iVtObjectAnotherMask_2_sROM = {65473, 1, &iVtObjectsoftkeys2_2, 10,iVtObjectAnotherMask_2_aObject_x_y_font_row_col, 0,NULL};
const IsoAgLib::iVtObject_c::iVtObjectOutputString_s iVtObjectops16_sROM = {65472, 480, 8, 1, &iVtObjectFontAttributesNormal6x8_2, 0, NULL, 0, 23, "Just Another Mask  6x 8", 0,NULL};
const IsoAgLib::iVtObject_c::iVtObjectOutputString_s iVtObjectops17_sROM = {65471, 480, 8, 1, &iVtObjectFontAttributesNormal8x8_2, 0, NULL, 0, 23, "Just Another Mask  8x 8", 0,NULL};
const IsoAgLib::iVtObject_c::iVtObjectOutputString_s iVtObjectops18_sROM = {65470, 480, 12, 1, &iVtObjectFontAttributesNormal8x12_2, 0, NULL, 0, 23, "Just Another Mask  8x12", 0,NULL};
const IsoAgLib::iVtObject_c::iVtObjectOutputString_s iVtObjectops19_sROM = {65469, 480, 16, 1, &iVtObjectFontAttributesNormal12x16_2, 0, NULL, 0, 10, "Just 12x16", 0,NULL};
const IsoAgLib::iVtObject_c::iVtObjectOutputString_s iVtObjectops20_sROM = {65468, 200, 16, 1, &iVtObjectFontAttributesNormal16x16_2, 0, NULL, 2, 10, "Just 16x16", 0,NULL};
const IsoAgLib::iVtObject_c::iVtObjectOutputString_s iVtObjectops21_sROM = {65467, 200, 24, 1, &iVtObjectFontAttributesNormal16x24_2, 0, NULL, 2, 10, "Just 16x24", 0,NULL};
const IsoAgLib::iVtObject_c::iVtObjectOutputString_s iVtObjectops22_sROM = {65466, 200, 32, 1, &iVtObjectFontAttributesNormal24x32_2, 0, NULL, 2, 10, "Just 24x32", 0,NULL};
const IsoAgLib::repeat_iVtObject_s iVtObjectsoftkeys2_2_aObject [] = {{&iVtObjectKeyReset_2}, {&iVtObjectKeyLogo_2}, {&iVtObjectKeyChangeCol_2}};
const IsoAgLib::iVtObject_c::iVtObjectSoftKeyMask_s iVtObjectsoftkeys2_2_sROM = {65465, 1, 3,iVtObjectsoftkeys2_2_aObject, 0,NULL};
const IsoAgLib::repeat_iVtObject_x_y_iVtObjectFontAttributes_row_col_s iVtObjectLastMask_aObject_x_y_font_row_col [] = {{&iVtObjectcontainerInAllMasks_2, 0, 0, NULL ,0, 0}, {&iVtObjectKeyBackMask, 70, 120, NULL ,0, 0}, {&iVtObjectdEllipse_2, 20, 50, NULL ,0, 0}, {&iVtObjectdPolygon_2, 10, 120, NULL ,0, 0}};
const IsoAgLib::iVtObject_c::iVtObjectDataMask_s iVtObjectLastMask_sROM = {65464, 1, &iVtObjectsoftkeys3, 4,iVtObjectLastMask_aObject_x_y_font_row_col, 0,NULL};
const IsoAgLib::repeat_iVtObject_s iVtObjectsoftkeys3_aObject [] = {{&iVtObjectKeyReset_2}, {&iVtObjectKeyLogo_2}};
const IsoAgLib::iVtObject_c::iVtObjectSoftKeyMask_s iVtObjectsoftkeys3_sROM = {65463, 1, 2,iVtObjectsoftkeys3_aObject, 0,NULL};
const IsoAgLib::repeat_iVtObject_x_y_iVtObjectFontAttributes_row_col_s iVtObjectForbiddenAlarmMask_2_aObject_x_y_font_row_col [] = {{&iVtObjectcontainerInAllMasks_2, 0, 0, NULL ,0, 0}, {&iVtObjectalarm1contentscontainer_2, 0, 30, NULL ,0, 0}};
const IsoAgLib::iVtObject_c::iVtObjectAlarmMask_s iVtObjectForbiddenAlarmMask_2_sROM = {65462, 1, NULL, 0, 0, 2,iVtObjectForbiddenAlarmMask_2_aObject_x_y_font_row_col, 0,NULL};
const IsoAgLib::repeat_iVtObject_x_y_iVtObjectFontAttributes_row_col_s iVtObjectalarm1contentscontainer_2_aObject_x_y_font_row_col [] = {{&iVtObjectops23, 0, 12, NULL ,0, 0}, {&iVtObjectops24, 0, 40, NULL ,0, 0}, {&iVtObjectops25, 0, 55, NULL ,0, 0}};
const IsoAgLib::iVtObject_c::iVtObjectContainer_s iVtObjectalarm1contentscontainer_2_sROM = {65461, 200, 170, 0, 3,iVtObjectalarm1contentscontainer_2_aObject_x_y_font_row_col, 0,NULL};
const IsoAgLib::iVtObject_c::iVtObjectOutputString_s iVtObjectops23_sROM = {65460, 200, 16, 1, &iVtObjectFontAttributesNormal12x16_2, 0, NULL, 1, 5, "ALARM", 0,NULL};
const IsoAgLib::iVtObject_c::iVtObjectOutputString_s iVtObjectops24_sROM = {65459, 200, 8, 1, &iVtObjectFontAttributesNormal6x8_2, 0, NULL, 0, 27, "I told you it is forbidden!", 0,NULL};
const IsoAgLib::iVtObject_c::iVtObjectOutputString_s iVtObjectops25_sROM = {65458, 200, 8, 1, &iVtObjectFontAttributesNormal6x8_2, 0, NULL, 2, 25, "(Press ESC to go back...)", 0,NULL};
const IsoAgLib::iVtObject_c::iVtObjectFontAttributes_s iVtObjectFontAttributesNormal6x8_2_sROM = {65457, 0, 0, 0, 0, 0,NULL};
const IsoAgLib::iVtObject_c::iVtObjectFontAttributes_s iVtObjectFontAttributes_2_Normal6x8LangDep_sROM = {65456, 0, 0, 0, 0, 0,NULL};
const IsoAgLib::iVtObject_c::iVtObjectFontAttributes_s iVtObjectFontAttributes_2_Normal6x8LangDep_1_sROM = {65456, 12, 0, 1, 0, 0,NULL};
const IsoAgLib::iVtObject_c::iVtObjectFontAttributes_s iVtObjectFontAttributes_2_Normal6x8LangDep_2_sROM = {65456, 9, 0, 1, 0, 0,NULL};
const IsoAgLib::iVtObject_c::iVtObjectFillAttributes_s iVtObjectFillAttrib_sROM = {65455,0, 34, NULL, 0,NULL};
const IsoAgLib::iVtObject_c::iVtObjectFillAttributes_s iVtObjectFillAttributes_2_sROM = {65454,0, 2, NULL, 0,NULL};
const IsoAgLib::iVtObject_c::iVtObjectFontAttributes_s iVtObjectFontAttributesNormal8x12_2_sROM = {65453, 0, 2, 0, 0, 0,NULL};
const IsoAgLib::iVtObject_c::iVtObjectFontAttributes_s iVtObjectFontAttributesNormal6x8R_2_sROM = {65452, 12, 0, 0, 0, 0,NULL};
const IsoAgLib::iVtObject_c::iVtObjectFontAttributes_s iVtObjectFontAttributesNormal6x8B_2_sROM = {65451, 9, 0, 0, 13, 0,NULL};
const IsoAgLib::iVtObject_c::iVtObjectFontAttributes_s iVtObjectFontAttributesNormal8x8_2_sROM = {65450, 0, 1, 0, 0, 0,NULL};
const IsoAgLib::iVtObject_c::iVtObjectFontAttributes_s iVtObjectFontAttributesNormal12x16_2_sROM = {65449, 0, 3, 0, 0, 0,NULL};
const IsoAgLib::iVtObject_c::iVtObjectFontAttributes_s iVtObjectFontAttributesNormal16x16_2_sROM = {65448, 0, 4, 0, 0, 0,NULL};
const IsoAgLib::iVtObject_c::iVtObjectFontAttributes_s iVtObjectFontAttributesNormal16x24_2_sROM = {65447, 0, 5, 0, 0, 0,NULL};
const IsoAgLib::iVtObject_c::iVtObjectFontAttributes_s iVtObjectFontAttributesNormal24x32_2_sROM = {65446, 0, 6, 0, 0, 0,NULL};
const IsoAgLib::iVtObject_c::iVtObjectLineAttributes_s iVtObjectLineAttributes_Normal_2_sROM = {65445, 0, 1, 0xffff, 0,NULL};
const IsoAgLib::iVtObject_c::iVtObjectLineAttributes_s iVtObjectLineAttributesNormal_2_sROM = {65444, 0, 2, 0xffff, 0,NULL};
const IsoAgLib::iVtObject_c::iVtObjectLineAttributes_s iVtObjectLineAttributesDotted_2_sROM = {65443, 0, 1, 0xaaaa, 0,NULL};
const IsoAgLib::iVtObject_c::iVtObjectFontAttributes_s iVtObjectFontAttributesSKM6x8_2_sROM = {65442, 0, 0, 0, 0, 0,NULL};
const IsoAgLib::iVtObject_c::iVtObjectFontAttributes_s iVtObjectFontAttributesSKM8x8_2_sROM = {65441, 0, 1, 0, 0, 0,NULL};
const IsoAgLib::iVtObject_c::iVtObjectFontAttributes_s iVtObjectFontAttributesSKM12x16_2_sROM = {65440, 0, 3, 0, 0, 0,NULL};
const IsoAgLib::iVtObject_c::iVtObjectLineAttributes_s iVtObjectLineAttributesSKM_2_sROM = {65439, 0, 1, 0xffff, 0,NULL};
const IsoAgLib::iVtObject_c::iVtObjectFontAttributes_s iVtObjectFontAttributesNormal6x8_Button60x30_2_sROM = {65438, 0, 0, 0, 0, 0,NULL};
