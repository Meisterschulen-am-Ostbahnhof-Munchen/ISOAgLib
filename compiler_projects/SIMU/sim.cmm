;-----------------------------------------------------------------------------
;  Name: 	sim.cmm         Description: T32-Command-File for ESX2-Project
;  Version:	01.03.99 /Se                          Copyrights (c) 1998, STW
;-----------------------------------------------------------------------------*/

	;--- START DEFINITIONS OF EMULATOR ---
	b:
	winclear
	res
	sys.cpu 167CR

	;--- MEMORY MAPPING FOR EMULATOR ---
	map.res
	map.frag 1 000000 000000--00DFFF
	map.gap 1 00E000--00FFFF
	map.frag 1 010000 010000--07FFFF
	map.bus16

	; for use of ESI-CON
	map.word

	;--- LOAD PROGRAMS ---
	;ESX2 Monitorprogram (change path, if necessary)
	;d.load.omf c:\t32pp\demo\c166\monitor\rom166wu.omf /ny
	d.load.auto c:\t32\demo\c166\monitor\rom166wu.hex

	;ESX2 Loaderprogram (normally actual directory)
	d.load.auto xos20sim.hex

	;ESX2 Applicationprogram (change path and files of project,if necessary)
	d.load.auto can_cs.abs

	;--- INTERNAL DEFINITIONS AND PROGRAMS OF EMULATOR FOR ESX2 ---
	;Interrupt Vectors
	d.a 00 jmps 0,1440      ; Reset
	d.a 08 jmps 0,1460      ; NMI
	d.a 20 jmps 0,1450      ; Breakpoints
	;C167 processor
	d.s 1400 %b 1
	;Disable internal Watchdog
	d.s 1402 %b 0
	; Lock all Interrupts (0:= run; 1:= stopped)
	d.s 1404 %w 1
	;Userwatchdog triggern
	d.a 1406--141f nop
	d.a 1406 bset dp6.5; Direction Output
	d.a     ,bset p6.5;  Watchdog = High
	d.a     ,nop
	d.a     ,nop
	d.a     ,nop
	d.a     ,nop
	d.a     ,nop
	d.a     ,nop
	d.a     ,nop
	d.a     ,nop
	d.a     ,nop
	d.a     ,bclr p6.5; Watchdog = Low
	d.a     ,jmpi cc_uc,[r4]
	;RESET and NMI-Polarity
	x.respol -
	x.nmipol -
	;NMI
	x.nmibreak on
	;stop interrupts while program stepping (On or Off)
	setup.imaskasm ON
	setup.imaskhll ON

	;--- SYSTEM ON ---
	sys.up

	;--- DEFINES OF EMULATOR DESKTOP ---
	mode.hll
	screen.always
	r.s pp 202
	var.local
	d.l main
	d.l

	go main
	wait !run()
	;wait 1.s
	d.s D:0xF1C6 %WORD 0100
end




