;------------------------------------------------------------------------------------
;  Name: 	simu.cmm               Description: T32-Command-File for ESX2-Project
;  Version:	02.12.98 /Se                                 Copyrights (c) 1998, STW
;-----------------------------------------------------------------------------------*/

	;--- START DEFINITIONS OF EMULATOR ---
	b:
	winclear
	res
	sys.cpu 167CR


	;--- MEMORY MAPPING FOR EMULATOR ---
	map.res

	;map.rom 000000--00DFFF
	;map.rom 010000--07FFFF

	map.frag 1 000000 000000--00DFFF
	map.gap 1 00E000--00FFFF
	map.frag 1 010000 010000--07FFFF

	map.bus16


	;--- LOAD PROGRAMS ---
	;ESX2 Monitorprogram (change path, if necessary)
	d.load.auto rom166wu.hex

	;ESX2 Loaderprogram (normally actual directory)
	d.load.auto xf2_4lau.hex

	;ESX2 Applicationprogram (change path and files of project,if necessary)
	y.dem on on
	sYmbol.DEMangle on on

	;d.load.auto ..\compiler_projects\EDE\7_send_setpoint\7_send_setpoint.abs /cfront
	y.spath + ..
	y.spath + ..\..\xgpl_src\__LBS_Lib
	y.spath + ..\..\xgpl_src\LBS_Lib
	y.spath + ..\..\lbs_lib_examples
	y.spath + ..\..\xgpl_src\__LBS_Lib\HwSystem
	y.spath + ..\..\xgpl_src\__LBS_Lib\LBS
	y.spath + ..\EDE\7_send_setpoint
	d.load.Ieee ..\EDE\7_send_setpoint\7_send_setpoint.abs /Include /cfront /int16 /puzzled
	y.dem on on
	sYmbol.DEMangle on on


	;--- INTERNAL DEFINITIONS AND PROGRAMS OF EMULATOR FOR ESX2 ---
	;C167 processor
	d.s 1400 %b 1
	;Disable internal Watchdog
	d.s 1402 %b 0
	; Lock all Interrupts (0:= run; 1:= stopped)
	;d.s 1404 %w 0
	d.s 1404 %w 1
	;Userwatchdog triggern
	d.a 1406--141f nop
	d.a 1406 bset dp6.5; Direction Output
	d.a     ,bset p6.5;  Watchdog = High
	d.a     ,nop
	d.a     ,nop
	d.a     ,nop
	d.a     ,nop
	d.a     ,nop
	d.a     ,nop
	d.a     ,nop
	d.a     ,nop
	d.a     ,nop
	d.a     ,bclr p6.5; Watchdog = Low
	d.a     ,jmpi cc_uc,[r4]
	;Interrupt Vectors
	d.a 00 jmps 0,1440      ; Reset
	d.a 08 jmps 0,1460      ; NMI
	d.a 20 jmps 0,1450      ; Breakpoints
	;RESET and NMI-Polarity
	x.respol -
	x.nmipol -
	;NMI
	x.nmibreak on
	;stop interrupts while program stepping
	setup.imaskasm On
	setup.imaskhll On


	;--- SYSTEM ON ---
	sys.up


	;--- DEFINES OF EMULATOR DESKTOP ---
	mode.hll
	screen.always
	;r.s pp main ; __CSTART
	r.s pp 202
	var.local
;	d.l main
	d.l

;	b:
;	go main
	y.dem on on
	sYmbol.DEMangle on on

end

























